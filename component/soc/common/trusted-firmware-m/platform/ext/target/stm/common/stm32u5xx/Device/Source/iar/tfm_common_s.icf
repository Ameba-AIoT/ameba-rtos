/*
 * Copyright (c) 2017-2022 Arm Limited. All rights reserved.
 * Copyright (c) 2020-2021 IAR Systems AB
 *
 * Licensed under the Apache License, Version 2.0 (the "License");
 * you may not use this file except in compliance with the License.
 * You may obtain a copy of the License at
 *
 *     http://www.apache.org/licenses/LICENSE-2.0
 *
 * Unless required by applicable law or agreed to in writing, software
 * distributed under the License is distributed on an "AS IS" BASIS,
 * WITHOUT WARRANTIES OR CONDITIONS OF ANY KIND, either express or implied.
 * See the License for the specific language governing permissions and
 * limitations under the License.
 *
 * This file is derivative of ../armclang/tfm_common_s.sct.template
 */

#include "region_defs.h"

define block ER_TFM_CODE with fixed order, alignment = 8, maximum size = S_CODE_SIZE {
       readonly section .intvec,
#ifndef S_RAM_CODE_START
       rw section .textrw object *.o,           /* place __ramfunc in ROM if no TFM_RAM_CODE block */
#endif
       readonly
};

define block TFM_UNPRIV_CODE with alignment = GTZC_FLASH_ALIGN {
       section SFN,
       ro section .rodata object tfm_*_secure_api.o,
       ro object *6M_tl*.a,
       ro object *7M_tl*.a,
       ro object *libtfm_sprt.a,
       ro object psa_interface_*.o,
       ro object tfm_psa_call_pack.o,
       ro object tfm_log_raw.o,
       ro object stm32u5xx_hal*.o,
       ro object tick.o
       };

    /**** Section for holding partition RO load data */
    /*
     * Sort the partition info by priority to guarantee the initing order.
     * The first loaded partition will be inited at last in SFN model.
     */
define block TFM_SP_LOAD_LIST with alignment = 4 {
    ro section .part_load_priority_lowest object load_info_*.o,
    ro section .part_load_priority_low object load_info_*.o,
    ro section .part_load_priority_normal object load_info_*.o,
    ro section .part_load_priority_high object load_info_*.o,
};

    /**** PSA RoT RO part (CODE + RODATA) start here */
    /*
     * This empty, zero long execution region is here to mark the start address
     * of PSA RoT code.
     */
define block TFM_PSA_CODE_START with alignment = 32, size = 0 { };

    define block TFM_PSA_ROT_LINKER with alignment = 32 {
        ro object *tfm_psa_rot_partition*,
    };

    /*
     * This empty, zero long execution region is here to mark the end address
     * of PSA RoT code.
     */
define block TFM_PSA_CODE_END with alignment = 32, size = 0 { };

    define block TFM_APP_ROT_LINKER with alignment = 32 {
        ro object *tfm_app_rot_partition*,
    };

    /*
     * This empty, zero long execution region is here to mark the end address
     * of APP RoT code.
     */
define block TFM_APP_CODE_END with alignment = 32, size = 0 { };


    /**** Base address of secure data area */
define block TFM_SECURE_DATA_START with size = 0 { };

    /* Shared area between BL2 and runtime to exchange data */
define block TFM_SHARED_DATA with alignment = 32, size = BOOT_TFM_SHARED_DATA_SIZE { };
define block ARM_LIB_STACK with alignment = 32, size = S_MSP_STACK_SIZE - 0x8 { };
define overlay STACK_DATA {block TFM_SHARED_DATA};
define overlay STACK_DATA {block ARM_LIB_STACK};

define block STACKSEAL with size = 0x8 { };

keep {block TFM_SHARED_DATA, block ARM_LIB_STACK};

#if defined(CONFIG_TFM_PARTITION_META)
define block TFM_SP_META_PTR with alignment = 32 {
    zi section .bss.SP_META_PTR_SPRTL_INST
       };
#endif

define block TFM_APP_RW_STACK_START with alignment = GTZC_RAM_ALIGN, size = 0 { };

    define block TFM_APP_ROT_LINKER_DATA with alignment = 32 {
        rw object *tfm_app_rot_partition*,
    };


    /*
     * This empty, zero long execution region is here to mark the end address
     * of APP RoT RW and Stack.
     */
define block TFM_APP_RW_STACK_END with alignment = GTZC_RAM_ALIGN, size = 0 { };

define block HEAP         with alignment = 8, size = S_HEAP_SIZE { };
define block ARM_LIB_HEAP with alignment = 8, size = S_HEAP_SIZE { };
define overlay HEAP_OVL {block HEAP};
define overlay HEAP_OVL {block ARM_LIB_HEAP};
keep {block HEAP, block ARM_LIB_HEAP};

define block ER_TFM_DATA          with alignment = 8 {readwrite};

/* The runtime partition placed order is same as load partition */
define block ER_PART_RT_POOL      with alignment = 4 {
    zi section .bss.part_runtime_priority_lowest,
    zi section .bss.part_runtime_priority_low,
    zi section .bss.part_runtime_priority_normal,
    zi section .bss.part_runtime_priority_high,
};

/* The runtime service placed order is same as load partition */
define block ER_SERV_RT_POOL      with alignment = 4 {
    zi section .bss.serv_runtime_priority_lowest,
    zi section .bss.serv_runtime_priority_low,
    zi section .bss.serv_runtime_priority_normal,
    zi section .bss.serv_runtime_priority_high,
};

keep {block ER_PART_RT_POOL, block ER_SERV_RT_POOL};

    /**** PSA RoT DATA start here */
    /*
     * This empty, zero long execution region is here to mark the start address
     * of PSA RoT RW and Stack.
     */
define block TFM_PSA_RW_STACK_START with alignment = 32, size = 0 { };

    define block TFM_PSA_ROT_LINKER_DATA with alignment = 32 {
        rw object *tfm_psa_rot_partition*,
    };


    /*
     * This empty, zero long execution region is here to mark the end address
     * of PSA RoT RW and Stack.
     */
define block TFM_PSA_RW_STACK_END with alignment = 32, size = 0x0 { };

#ifdef RAM_VECTORS_SUPPORT
define block ER_RAM_VECTORS      with alignment = 256 { section .ramvec };
#endif

#if defined (S_RAM_CODE_START)
define block TFM_RAM_CODE with alignment = 8 {
       rw section .textrw,               /* __ramfunc */
};
place at address S_RAM_CODE_START      { block TFM_RAM_CODE };
#endif

    /* This empty, zero long execution region is here to mark the limit address
     * of the last execution region that is allocated in SRAM.
     */
define block SRAM_WATERMARK with size = 0 { };

define block LR_CODE with fixed order {
       block ER_TFM_CODE,

       block TFM_SP_LOAD_LIST,

       block TFM_PSA_CODE_START,

       block TFM_PSA_ROT_LINKER,

       block TFM_PSA_CODE_END,
/**** UnPrivileged Flash start here , UNPRIV_BLOCK is align to match GTZC constrains */

       block TFM_UNPRIV_CODE,

/**** APPLICATION RoT RO part (CODE + RODATA) start here */

       block TFM_APP_ROT_LINKER,

    /*
     * This empty, zero long execution region is here to mark the end address
     * of APP RoT code.
     */
       block TFM_APP_CODE_END,
       };

do not initialize  {
   section .noinit,
   rw section .ramvec
   };
initialize by copy with packing = none { readwrite }
#ifndef S_RAM_CODE_START
       except { section .textrw }
#endif
       ;
if (isdefinedsymbol(__USE_DLIB_PERTHREAD))
{
  // Required in a multi-threaded application
  initialize by copy { section __DLIB_PERTHREAD };
}

place at address S_CODE_START         { block LR_CODE };

define block DATA with fixed order {

    /**** Unpriv DATA start here */
    /*
     * This empty, zero long execution region is here to mark the start address
     * of unpriv data.
     */
    block TFM_APP_RW_STACK_START,
    /* Shared area between BL2 and runtime to exchange data */

#if defined(CONFIG_TFM_PARTITION_META)
    block TFM_SP_META_PTR,
#endif

    block TFM_APP_ROT_LINKER_DATA,

    /*
     * This empty, zero long execution region is here to mark the end address
     * of APP RoT RW and Stack.
     */
    block TFM_APP_RW_STACK_END,

    /* Privileged RAM starts here */
    /**** Base address of secure data area */
    block  TFM_SECURE_DATA_START,


    overlay HEAP_OVL,

    block ER_TFM_DATA,

    block ER_PART_RT_POOL,

    block ER_SERV_RT_POOL,

    /**** PSA RoT DATA start here */
    /*
     * This empty, zero long execution region is here to mark the start address
     * of PSA RoT RW and Stack.
     */
    block TFM_PSA_RW_STACK_START,

    block TFM_PSA_ROT_LINKER_DATA,

    overlay STACK_DATA,
    block STACKSEAL,
    /*
     * This empty, zero long execution region is here to mark the end address
     * of PSA RoT RW and Stack.
     */
    block TFM_PSA_RW_STACK_END,

    /* This empty, zero long execution region is here to mark the limit address
     * of the last execution region that is allocated in SRAM.
     */
    block SRAM_WATERMARK,

    /* Make sure that the sections allocated in the SRAM does not exceed the
     * size of the SRAM available.
     */
};

place at address S_DATA_START          { block DATA };

    /*
     * Place the CMSE Veneers (containing the SG instruction) in a separate
     * 32 bytes aligned region so that the SAU can be programmed to
     * just set this region as Non-Secure Callable.
     */
define block LR_VENEER with alignment = 0x20, size = CMSE_VENEER_REGION_SIZE {section Veneer$$CMSE};
place at address CMSE_VENEER_REGION_START {block LR_VENEER};

    /* Reserved place for NS application.
     * No code will be placed here, just address of this region is used in the
     * secure code to configure certain HW components. This generates an empty
     * execution region description warning during linking.
     */
define block LR_NS_PARTITION with size = NS_PARTITION_SIZE { };
place at address NS_PARTITION_START { block LR_NS_PARTITION };

#ifdef BL2
    /* Reserved place for new image in case of firmware upgrade.
     * No code will be placed here, just address of this region is used in the
     * secure code to configure certain HW components. This generates an empty
     * execution region description warning during linking.
     */
define block LR_SECONDARY_PARTITION with size = SECONDARY_PARTITION_SIZE { };
place at address SECONDARY_PARTITION_START { block LR_SECONDARY_PARTITION };
#endif /* BL2 */
