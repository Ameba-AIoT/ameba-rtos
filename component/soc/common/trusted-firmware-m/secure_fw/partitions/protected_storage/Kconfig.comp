## component/wifi/Kconfig.wifi
```kconfig
menu "CONFIG WIFI MODE"
if WHC_DEV_MENU
    config WIFI_NAN_ENABLE
        bool "Enable NAN"
        default n
endif
    config WIFI_P2P_ENABLE
        bool "Enable P2P"
        default n
endmenu

if WHC_INTF_IPC_MENU || WIFI_SINGLE_CORE_MENU
    config WIFI_WPS_ENABLE_MENU
        bool "Enable WPS"
        default n
endif

config WIFI_EAP_ENABLE
    bool "Enable EAP"
    default n

config WIFI_CSI_ENABLE
    bool "Enable CSI"
    default n

config WIFI_ANTDIV_ENABLE
    bool "Enable ANTDIV"
    default n

config WIFI_MCC_ENABLE
    bool "Enable MCC"
    default n

config WIFI_11K_ENABLE
    bool "Enable 11K"
    default n

config WIFI_11V_ENABLE
    bool "Enable 11V"
    default n

config WIFI_11R_ENABLE
    bool "Enable 11R"
    default n

config WIFI_SPEAKER_ENABLE
    bool "Enable WIFI SPEAKER"
    default n

config RMESH_EN
    bool "Enable R-mesh"
    default n

if RMESH_EN
    config RNAT_EN
        bool "Enable R-NAT"
        default n

    config RMESH_SOCKET_EN
        bool "Enable R-mesh Socket"
        default n

if RMESH_SOCKET_EN
    config RMESH_OTA_EN
        bool "Enable R-mesh OTA"
        default n
endif

endif

if LINUX_FW_EN
    config WIFI_NAN_ENABLE
        bool "Enable NAN"
        default n
    config WIFI_P2P_ENABLE
        bool "Enable P2P"
        default n
endif

config WIFI_NAN_HOST_APP
    bool "Enable NAN host control app (km4_tz / WHC host)"
    default n
    select WIFI_NAN_ENABLE
    help
      Build the in-firmware NAN control + AT command front-end on the
      application (WHC host / km4_tz) core. It drives the NP-core NAN driver
      over the WHC IPC path (AT+NANINIT/START/PUB/SUB/STOP/DEINIT). The NP
      core must have the NAN driver (CONFIG_NAN) enabled. Selecting this
      also enables WIFI_NAN_ENABLE so the NP build skips wifi_feature_dis_nan.c
      stubs that would otherwise mask the real weak handlers.

# Only meaningful for IMG2 on FLASH (flash vs SRAM trade-off). For IMG2 on
# PSRAM/SRAM the pre-link step just forces the TRX code to the default region.
config WIFI_MOVE_TRX_CODE_TO_SRAM
    bool "Move TRX code to SRAM"
    depends on IMG2_FLASH
    default y
    help
        Move the WLAN TX/RX path code (listed in section_placement.json5) into
        SRAM for better throughput. When disabled the code is grouped into
        .flash.only.text (flash). Applied by ameba_sections_rename.py at
        pre-link (RTL8720F only for now).

if WIFI_MOVE_TRX_CODE_TO_SRAM
choice
    prompt "TRX code in SRAM"
    default WIFI_TRX_SRAM_PARTIAL
    config WIFI_TRX_SRAM_PARTIAL
        bool "Partial"
        help
            Only the hot TRX functions (.sram.only.text class) go to SRAM;
            the rest stays in flash (.flash.only.text). No remap needed.
    config WIFI_TRX_SRAM_ALL
        bool "All"
        help
            All TRX functions go to SRAM.
endchoice
endif

config WLAN_CRITICAL_CODE_IN_RAM
    bool "Enable Critical code in RAM"
    default y
```

## component/wifi/cfg80211_fullmac/Kconfig
```kconfig
# SPDX-License-Identifier: GPL-2.0
menuconfig WIFI_RTK_CFG80211_FULLMAC
    tristate "CFG80211 WiFi FULLMAC drivers"

if WIFI_RTK_CFG80211_FULLMAC

source "drivers/rtkdrivers/net/wireless/cfg80211_fullmac/rtl8730e/Kconfig"

endif
```

## component/wifi/cfg80211_fullmac/rtl8730e/Kconfig
```kconfig
# SPDX-License-Identifier: GPL-2.0
config FULLMAC_RTK_RTL8730E
	tristate "Fullmac for rtl8730e"
	select CFG80211_DEFAULT_PS
	select CFG80211_CRDA_SUPPORT
	select CFG80211_WEXT
	select WLAN_VENDOR_INTEL

	---help---
	  Realtek RTL8730E driver.
	  802.11 a/b/g/n/ac/ax AXI wireless network adapter
```
