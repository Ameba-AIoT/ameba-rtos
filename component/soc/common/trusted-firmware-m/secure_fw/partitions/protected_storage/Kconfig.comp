## component/soc/usrcfg/amebadplus/Kconfig
```kconfig
menu "CONFIG User Config"

menu "Flash Layout Configuration"

# Boot Manifest(4K) + KM4 Bootloader(252K)
comment "BOOT Offset: 0x8000000 (fixed)"

config FLASH_BOOT_OFFSET
    hex
    default 0x8000000

config FLASH_BOOT_SIZE
    hex "BOOT Size"
    default 0x14000

# Certificate(4K) + Manifest(4K) + KM0 & KM4 Application OTA1 + RDP IMG OTA1
config FLASH_OTA1_OFFSET
    hex "APP OTA1 Offset"
    default 0x8014000

config FLASH_OTA1_SIZE
    hex "APP OTA1 Size"
    default 0x1EC000

# Boot Manifest(4K) + KM4 Bootloader(252K) OTA
config FLASH_BOOT_OTA2_OFFSET
    hex "BOOT OTA2 Offset"
    default 0x8200000

config FLASH_BOOT_OTA2_SIZE
    hex "BOOT OTA2 Size"
    default 0x14000

# Certificate(4K) + Manifest(4K) + KM0 & KM4 Application OTA2 + RDP IMG OTA2
config FLASH_OTA2_OFFSET
    hex "APP OTA2 Offset"
    default 0x8214000

config FLASH_OTA2_SIZE
    hex "APP OTA2 Size"
    default 0x1C9000

# VFS region 1 (512K)
config FLASH_VFS1_OFFSET
    hex "VFS1 Offset"
    default 0x83E0000

config FLASH_VFS1_SIZE
    hex "VFS1 Size"
    default 0x20000

# VFS region 2
config FLASH_VFS2_OFFSET
    hex "VFS2 Offset"
    default 0xFFFFFFFF

config FLASH_VFS2_SIZE
    hex "VFS2 Size"
    default 0

# reserve for user
config FLASH_USER_OFFSET
    hex "USER Offset"
    default 0xFFFFFFFF

config FLASH_USER_SIZE
    hex "USER Size"
    default 0

endmenu

menu "Boot Configuration"

config LOGUART_AGG_EN
    bool "Enable Loguart AGG"
    default n
    help
        Enable or disable Loguart log aggregation (Boot_Agg_En).
        If the output character sequence of the serial port tool is
        disordered, enable this option according to the chip ID.

endmenu

menu "Clock Configuration"

choice
    prompt "SoC Clock Config"
    default CLKCFG_USB_0P9_480M
    help
        Select the SoC clock configuration. The leading [N] is the index into
        SocClk_Info[] in ameba_bootcfg.c (assigned to Boot_SocClk_Info_Idx via
        CONFIG_CLKCFG_IDX). The bootloader still validates the choice against the
        chip package (SiP Psram / No Psram); an unsupported combination will
        assert at boot.
        When USB device is enabled, only the 480MHz option (PLL is an integer
        multiple of 48MHz) is available.

config CLKCFG_PSRAM_0P9_524M
    bool "[0] SiP Psram, 0.9V, PLL 524MHz"
    depends on !USB_DEVICE_EN

config CLKCFG_PSRAM_0P9_392M
    bool "[1] SiP Psram, 0.9V, PLL 392MHz"
    depends on !USB_DEVICE_EN

config CLKCFG_PSRAM_1P0_334M
    bool "[2] SiP Psram, 1.0V, PLL 334MHz"
    depends on !USB_DEVICE_EN

config CLKCFG_NOPSRAM_0P9_512M
    bool "[3] SiP Flash / single die, 0.9V, PLL 512MHz"
    depends on !USB_DEVICE_EN

config CLKCFG_NOPSRAM_0P9_400M
    bool "[4] SiP Flash / single die, 0.9V, PLL 400MHz"
    depends on !USB_DEVICE_EN

config CLKCFG_NOPSRAM_1P0_334M
    bool "[5] SiP Flash / single die, 1.0V, PLL 334MHz"
    depends on !USB_DEVICE_EN

config CLKCFG_USB_0P9_480M
    bool "[6] USB (48M-multiple), 0.9V, PLL 480MHz"

config CLKCFG_AUDIO_1P0_677M
    bool "[7] Audio, 1.0V, PLL 677.376MHz"
    depends on !USB_DEVICE_EN

config CLKCFG_AUDIO_1P0_688M
    bool "[8] Audio, 1.0V, PLL 688.128MHz"
    depends on !USB_DEVICE_EN

endchoice

config CLKCFG_IDX
    int
    default 0 if CLKCFG_PSRAM_0P9_524M
    default 1 if CLKCFG_PSRAM_0P9_392M
    default 2 if CLKCFG_PSRAM_1P0_334M
    default 3 if CLKCFG_NOPSRAM_0P9_512M
    default 4 if CLKCFG_NOPSRAM_0P9_400M
    default 5 if CLKCFG_NOPSRAM_1P0_334M
    default 7 if CLKCFG_AUDIO_1P0_677M
    default 8 if CLKCFG_AUDIO_1P0_688M
    default 6

endmenu

menu "RAM Layout Configuration"

# TrustZone secure image (Image3) size. For SoCs without PSRAM this region may
# live in SRAM, so it is a general RAM-layout parameter, configured per IC.
config TZ_S_SIZE
    int "TrustZone Secure Image Size (KB)"
    depends on TRUSTZONE
    default 128 if TRUSTZONE_MBEDTLS
    default 64
    help
        Size of TrustZone secure image (Image3) in KB.
        Default 64KB, or 128KB when MbedTLS is enabled.

config PSRAM_KM0_IMG2_KB
    int "KM0 PSRAM image2 size (KB)"
    depends on IMG2_PSRAM || DATA_HEAP_PSRAM
    range 64 2048
    default 876
    help
        Size of the NP(KM0) PSRAM image2 segment. Only meaningful when the NP
        core places code (IMG2_PSRAM) or data/heap (DATA_HEAP_PSRAM) in PSRAM.
        Otherwise the segment collapses to 0 and all non-secure PSRAM goes to
        the AP(KM4) heap.

endmenu

endmenu
```

## component/soc/usrcfg/amebasmart/Kconfig
```kconfig
menu "CONFIG User Config"

menu "Flash Layout Configuration"

# Boot Manifest(4K) + KM4 Bootloader(252K)
comment "BOOT Offset: 0x8000000 (fixed)"

config FLASH_BOOT_OFFSET
    hex
    default 0x8000000

config FLASH_BOOT_SIZE
    hex "BOOT Size"
    default 0x40000

# Certificate(4K) + Manifest(4K) + KM0 & KM4 & CA32 Application OTA1 + RDP IMG OTA1
config FLASH_OTA1_OFFSET
    hex "APP OTA1 Offset"
    default 0x8040000

config FLASH_OTA1_SIZE
    hex "APP OTA1 Size"
    default 0x2C0000

# Boot Manifest(4K) + KM4 Bootloader(252K) OTA
config FLASH_BOOT_OTA2_OFFSET
    hex "BOOT OTA2 Offset"
    default 0x8300000

config FLASH_BOOT_OTA2_SIZE
    hex "BOOT OTA2 Size"
    default 0x40000

# Certificate(4K) + Manifest(4K) + KM0 & KM4 & CA32 Application OTA2 + RDP IMG OTA2
config FLASH_OTA2_OFFSET
    hex "APP OTA2 Offset"
    default 0x8340000

config FLASH_OTA2_SIZE
    hex "APP OTA2 Size"
    default 0x2C0000

# VFS region 1 (512K)
config FLASH_VFS1_OFFSET
    hex "VFS1 Offset"
    default 0x8600000

config FLASH_VFS1_SIZE
    hex "VFS1 Size"
    default 0x200000

# VFS region 2
config FLASH_VFS2_OFFSET
    hex "VFS2 Offset"
    default 0xFFFFFFFF

config FLASH_VFS2_SIZE
    hex "VFS2 Size"
    default 0

# reserve for user
config FLASH_USER_OFFSET
    hex "USER Offset"
    default 0xFFFFFFFF

config FLASH_USER_SIZE
    hex "USER Size"
    default 0

endmenu

menu "Boot Configuration"

config LOGUART_AGG_EN
    bool "Enable Loguart AGG"
    default n
    help
        Enable or disable Loguart log aggregation (Boot_Agg_En).
        If the output character sequence of the serial port tool is
        disordered, enable this option according to the chip ID.

endmenu

menu "RAM Layout Configuration"

# TrustZone secure image (Image3) size. For SoCs without PSRAM this region may
# live in SRAM, so it is a general RAM-layout parameter, configured per IC.
config TZ_S_SIZE
    int "TrustZone Secure Image Size (KB)"
    depends on TRUSTZONE
    default 128 if TRUSTZONE_MBEDTLS
    default 64
    help
        Size of TrustZone secure image (Image3) in KB.
        Default 64KB, or 128KB when MbedTLS is enabled.

endmenu

endmenu
```

## component/ssl/Kconfig
```kconfig
menu "CONFIG SSL"
    config MBEDTLS_ENABLED_MENU
        bool "Enable MbedTLS"
        select MBEDTLS_ENABLED if WHC_HOST || WHC_NONE || WHC_DEV_TCPIP_KEEPALIVE_FOR_KM4 || WHC_DEV_TCPIP_KEEPALIVE_FOR_KM4TZ || WHC_DEV_TCPIP_KEEPALIVE_FOR_KR4 || WPA_STD || TRUSTZONE_FOR_KM4

    config MBEDTLS_SSL_PROTO_TLS1_3_MENU
        depends on MBEDTLS_ENABLED_MENU
        bool "Enable TLS 1.3"
        select MBEDTLS_SSL_PROTO_TLS1_3 if WHC_HOST || WHC_NONE || WHC_DEV_TCPIP_KEEPALIVE_FOR_KM4 || WHC_DEV_TCPIP_KEEPALIVE_FOR_KM4TZ || WHC_DEV_TCPIP_KEEPALIVE_FOR_KR4 || WPA_STD || TRUSTZONE_FOR_KM4

    config MBEDTLS_SSL_IN_CONTENT_LEN_MENU
        depends on MBEDTLS_ENABLED_MENU
        int "Maximum len of incoming fragments"
        default 16384

    config MBEDTLS_SSL_OUT_CONTENT_LEN_MENU
        depends on MBEDTLS_ENABLED_MENU
        int "Maximum len of outgoing fragments."
        default 4096

    config GMSSL_ENABLED
        bool "Enable GmSSL"
        default false

    if AMEBAGREEN2          # only for amebagreen2 km4tz
        config SSL_ROM_TEST_MENU
            bool "SSL ROM Test"
            select SSL_ROM_TEST if WHC_HOST || WHC_NONE

        config USE_MBEDTLS_ROM_ALG # ed25519 will use mbedtls rom
            bool
            default y
    endif

    config MBEDTLS_ENABLED
        bool

    config MBEDTLS_SSL_PROTO_TLS1_3
        bool

    config MBEDTLS_SSL_IN_CONTENT_LEN
        depends on WHC_HOST || WHC_NONE || WHC_DEV_TCPIP_KEEPALIVE_FOR_KM4 || WHC_DEV_TCPIP_KEEPALIVE_FOR_KM4TZ || WHC_DEV_TCPIP_KEEPALIVE_FOR_KR4 || WPA_STD || TRUSTZONE_FOR_KM4
        int
        default MBEDTLS_SSL_IN_CONTENT_LEN_MENU

    config MBEDTLS_SSL_OUT_CONTENT_LEN
        depends on WHC_HOST || WHC_NONE || WHC_DEV_TCPIP_KEEPALIVE_FOR_KM4 || WHC_DEV_TCPIP_KEEPALIVE_FOR_KM4TZ || WHC_DEV_TCPIP_KEEPALIVE_FOR_KR4 || WPA_STD || TRUSTZONE_FOR_KM4
        int
        default MBEDTLS_SSL_OUT_CONTENT_LEN_MENU

    config SSL_ROM_TEST
        bool

endmenu
```

## component/tflite_micro/Kconfig
```kconfig
config TFLITE_MICRO_EN_MENU
    bool "Enable TFLITE MICRO"
    select TFLITE_MICRO_EN if WHC_HOST || WHC_NONE
    default n
config TFLITE_MICRO_EN
    bool
```

## component/ui/Kconfig
```kconfig
menu "Graphics Libraries Configuration"
    rsource "LVGL/Kconfig"
    rsource "third_party/Kconfig"
endmenu
```

## component/ui/LVGL/Kconfig
```kconfig
menu "Graphics Library Selection"
    config LVGL_ENABLE
        bool "Enable LVGL Graphics Library"
        default n
        help
            Enable LVGL for graphical user interface.
            Disable this to exclude LVGL completely.

    if LVGL_ENABLE
        choice
            prompt "LVGL Version"
            default LVGL_8_3
            help
                Select the version of LVGL graphics library.

            config LVGL_8_3
                bool "LVGL 8.3"
                help
                    Use stable LVGL 8.3 (recommended for legacy projects).

            config LVGL_9_2
                bool "LVGL 9.2"
                help
                    Use latest LVGL 9.2 with new features and optimizations.
        endchoice
    endif
endmenu
```

## component/ui/third_party/Kconfig
```kconfig
menu "Third Party Libraries"
    config LIBJPEG_TURBO_ENABLE
        bool "Enable libjpeg-turbo"
        default n
        help
            Enable JPEG image support via libjpeg-turbo (faster than standard libjpeg).

    config LIBPNG_ENABLE
        bool "Enable libpng (require zlib)"
        default n
        select ZLIB_ENABLE
        help
            Enable PNG image support via libpng. It require zlib for PNG decoding.

    config ZLIB_ENABLE
        bool "Enable zlib"
        default n
        help
            Enable zlib compression library.
endmenu
```

## component/usb/Kconfig
```kconfig
menu "CONFIG USB"

    config USB_OTG_EN_MENU
        bool "Enable USB"
        select USB_OTG_EN if CORE_AS_AP

    if USB_OTG_EN_MENU
        choice
            prompt "USB Mode"
            default USB_DEVICE_EN_MENU
            config USB_DEVICE_EN_MENU
                bool "Device"
                select USB_DEVICE_EN if CORE_AS_AP
            config USB_HOST_EN_MENU
                bool "Host"
                depends on !SUPPORT_USB_DEVICE_ONLY
                select USB_HOST_EN if CORE_AS_AP
            config USB_DRD_EN_MENU
                bool "DRD"
                depends on !SUPPORT_USB_DEVICE_ONLY
                select USB_DRD_EN if CORE_AS_AP
        endchoice
    endif

    if USB_DEVICE_EN_MENU || USB_DRD_EN_MENU
        comment "USB Device Class"
        orsource "device/Kconfig"
    endif

    if USB_HOST_EN_MENU || USB_DRD_EN_MENU
        comment "USB Host Class"
        orsource "host/Kconfig"
    endif

    config USB_OTG_EN
        bool
    config USB_DEVICE_EN
        bool
    config USB_HOST_EN
        bool
    config USB_DRD_EN
        bool

    config USBD_CDC_ACM
        bool
    config USBD_COMPOSITE
        bool
    config USBD_COMPOSITE_CDC_ACM_HID
        bool
    config USBD_COMPOSITE_CDC_ACM_MSC
        bool
    config USBD_COMPOSITE_CDC_ACM_UAC
        bool
    config USBD_COMPOSITE_CDC_ACM_UAC1
        bool
    config USBD_COMPOSITE_CDC_ACM_UAC2
        bool
    config USBD_COMPOSITE_HID_UAC
        bool
    config USBD_COMPOSITE_HID_UAC1
        bool
    config USBD_COMPOSITE_HID_UAC2
        bool
    config USBD_HID
        bool
    config USBD_INIC
        bool
    config USBD_MSC
        bool
    config USBD_UAC
        bool
    config USBD_UAC1
        bool
    config USBD_UAC2
        bool
    config USBD_VENDOR
        bool

    config USBH_CDC_ACM
        bool
    config USBH_CDC_ECM
        bool
    config USBH_ECM_ETHERNET
        bool
    config USBH_ECM_ETHERNET_BRIDGE
        bool
    config USBH_MSC
        bool
    config USBH_UVC
        bool
    config USBH_VENDOR
        bool
endmenu
```

## component/utils/ipc/Kconfig
```kconfig
menu "IPC Message Queue Config"#DONE
    config IMQ_EN
        bool "Enable IPC Message Queue"

    if IMQ_EN
        config RPC_EN
            bool "Enable RPC"

        config IMQ2_TEST
            bool "Enable IPC Message Queue Test"


        config IPC_MSG_MASTER_FOR_KM4
            def_bool y
            depends on AMEBALITE||AMEBASMART||AMEBASMARTPLUS


    endif
endmenu
```
