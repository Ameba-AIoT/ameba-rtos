## component/soc/common/trusted-firmware-m/secure_fw/partitions/protected_storage/Kconfig.comp
```kconfig
#-------------------------------------------------------------------------------
# Copyright (c) 2022-2023, Arm Limited. All rights reserved.
#
# SPDX-License-Identifier: BSD-3-Clause
#
#-------------------------------------------------------------------------------

menu "PS component options"

config PS_CREATE_FLASH_LAYOUT
    bool "Create flash FS"
    default y
    help
      Indicates that it is required to create a PS flash layout. If this flag is
      set, PS service will generate an empty and valid PS flash layout to store
      assets. It will erase all data located in the assigned PS memory area
      before generating the PS layout.  This flag is required to be set if the
      PS memory area is located in a non-persistent memory.  This flag can be
      set if the PS memory area is located in a persistent memory without a
      valid PS flash layout in it. That is the case when it is the first time in
      the device life that the PS service is executed.

config PS_RAM_FS
    bool "Emulated RAM FS"
    default n
    help
      Enables the use of RAM instead of the persistent storage device to store
      the FS in the Protected Storage service. This flag is OFF by default.
      The PS regression tests write/erase storage multiple time, so enabling
      this flag can increase the life of flash memory when testing.

      If this flag is enabled, PS_RAM_FS_SIZE must also be provided. This
      specifies the size of the block of RAM to be used to simulate the flash.

      Note: If this flag is disabled when running the regression tests, then it
      is recommended that the persistent storage area is erased before running
      the tests to ensure that all tests can run to completion. The type of
      persistent storage area is platform specific (eFlash, MRAM, etc.) and it
      is described in corresponding flash_layout.h

config PS_ROLLBACK_PROTECTION
    bool "Rollback protection"
    default y
    depends on !PLATFORM_NV_COUNTER_MODULE_DISABLED && PS_ENCRYPTION
    help
      Enable rollback protection in protected storage service. This flag takes
      effect only if the target has non-volatile counters and PS_ENCRYPTION flag
      is on.

config PS_VALIDATE_METADATA_FROM_FLASH
    bool "Validate filesystem metadata"
    default y
    imply ITS_VALIDATE_METADATA_FROM_FLASH
    help
      Enable the validation mechanism to check the metadata store in flash
      every time the flash data is read from flash. This validation is required
      if the flash is not hardware protected against malicious writes. In case
      the flash is protected against malicious writes (i.e embedded flash, etc),
      this validation can be disabled in order to reduce the validation
      overhead.

config PS_MAX_ASSET_SIZE
    int "Maximum stored asset size"
    default 2048
    help
      Defines the maximum asset size to be stored in the PS area. This size is
      used to define the temporary buffers used by PS to read/write the asset
      content from/to flash. The memory used by the temporary buffers is
      allocated statically as PS does not use dynamic memory allocation.

config PS_NUM_ASSETS
    int "Maximum stored assets number"
    default 10
    help
      Defines the maximum number of assets to be stored in the PS area. This
      number is used to dimension statically the object table size in
      RAM (fast access) and flash (persistent storage). The memory used by the
      object table is allocated statically as PS does not use dynamic memory
      allocation.

config PS_STACK_SIZE
    hex "Stack size"
    default 0x700
    help
      Defines the stack size of the Protected Storage Secure Partition. This
      value mainly depends on the build type(debug, release and minisizerel) and
      compiler.

endmenu
```

## component/soc/common/trusted-firmware-m/secure_fw/spm/Kconfig
```kconfig
#-------------------------------------------------------------------------------
# Copyright (c) 2022-2023, Arm Limited. All rights reserved.
#
# SPDX-License-Identifier: BSD-3-Clause
#
#-------------------------------------------------------------------------------

menu "SPM"
config TFM_ISOLATION_LEVEL
    int "Isolation level"
    default 1
    range 1 3 if PLATFORM_HAS_ISOLATION_L3_SUPPORT
    range 1 2
    help
      SFN backend only supports level 1.
      IPC backend can support all 3 levels.
      Isolation level 3 requires platform support.

choice
    prompt "SPM Backend"

    config CONFIG_TFM_SPM_BACKEND_SFN
        bool "SFN Backend"
        # Multi-core platform based on inter-core communication cannot fully work with SFN
        # backend yet.
        # TO-DO: Check whether it depends on TFM_PARTITION_NS_AGENT_MAILBOX or TFM_MULTI_CORE_TOPOLOGY
        depends on !TFM_PARTITION_NS_AGENT_MAILBOX && TFM_ISOLATION_LEVEL = 1

    config CONFIG_TFM_SPM_BACKEND_IPC
        bool "IPC Backend"
        select CONFIG_TFM_PARTITION_META
endchoice

config CONFIG_TFM_SPM_BACKEND
    string
    default "IPC" if CONFIG_TFM_SPM_BACKEND_IPC
    default "SFN" if CONFIG_TFM_SPM_BACKEND_SFN
    default ""

choice
    prompt "FIH Profile"
    default TFM_FIH_PROFILE_OFF
    help
      Fault injection hardening profile

    config TFM_FIH_PROFILE_OFF
        bool "OFF"

    config TFM_FIH_PROFILE_LOW
        bool "Low"

    config TFM_FIH_PROFILE_MEDIUM
        bool "Medium"

    config TFM_FIH_PROFILE_HIGH
        bool "High"
endchoice

config TFM_FIH_PROFILE
    string
    default "OFF" if TFM_FIH_PROFILE_OFF
    default "LOW" if TFM_FIH_PROFILE_LOW
    default "MEDIUM" if TFM_FIH_PROFILE_MEDIUM
    default "HIGH" if TFM_FIH_PROFILE_HIGH

config PSA_FRAMEWORK_HAS_MM_IOVEC
    bool "MM-IOVEC"
    default n
    depends on TFM_ISOLATION_LEVEL = 1
    help
      Memory-mapped IOVECs feature, supported only for isolation level 1

################################# Misc #########################################

config TFM_EXCEPTION_INFO_DUMP
    bool "Exception information dump"
    default n
    help
      On fatal errors in the secure firmware, capture info about the
      exception. Print the info if the "SPM Log Level" is sufficient.

config CONFIG_TFM_HALT_ON_CORE_PANIC
    bool "Halt instead of rebooting"
    default n
    help
      On fatal errors in the secure firmware, halt instead of rebooting.
      This would be helpful for debugging.

config TFM_PXN_ENABLE
    bool "PXN"
    depends on ARCH_ARM_V81MM
    default n
    help
      Privileged eXecute-Never.
      Enables the PXN feature in common MPU driver and isolation setup.

config CONFIG_TFM_STACK_WATERMARKS
    bool "Stack Watermarks"
    depends on TFM_ISOLATION_LEVEL != 3
    help
      Whether to pre-fill partition stacks with a set value to help
      determine stack usage.
      Not supported for isolation level 3 yet.

config NUM_MAILBOX_QUEUE_SLOT
    int "Number of mailbox queue slots"
    depends on TFM_PARTITION_NS_AGENT_MAILBOX
    default 1

################################# SPM log level ################################

choice SPM_LOG_LEVEL
    prompt "SPM Log Level"
    default SPM_LOG_LEVEL_SILENCE

    config SPM_LOG_LEVEL_DEBUG
        bool "Debug"

    config SPM_LOG_LEVEL_INFO
        bool "Info"

    config SPM_LOG_LEVEL_ERROR
        bool "Error"

    config SPM_LOG_LEVEL_SILENCE
        bool "Silence"
endchoice

config TFM_SPM_LOG_LEVEL
    int
    default 3 if SPM_LOG_LEVEL_DEBUG
    default 2 if SPM_LOG_LEVEL_INFO
    default 1 if SPM_LOG_LEVEL_ERROR
    default 0 if SPM_LOG_LEVEL_SILENCE

endmenu

config TFM_SPM_LOG_RAW_ENABLED
    bool
    default y if TFM_SPM_LOG_LEVEL != 0 || TFM_SP_LOG_RAW_ENABLED
    default n

######################## Promptless (non-user) config options ##################
########### Do NOT change the following config options anywhere! ###############
config CONFIG_TFM_PARTITION_META
    def_bool n

config TFM_PARTITION_NS_AGENT_MAILBOX
    bool
    default y if TFM_MULTI_CORE_TOPOLOGY
    default n

config TFM_PARTITION_NS_AGENT_TZ
    bool
    default y if CONFIG_TFM_USE_TRUSTZONE
    default n
```

## component/soc/common/trusted-firmware-m/secure_fw/spm/Kconfig.comp
```kconfig
#-------------------------------------------------------------------------------
# Copyright (c) 2022-2023, Arm Limited. All rights reserved.
# Copyright (c) 2023 Cypress Semiconductor Corporation (an Infineon company)
# or an affiliate of Cypress Semiconductor Corporation. All rights reserved.
#
# SPDX-License-Identifier: BSD-3-Clause
#
#-------------------------------------------------------------------------------

menu "TF-M SPM component configs"

config CONFIG_TFM_CONN_HANDLE_MAX_NUM
    int "Maximal number of handling secure services"
    default 8
    help
      The maximal number of secure services that are connected or requested at
      the same time

config CONFIG_TFM_DOORBELL_API
    bool "Enable the doorbell APIs"
    depends on CONFIG_TFM_SPM_BACKEND_IPC
    default y

config CONFIG_TFM_SCHEDULE_WHEN_NS_INTERRUPTED
    bool "Run the scheduler after a secure interrupt pre-empts the NSPE"
    default n
endmenu
```

## component/soc/usrcfg/RTL8720F/Kconfig
```kconfig
menu "CONFIG User Config"

menu "Flash Layout Configuration"

# Boot Manifest(4K) + KM4 Bootloader(76K)
comment "BOOT Offset: 0x08000000 (fixed)"

config FLASH_BOOT_OFFSET
    hex
    default 0x08000000

config FLASH_BOOT_SIZE
    hex "BOOT Size"
    default 0x14000

# Certificate(4K) + Manifest(4K) + KM0 & KM4 Application OTA1 + RDP IMG OTA1
config FLASH_APP_OTA1_OFFSET
    hex "APP OTA1 Offset"
    default 0x08014000

config FLASH_APP_OTA1_SIZE
    hex "APP OTA1 Size"
    default 0x1EC000

# Boot Manifest(4K) + KM4 Bootloader(76K) OTA
config FLASH_BOOT_OTA2_OFFSET
    hex "BOOT OTA2 Offset"
    default 0x08200000

config FLASH_BOOT_OTA2_SIZE
    hex "BOOT OTA2 Size"
    default 0x14000

# Certificate(4K) + Manifest(4K) + KM0 & KM4 Application OTA2 + RDP IMG OTA2
config FLASH_APP_OTA2_OFFSET
    hex "APP OTA2 Offset"
    default 0x08214000

config FLASH_APP_OTA2_SIZE
    hex "APP OTA2 Size"
    default 0x1C9000

# VFS region 1 (128K)
config FLASH_VFS1_OFFSET
    hex "VFS1 Offset"
    default 0x083E0000

config FLASH_VFS1_SIZE
    hex "VFS1 Size"
    default 0x20000

# VFS region 2
config FLASH_VFS2_OFFSET
    hex "VFS2 Offset"
    default 0xFFFFFFFF

config FLASH_VFS2_SIZE
    hex "VFS2 Size"
    default 0

# reserve for user
config FLASH_USER_OFFSET
    hex "USER Offset"
    default 0xFFFFFFFF

config FLASH_USER_SIZE
    hex "USER Size"
    default 0

endmenu

menu "Boot Configuration"

config LOGUART_AGG_EN
    bool "Enable Loguart AGG"
    default n
    help
        Enable or disable Loguart log aggregation (Boot_Agg_En).
        If the output character sequence of the serial port tool is
        disordered, enable this option according to the chip ID.

endmenu

menu "Clock Configuration"

choice
    prompt "SoC Clock Config"
    default CLKCFG_0P9
    help
        Select the SoC clock configuration. The leading [N] is the index into
        SocClk_Info[] in ameba_bootcfg.c (assigned to Boot_SocClk_Info_Idx via
        CONFIG_CLKCFG_IDX).

config CLKCFG_0P9
    bool "[0] 0.9V, CPU 240MHz"

config CLKCFG_1P0
    bool "[1] 1.0V, CPU 320MHz"

endchoice

config CLKCFG_IDX
    int
    default 0 if CLKCFG_0P9
    default 1 if CLKCFG_1P0
    default 0

endmenu

menu "RAM Layout Configuration"

# TrustZone secure image (Image3) size. For SoCs without PSRAM this region may
# live in SRAM, so it is a general RAM-layout parameter, configured per IC.
config TZ_S_SIZE
    int "TrustZone Secure Image Size (KB)"
    depends on TRUSTZONE
    default 128 if TRUSTZONE_MBEDTLS
    default 64
    help
        Size of TrustZone secure image (Image3) in KB.
        Default 64KB, or 128KB when MbedTLS is enabled.

config PSRAM_KM4NS_IMG2_KB
    int "KM4NS PSRAM image2 size (KB)"
    depends on IMG2_PSRAM || DATA_HEAP_PSRAM
    range 64 2048
    default 876
    help
        Size of the NP(KM4NS) PSRAM image2 segment. Only meaningful when the NP
        core places code (IMG2_PSRAM) or data/heap (DATA_HEAP_PSRAM) in PSRAM.
        Otherwise the segment collapses to 0 and all non-secure PSRAM goes to
        the AP(KM4TZ) heap.

endmenu

endmenu
```
