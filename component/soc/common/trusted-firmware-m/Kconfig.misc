## component/soc/common/trusted-firmware-m/platform/Kconfig
```kconfig
#-------------------------------------------------------------------------------
# Copyright (c) 2022-2023, Arm Limited. All rights reserved.
#
# SPDX-License-Identifier: BSD-3-Clause
#
#-------------------------------------------------------------------------------

menu "Platform options"

rsource "Kconfig.arch"

config SECURE_UART1
    bool "Enable secure UART1"
    default n

config TFM_DUMMY_PROVISIONING
    bool "Provision with dummy values"
    default y
    select PLATFORM_DEFAULT_OTP_WRITEABLE if PLATFORM_DEFAULT_OTP
    help
      NOT to be used in production

################################# Crypto dependencies ##########################

config CRYPTO_HW_ACCELERATOR
    bool "Enable the crypto hardware accelerator"
    depends on CRYPTO_HW_ACCELERATOR_TYPE != ""
    default n

rsource "Kconfig.fpu"
rsource "Kconfig.platform"

endmenu
```

## component/soc/common/trusted-firmware-m/platform/Kconfig.arch
```kconfig
#-------------------------------------------------------------------------------
# Copyright (c) 2023, Arm Limited. All rights reserved.
#
# SPDX-License-Identifier: BSD-3-Clause
#
#-------------------------------------------------------------------------------

############### Supported Arch Options for platforms to "select" ###############
config ARCH_ARM_V6M
    def_bool n
    help
        Armv6-M

config ARCH_ARM_V7M
    def_bool n
    help
        Armv7-M

config ARCH_ARM_V80MB
    def_bool n
    help
        Armv8.0-M baseline

config ARCH_ARM_V80MM
    def_bool n
    help
        Armv8.0-M mainline

config ARCH_ARM_V81M
    def_bool n
    help
        Armv8.1-M

config TFM_SYSTEM_ARCHITECTURE
    string
    default "armv6-m" if ARCH_ARM_V6M
    default "armv7-m" if ARCH_ARM_V7M
    default "armv8-m.base" if ARCH_ARM_V80MB
    default "armv8-m.main" if ARCH_ARM_V80MM
    default "armv8.1-m.main" if ARCH_ARM_V81M
    default ""

################# Processor Options for platforms to "select" ##################
config PROCESSOR_CM0PLUS
    def_bool n
    help
        Cortex-M0+

config PROCESSOR_CM23
    def_bool n
    help
        Cortex-M23

config PROCESSOR_CM33
    def_bool n
    help
        Cortex-M33

config PROCESSOR_CM55
    def_bool n
    help
        Cortex-M55

config PROCESSOR_CM85
    def_bool n
    help
        Cortex-M85

config TFM_SYSTEM_PROCESSOR
    string
    default "cortex-m0plus" if PROCESSOR_CM0PLUS
    default "cortex-m23" if PROCESSOR_CM23
    default "cortex-m33" if PROCESSOR_CM33
    default "cortex-m55" if PROCESSOR_CM55
    default "cortex-m85" if PROCESSOR_CM85
    default ""

######################### TFM system DSP #######################################

config TFM_SYSTEM_DSP
    def_bool n

############################## FP Arch #########################################
config FP_ARCH_FPV5_D16
    def_bool n
    help
        FPv5-D16

config FP_ARCH_FPV5_SP_D16
    def_bool n
    help
        FPv5-SP-D16

config CONFIG_TFM_FP_ARCH
    string
    default "fpv5-d16" if FP_ARCH_FPV5_D16
    default "fpv5-sp-d16" if FP_ARCH_FPV5_SP_D16
    default ""

config CONFIG_TFM_FP_ARCH_ASM
    string
    default "FPv5_D16" if FP_ARCH_FPV5_D16
    default ""
```

## component/soc/common/trusted-firmware-m/platform/Kconfig.fpu
```kconfig
#-------------------------------------------------------------------------------
# Copyright (c) 2023, Arm Limited. All rights reserved.
#
# SPDX-License-Identifier: BSD-3-Clause
#
#-------------------------------------------------------------------------------

################################# FPU ####################################

menu "FPU/MVE"

    config CONFIG_TFM_LAZY_STACKING
        bool
        default n
        help
          Enable lazy stacking

    config CONFIG_TFM_ENABLE_CP10CP11
        bool
        default n
        help
          Make FPU and MVE operational when SPE and/or NSPE require FPU or MVE usage.
          This alone only enables the coprocessors CP10-CP11, whereas CONFIG_TFM_FLOAT_ABI=hard
          along with CONFIG_TFM_ENABLE_FP, CONFIG_TFM_ENABLE_MVE or CONFIG_TFM_ENABLE_MVE_FP
          compiles the code with hardware FP or MVE instructions and ABI.

    config CONFIG_TFM_ENABLE_FP
        #TODO: depends on toolchain type
        bool "Enable FP usage"
        depends on CONFIG_TFM_FP_ARCH != ""
        default n
        imply CONFIG_TFM_LAZY_STACKING
        select CONFIG_TFM_ENABLE_CP10CP11

    config CONFIG_TFM_ENABLE_MVE
        #TODO: depends on v8.1
        bool "Enable integer MVE usage"
        default n
        imply CONFIG_TFM_LAZY_STACKING
        select CONFIG_TFM_ENABLE_CP10CP11

    config CONFIG_TFM_ENABLE_MVE_FP
        bool "Enable floating-point MVE usage"
        depends on CONFIG_TFM_FP_ARCH != ""
        default n
        imply CONFIG_TFM_LAZY_STACKING
        select CONFIG_TFM_ENABLE_CP10CP11

    config CONFIG_TFM_FLOAT_ABI
        #TODO: shall be int to align with compile options
        string
        default "hard"  if CONFIG_TFM_ENABLE_FP || CONFIG_TFM_ENABLE_MVE || CONFIG_TFM_ENABLE_MVE_FP
        default "soft"
        help
          Set float abi hard to enable hardware floating-point instructions and
          hardware floating-point linkage.

          Set float abi soft, meaning software library functions for
          floating-point operations and software floating-point linkage.

endmenu
```

## component/soc/common/trusted-firmware-m/platform/Kconfig.platform
```kconfig
#-------------------------------------------------------------------------------
# Copyright (c) 2023, Arm Limited. All rights reserved.
#
# SPDX-License-Identifier: BSD-3-Clause
#
#-------------------------------------------------------------------------------

################################# Platform dependencies ########################

config PLATFORM_SVC_HANDLERS
    bool "Platform specific SVC handlers"
    default n

config PLATFORM_HAS_FIRMWARE_UPDATE_SUPPORT
    def_bool n

config PLATFORM_HAS_ISOLATION_L3_SUPPORT
    def_bool n
    help
        Platform supports Isolation level 3

################################# Test dependencies ############################

config PS_TEST_NV_COUNTERS
    bool "Use the PS test NV counters"
    default y
    help
      Enables the virtual implementation of the PS NV counters interface in
      test/secure_fw/suites/ps/secure/nv_counters of the tf-m-tests repo,
      which emulates NV counters in RAM, and disables the hardware
      implementation of NV counters provided by the secure service. This flag is
      enabled by default, but has no effect when the secure regression test is
      disabled. This flag can be overridden to OFF when building the regression
      tests. In this case, the PS rollback protection test suite will not be
      built, as it relies on extra functionality provided by the virtual NV
      counters to simulate different rollback scenarios.

      The remainder of the PS test suites will run using the hardware NV
      counters. Please note that running the tests in this configuration will
      quickly increase the hardware NV counter values, which cannot be decreased
      again.

      Overriding this flag from its default value of OFF when not building the
      regression tests is not currently supported.

config PLATFORM_SLIH_IRQ_TEST_SUPPORT
    def_bool n
    help
      Platform supports SLIH IRQ tests

config PLATFORM_FLIH_IRQ_TEST_SUPPORT
    def_bool n
    help
      Platform supports FLIH IRQ tests

######################### TFM psa api test target ##############################

config PSA_API_TEST_TARGET
    def_string ""

################################# Debug authentication #########################

config DEBUG_AUTHENTICATION_CHIP_DEFAULT
    def_bool y

config DEBUG_AUTHENTICATION_NONE
    def_bool n

config DEBUG_AUTHENTICATION_NS_ONLY
    def_bool n

config DEBUG_AUTHENTICATION_FULL
    def_bool n

config DEBUG_AUTHENTICATION
    string
    default "CHIP_DEFAULT" if DEBUG_AUTHENTICATION_CHIP_DEFAULT
    default "NONE" if DEBUG_AUTHENTICATION_NONE
    default "NS_ONLY" if DEBUG_AUTHENTICATION_NS_ONLY
    default "FULL" if DEBUG_AUTHENTICATION_FULL

################################# Platform Hardware topology ###################
config TFM_MULTI_CORE_TOPOLOGY
    bool
    default n
    help
      Dual-cpu architecture

config CONFIG_TFM_USE_TRUSTZONE
    bool
    default n
    help
      Enable use of TrustZone to transition between NSPE and SPE

######################### Cyrpto Hardware accelerator ##########################
config CRYPTO_HW_ACCELERATOR_CC312
    def_bool n
    help
        CryptoCell-312

config CRYPTO_HW_ACCELERATOR_STM
    def_bool n

config CRYPTO_HW_ACCELERATOR_TYPE
    string
    default "cc312" if CRYPTO_HW_ACCELERATOR_CC312
    default "stm" if CRYPTO_HW_ACCELERATOR_STM
    default ""

################################# Platform default #############################

config PLATFORM_DEFAULT_BL1
    bool "Use default BL1"
    default y

config PLATFORM_DEFAULT_ATTEST_HAL
    def_bool y
    help
      Use default attest hal implementation

config PLATFORM_DEFAULT_NV_COUNTERS
    def_bool y
    depends on PLATFORM_DEFAULT_OTP_WRITEABLE
    help
      Use default nv counter implementation

config PLATFORM_DEFAULT_CRYPTO_KEYS
    def_bool y
    help
      Use default crypto keys implementation

config PLATFORM_DEFAULT_ROTPK
    def_bool y
    help
      Use default root of trust public key

config PLATFORM_DEFAULT_IAK
    def_bool y
    help
      Use default initial attestation_key

config PLATFORM_DEFAULT_UART_STDOUT
    def_bool y
    help
      Use default uart stdout implementation

config PLATFORM_DEFAULT_NV_SEED
    def_bool y
    help
      Use default NV seed implementation

config PLATFORM_DEFAULT_OTP
    bool "Use trusted on-chip flash to implement OTP memory"
    default y
    help
      Use trusted on-chip flash to implement OTP memory

config PLATFORM_DEFAULT_OTP_WRITEABLE
    def_bool y
    help
      Use OTP memory with write support

config PLATFORM_DEFAULT_PROVISIONING
    def_bool y
    help
      Use default provisioning implementation

config PLATFORM_DEFAULT_SYSTEM_RESET_HALT
    bool "Use default system halt implementation"
    default y
    help
      Use default system reset/halt implementation

config PLATFORM_DEFAULT_IMAGE_SIGNING
    def_bool y
    help
      Use default image signing implementation

config TFM_PLAT_SPECIFIC_MULTI_CORE_COMM
    bool "Use a platform specific inter-core communication"
    depends on TFM_MULTI_CORE_TOPOLOGY
    help
      Whether to use a platform specific inter-core communication instead of
      mailbox in dual-cpu topology

config OTP_NV_COUNTERS_RAM_EMULATION
    bool "Enable OTP/NV_COUNTERS emulation in RAM"
    default n
    depends on PLATFORM_DEFAULT_OTP || PLATFORM_DEFAULT_NV_COUNTERS
    help
      Enable OTP/NV_COUNTERS emulation in RAM. Has no effect on non-default
      implementations of the OTP and NV_COUNTERS

config TFM_NS_NV_COUNTER_AMOUNT
    int "Numbers of NS NV counters"
    default 0
    range 0 3

config PSA_API_TEST_TARGET
    def_string ""
```

## component/soc/common/trusted-firmware-m/secure_fw/partitions/Kconfig
```kconfig
#-------------------------------------------------------------------------------
# Copyright (c) 2022-2023, Arm Limited. All rights reserved.
#
# SPDX-License-Identifier: BSD-3-Clause
#
#-------------------------------------------------------------------------------

menu "Secure partitions"

rsource "protected_storage/Kconfig"
rsource "initial_attestation/Kconfig"
rsource "firmware_update/Kconfig"
rsource "crypto/Kconfig"
rsource "platform/Kconfig"
rsource "internal_trusted_storage/Kconfig"

choice PARTITION_LOG_LEVEL
    prompt "Secure Partition Log Level"
    default PARTITION_LOG_LEVEL_SILENCE

    config PARTITION_LOG_LEVEL_DEBUG
        bool "Debug"

    config PARTITION_LOG_LEVEL_INFO
        bool "Info"

    config PARTITION_LOG_LEVEL_ERROR
        bool "Error"

    config PARTITION_LOG_LEVEL_SILENCE
        bool "Silence"
endchoice

config TFM_PARTITION_LOG_LEVEL
    int
    default 3 if PARTITION_LOG_LEVEL_DEBUG
    default 2 if PARTITION_LOG_LEVEL_INFO
    default 1 if PARTITION_LOG_LEVEL_ERROR
    default 0 if PARTITION_LOG_LEVEL_SILENCE

config TFM_SP_LOG_RAW_ENABLED
    bool
    default y if TFM_PARTITION_LOG_LEVEL != 0 || TFM_S_REG_TEST || TFM_NS_REG_TEST
    default n

endmenu
```

## component/soc/common/trusted-firmware-m/secure_fw/partitions/crypto/Kconfig
```kconfig
#-------------------------------------------------------------------------------
# Copyright (c) 2023, Arm Limited. All rights reserved.
#
# SPDX-License-Identifier: BSD-3-Clause
#
#-------------------------------------------------------------------------------

menuconfig TFM_PARTITION_CRYPTO
    bool "Crypto"
    depends on TFM_PARTITION_INTERNAL_TRUSTED_STORAGE
    select CRYPTO_NV_SEED if !CRYPTO_HW_ACCELERATOR
    default n

if TFM_PARTITION_CRYPTO

config CRYPTO_TFM_BUILTIN_KEYS_DRIVER
    bool "Enable loading builtin keys in the Crypto service secure memory"
    default y
    help
      Whether to enable the TF-M builtin key loader component. Without this, a
      platform must be define its own mechanism to make builtin keys available
      for the Crypto service (for example, through a fully opaque driver)

endif
```

## component/soc/common/trusted-firmware-m/secure_fw/partitions/crypto/Kconfig.comp
```kconfig
#-------------------------------------------------------------------------------
# Copyright (c) 2022-2023, Arm Limited. All rights reserved.
#
# SPDX-License-Identifier: BSD-3-Clause
#
#-------------------------------------------------------------------------------

menu "Crypto component options"
    depends on TFM_PARTITION_CRYPTO

config CRYPTO_STACK_SIZE
    hex "Stack size"
    default 0x1B00

config CRYPTO_ENGINE_BUF_SIZE
    hex "Crypto engine buffer size"
    default 0x4000 if CRYPTO_HW_ACCELERATOR_CC312
    default 0x2080
    help
      The mbed TLS library requires to provide a static buffer to be used as
      heap for its internal allocation CRYPTO_ENGINE_BUF_SIZE needs to be >8KB
      for EC signing by attest module.

config CRYPTO_IOVEC_BUFFER_SIZE
    int "Default size of the internal scratch buffer"
    default 5120
    help
      The size of the buffer used as an scratch for allocating internal input
      and output vectors when MM-IOVEC is not enabled.

config CRYPTO_CONC_OPER_NUM
    int "Max number of concurrent operations"
    default 8
    help
      The max number of concurrent operations that can be active (allocated) at
      any time in Crypto.

config CRYPTO_RNG_MODULE_ENABLED
    bool "PSA Crypto random number generator module"
    default y

config CRYPTO_KEY_MODULE_ENABLED
    bool "PSA Crypto Key module"
    default y

config CRYPTO_AEAD_MODULE_ENABLED
    bool "PSA Crypto AEAD module"
    default y

config CRYPTO_MAC_MODULE_ENABLED
    bool "PSA Crypto MAC module"
    default y

config CRYPTO_HASH_MODULE_ENABLED
    bool "PSA Crypto Hash module"
    default y

config CRYPTO_CIPHER_MODULE_ENABLED
    bool "PSA Crypto Cipher module"
    default y

config CRYPTO_ASYM_SIGN_MODULE_ENABLED
    bool "PSA Crypto asymmetric key signature module"
    default y

config CRYPTO_ASYM_ENCRYPT_MODULE_ENABLED
    bool "Enable PSA Crypto asymmetric key encryption module"
    default y

config CRYPTO_KEY_DERIVATION_MODULE_ENABLED
    bool "PSA Crypto key derivation module"
    default y

config CRYPTO_NV_SEED
    bool
    default n if CRYPTO_HW_ACCELERATOR
    help
      Use stored NV seed to provide entropy

config CRYPTO_SINGLE_PART_FUNCS_DISABLED
    bool "Disable single-part operations"
    default n
    help
      Keep multi-part operations in Hash, MAC, AEAD and symmetric ciphers only,
      to optimize memory footprint in resource-constrained devices.

endmenu
```
