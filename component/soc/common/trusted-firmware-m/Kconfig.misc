## component/soc/common/trusted-firmware-m/Kconfig.misc
```kconfig
#-------------------------------------------------------------------------------
# Copyright (c) 2023, Arm Limited. All rights reserved.
#
# SPDX-License-Identifier: BSD-3-Clause
#
#-------------------------------------------------------------------------------

config TFM_CODE_SHARING
    bool "Enable code sharing between MCUboot and secure firmware"
    #FIXME: Shall check IAR
    default n
    depends on !CRYPTO_HW_ACCELERATOR
    help
      This feature is only officially tested on AN521 and Musca-B1 platforms.

################################# NS ###########################################

menu "NS support"
config NS
    bool "NS app"
    default y

config TFM_NS_MANAGE_NSID
    bool "Support NSPE OS providing NSPE client_id"
    depends on !TFM_MULTI_CORE_TOPOLOGY
    help
      An NSPE client_id is provided by the NSPE OS via the SPM or directly
      by the SPM. When `TFM_NS_MANAGE_NSID` is `ON`, TF-M supports NSPE OS
      providing NSPE client_id.

config NS_EVALUATION_APP_PATH
    string "Path to TFM NS Evaluation Application"
    default ""
endmenu

################################# Mbedcrypto ###################################

menu "Mbedcrypto profile"

config MBEDCRYPTO_BUILD_TYPE
    string "Mbedcrypto build type"
    default "$(CMAKE_BUILD_TYPE)"

config TFM_MBEDCRYPTO_CONFIG_PATH
    string "Mbedtls config path"
    default "$(TFM_SOURCE_DIR)/lib/ext/mbedcrypto/mbedcrypto_config/tfm_mbedcrypto_config_default.h"
    help
      Config to use for Mbed Crypto. For increased flexibility when
      pointing to a file, set the type of this setting to 'STRING' by
      passing the :<type> portion when specifying the setting value in
      the command line. E.g.
      '-DTFM_MBEDCRYPTO_CONFIG_PATH:STRING=some_file_which_is_generated.h'
      This can be useful if the config file is generated and placed
      inside a directory already added to the include path of mbedtls.

config TFM_MBEDCRYPTO_PSA_CRYPTO_CONFIG_PATH
    string "Mbedtls psa crypto config path"
    default "$(TFM_SOURCE_DIR)/lib/ext/mbedcrypto/mbedcrypto_config/crypto_config_default.h"
    help
      Config to use psa crypto setting for Mbed Crypto

config TFM_MBEDCRYPTO_PLATFORM_EXTRA_CONFIG_PATH
    string "Mbedtls platform crypto config path"
    default ""
    help
      Config to append to standard Mbed Crypto config, used by platforms
      to configure feature support

endmenu

################################# Manifest #####################################

menu "TF-M manifest"

config TFM_MANIFEST_LIST
    string "TF-M native Secure Partition manifests list file"
    default "$(TFM_SOURCE_DIR)/tools/tfm_manifest_list.yaml"
    help
      TF-M native Secure Partition manifests list file

config TFM_EXTRA_MANIFEST_LIST_FILES
    string "Extra manifest list file(s)"
    default ""
    help
      Used to list extra Secure Partition manifests.

config TFM_EXTRA_GENERATED_FILE_LIST_PATH
    string "Path to extra generated file list."
    default ""
    help
      Appended to stardard TFM generated file list

config TFM_EXTRA_PARTITION_PATHS
    string "List of extra Secure Partitions directories."
    default ""
    help
      An extra Secure Parition folder contains source code, CMakeLists.txt and
      manifest files

endmenu
```

## component/soc/common/trusted-firmware-m/bl1/Kconfig
```kconfig
#-------------------------------------------------------------------------------
# Copyright (c) 2023, Arm Limited. All rights reserved.
#
# SPDX-License-Identifier: BSD-3-Clause
#
#-------------------------------------------------------------------------------

menuconfig BL1
    bool "BL1"
    default n

if BL1 && PLATFORM_DEFAULT_BL1

config TFM_BL2_ENCRYPTION_KEY_PATH
    string
    default "$(TFM_SOURCE_DIR)/bl1/bl1_2/bl2_dummy_encryption_key.bin"
    help
      Path to binary key to use for encrypting BL2

config TFM_GUK_PATH
    string
    default "$(TFM_SOURCE_DIR)/bl1/bl1_1/dummy_guk.bin"
    help
      Path to binary GUK key file to provision

config TFM_BL2_IMAGE_FLASH_AREA_NUM
    int "Which flash area BL2 is stored in"
    default 0

config TFM_BL2_SIGNING_KEY_PATH
    string
    default "$(TFM_SOURCE_DIR)/bl1/bl1_2/bl1_dummy_rotpk"
    help
      Path to binary BL2 signing private key

config TFM_BL1_MEMORY_MAPPED_FLASH
    bool "BL1 Access flash content"
    default y

config TFM_BL1_LOGGING
    bool "BL1 log to uart"
    default y

config TFM_BL1_DEFAULT_OTP
    bool
    default y
    help
      Whether BL1_1 will use default OTP memory

config TFM_BL1_DEFAULT_PROVISIONING
    bool
    default y
    help
      Whether BL1_1 will use default provisioning

config TFM_BL1_SOFTWARE_CRYPTO
    bool
    default y
    help
      Whether BL1_1 will use software crypto

config TFM_BL1_DUMMY_TRNG
    bool
    default y
    help
      Whether BL1_1 will use dummy TRNG

config TFM_BL1_PQ_CRYPTO
    bool "Enable LMS PQ crypto for BL2 verification."
    default n
    help
      Enable LMS PQ crypto for BL2 verification. This is experimental and should
      not yet be used in production

config TFM_BL1_IMAGE_VERSION_BL2
    string "Image version of BL2 image"
    default "1.9.0+0"

config TFM_BL1_IMAGE_SECURITY_COUNTER_BL2
    int "Security counter value to include with BL2 image"
    default 1

config TFM_BL1_2_IN_OTP
    bool "Whether BL1_2 is stored in OTP"
    default y

config BL1_HEADER_SIZE
    hex "BL1 Header size"
    default 0x800

config BL1_TRAILER_SIZE
    hex "BL1 Trailer size"
    default 0x000

config TFM_BL1_LOGGING
    bool "Enable BL1 Logging"
    default y

endif
```

## component/soc/common/trusted-firmware-m/bl2/ext/mcuboot/Kconfig
```kconfig
#-------------------------------------------------------------------------------
# Copyright (c) 2023, Arm Limited. All rights reserved.
#
# SPDX-License-Identifier: BSD-3-Clause
#
#-------------------------------------------------------------------------------

menuconfig BL2
    bool "BL2"
    default y

if BL2

config DEFAULT_MCUBOOT_SECURITY_COUNTERS
    bool "Use the default security counter configuration"
    default y
    help
      Use the default security counter configuration defined by TF-M project

config DEFAULT_MCUBOOT_FLASH_MAP
    bool "Use the default flash map"
    default y
    help
      Whether to use the default flash map defined by TF-M project

config MCUBOOT_S_IMAGE_FLASH_AREA_NUM
    int "ID of the flash area containing the primary Secure image"
    default 0
    help
      ID of the flash area containing the primary Secure image

config MCUBOOT_NS_IMAGE_FLASH_AREA_NUM
    int "ID of the flash area containing the primary Non-Secure image"
    default 1

config MCUBOOT_IMAGE_NUMBER
    int "Whether to combine S and NS into either 1 image, or sign each seperately"
    default 2
    range 1 4

config MCUBOOT_EXECUTION_SLOT
    int "Slot from which to execute the image, used for XIP mode"
    default 1

config MCUBOOT_HW_KEY
    bool "Embed the entire public key"
    default y
    help
      Whether to embed the entire public key in the image metadata instead of
      the hash only

choice
    prompt "Upgrade strategy for images"
    default MCUBOOT_UPGRADE_STRATEGY_OVERWRITE_ONLY

    config MCUBOOT_UPGRADE_STRATEGY_OVERWRITE_ONLY
        bool "Overwrite only"

    config MCUBOOT_UPGRADE_STRATEGY_SWAP_USING_SCRATCH
        bool "Swap using scratch"
        imply FWU_SUPPORT_TRIAL_STATE

    config MCUBOOT_UPGRADE_STRATEGY_SWAP_USING_MOVE
        bool "Swap using move"
        imply FWU_SUPPORT_TRIAL_STATE

    config MCUBOOT_UPGRADE_STRATEGY_DIRECT_XIP
        bool "Direct xip"
        depends on !TFM_PARTITION_FIRMWARE_UPDATE

    config MCUBOOT_UPGRADE_STRATEGY_RAM_LOAD
        bool "Ram load"
        depends on !TFM_PARTITION_FIRMWARE_UPDATE
endchoice

config MCUBOOT_UPGRADE_STRATEGY
    string "Upgrade strategy for images"
    default "OVERWRITE_ONLY" if MCUBOOT_UPGRADE_STRATEGY_OVERWRITE_ONLY
    default "SWAP_USING_SCRATCH" if MCUBOOT_UPGRADE_STRATEGY_SWAP_USING_SCRATCH
    default "SWAP_USING_MOVE" if MCUBOOT_UPGRADE_STRATEGY_SWAP_USING_MOVE
    default "DIRECT_XIP" if MCUBOOT_UPGRADE_STRATEGY_DIRECT_XIP
    default "RAM_LOAD" if MCUBOOT_UPGRADE_STRATEGY_RAM_LOAD

config BL2_HEADER_SIZE
    hex "BL2 Header size"
    default 0x400

config BL2_TRAILER_SIZE
    hex "BL2 Trailer size"
    default 0x400

choice
    prompt "Align option for mcuboot and build image with imgtool"
    config MCUBOOT_ALIGN_VAL_1
        bool "1"
    config MCUBOOT_ALIGN_VAL_2
        bool "2"
    config MCUBOOT_ALIGN_VAL_4
        bool "4"
    config MCUBOOT_ALIGN_VAL_8
        bool "8"
    config MCUBOOT_ALIGN_VAL_16
        bool "16"
    config MCUBOOT_ALIGN_VAL_32
        bool "32"
endchoice

config MCUBOOT_ALIGN_VAL
    int
    default 1 if MCUBOOT_ALIGN_VAL_1
    default 2 if MCUBOOT_ALIGN_VAL_2
    default 4 if MCUBOOT_ALIGN_VAL_4
    default 8 if MCUBOOT_ALIGN_VAL_8
    default 16 if MCUBOOT_ALIGN_VAL_16
    default 32 if MCUBOOT_ALIGN_VAL_32

config MCUBOOT_CONFIRM_IMAGE
    bool "Whether to confirm the image if REVERT is supported in MCUboot"
    default n

config MCUBOOT_DIRECT_XIP_REVERT
    bool "Enable the revert mechanism in direct-xip mode"
    default y

config MCUBOOT_HW_ROLLBACK_PROT
    bool "Enable security counter validation against non-volatile HW counters"
    default y

config MCUBOOT_ENC_IMAGES
    bool "Enable encrypted image upgrade support"
    default n

config MCUBOOT_BOOTSTRAP
    bool "Support initial state with empty primary slot and images installed from secondary slots"
    default n

config MCUBOOT_ENCRYPT_RSA
    bool "Use RSA for encrypted image upgrade support"
    default n

choice
    prompt "Fault injection hardening profile"
    default MCUBOOT_FIH_PROFILE_OFF

    config MCUBOOT_FIH_PROFILE_OFF
        bool "OFF"

    config MCUBOOT_FIH_PROFILE_LOW
        bool "LOW"

    config MCUBOOT_FIH_PROFILE_MEDIUM
        bool "MEDIUM"

    config MCUBOOT_FIH_PROFILE_HIGH
        bool "HIGH"
endchoice

config MCUBOOT_FIH_PROFILE
    string
    default "OFF" if MCUBOOT_FIH_PROFILE_OFF
    default "LOW" if MCUBOOT_FIH_PROFILE_LOW
    default "MEDIUM" if MCUBOOT_FIH_PROFILE_MEDIUM
    default "HIGH" if MCUBOOT_FIH_PROFILE_HIGH

config MCUBOOT_SIGNATURE_TYPE
    string "Algorithm to use for signature validation"
    default "RSA"
    help
      Note - If either SIGNATURE_TYPE or KEY_LEN are changed, the entries for KEY_S
      and KEY_NS will either have to be updated manually or removed from the cache.
      `cmake .. -UMCUBOOT_KEY_S -UMCUBOOT_KEY_NS`. Once removed from the cache it
      will be set to default again.

config MCUBOOT_SIGNATURE_KEY_LEN
    int "Key length to use for signature validation"
    default 3072

config MCUBOOT_KEY_S
    string "Path to key with which to sign secure binary"
    default "$(TFM_SOURCE_DIR)/bl2/ext/mcuboot/root-${MCUBOOT_SIGNATURE_TYPE}-${MCUBOOT_SIGNATURE_KEY_LEN}.pem"

config MCUBOOT_KEY_NS
    string "Path to key with which to sign non-secure binary"
    default "$(TFM_SOURCE_DIR)/bl2/ext/mcuboot/root-${MCUBOOT_SIGNATURE_TYPE}-${MCUBOOT_SIGNATURE_KEY_LEN}_1.pem"

config MCUBOOT_IMAGE_VERSION_S
    string "Version number of S image"
    default "$(TFM_VERSION)"

config MCUBOOT_IMAGE_VERSION_NS
    string "Version number of NS image"
    default "0.0.0"

config MCUBOOT_SECURITY_COUNTER_S
    int "Security counter for S image. auto sets it to IMAGE_VERSION_S"
    default 1

config MCUBOOT_SECURITY_COUNTER_NS
    int "Security counter for NS image. auto sets it to IMAGE_VERSION_NS"
    default 1

config MCUBOOT_S_IMAGE_MIN_VER
    string "Minimum version of secure image"
    default "0.0.0+0"
    help
      Minimum version of secure image required by the non-secure image for
      upgrade to this non-secure image. If MCUBOOT_IMAGE_NUMBER == 1 this
      option has no effect

config MCUBOOT_NS_IMAGE_MIN_VER
    string "Minimum version of non-secure image"
    default "0.0.0+0"
    help
      Minimum version of non-secure image required by the secure image for
      upgrade to this secure image. If MCUBOOT_IMAGE_NUMBER == 1 this option
      has no effect

config MCUBOOT_ENC_KEY_LEN
    int "Length of the AES key for encrypting images"
    default 128

config MCUBOOT_MBEDCRYPTO_CONFIG_FILEPATH
    string "Mbedtls config file to use with MCUboot"
    default "$(TFM_SOURCE_DIR)/bl2/ext/mcuboot/config/mcuboot-mbedtls-cfg.h"

choice
    prompt "MCUBoot Log Level"
    default MCUBOOT_LOG_LEVEL_INFO

    config MCUBOOT_LOG_LEVEL_DEBUG
        bool "Debug"
    config MCUBOOT_LOG_LEVEL_INFO
        bool "Info"
    config MCUBOOT_LOG_LEVEL_WARNING
        bool "Warning"
    config MCUBOOT_LOG_LEVEL_ERROR
        bool "Error"
    config MCUBOOT_LOG_LEVEL_OFF
        bool "Off"
endchoice

config MCUBOOT_LOG_LEVEL
    string
    default "DEBUG" if MCUBOOT_LOG_LEVEL_DEBUG
    default "INFO" if MCUBOOT_LOG_LEVEL_INFO
    default "WARNING" if MCUBOOT_LOG_LEVEL_WARNING
    default "ERROR" if MCUBOOT_LOG_LEVEL_ERROR
    default "OFF" if MCUBOOT_LOG_LEVEL_OFF
endif
```

## component/soc/common/trusted-firmware-m/config/build_type/Kconfig.debug
```kconfig
#-------------------------------------------------------------------------------
# Copyright (c) 2023, Arm Limited. All rights reserved.
#
# SPDX-License-Identifier: BSD-3-Clause
#
#-------------------------------------------------------------------------------

config MBEDCRYPTO_BUILD_TYPE
    default "relwithdebinfo"

config CONFIG_TFM_HALT_ON_CORE_PANIC
    default y

choice SPM_LOG_LEVEL
    default SPM_LOG_LEVEL_DEBUG
endchoice

choice PARTITION_LOG_LEVEL
    default PARTITION_LOG_LEVEL_DEBUG
endchoice
```

## component/soc/common/trusted-firmware-m/config/build_type/Kconfig.minsizerel
```kconfig
#-------------------------------------------------------------------------------
# Copyright (c) 2023, Arm Limited. All rights reserved.
#
# SPDX-License-Identifier: BSD-3-Clause
#
#-------------------------------------------------------------------------------

if BL2
config MCUBOOT_LOG_LEVEL
    default "OFF"
endif

if BL1 && PLATFORM_DEFAULT_BL1
config TFM_BL1_LOGGING
    default n
endif

choice SPM_LOG_LEVEL
    default SPM_LOG_LEVEL_SILENCE
endchoice

choice PARTITION_LOG_LEVEL
    default PARTITION_LOG_LEVEL_SILENCE
endchoice
```
