## component/soc/common/trusted-firmware-m/secure_fw/partitions/firmware_update/Kconfig
```kconfig
#-------------------------------------------------------------------------------
# Copyright (c) 2023, Arm Limited. All rights reserved.
#
# SPDX-License-Identifier: BSD-3-Clause
#
#-------------------------------------------------------------------------------

menuconfig TFM_PARTITION_FIRMWARE_UPDATE
    bool "Firmware update"
    depends on TFM_PARTITION_PLATFORM && TFM_PARTITION_CRYPTO && PLATFORM_HAS_FIRMWARE_UPDATE_SUPPORT
    default n

if TFM_PARTITION_FIRMWARE_UPDATE

config TFM_FWU_BOOTLOADER_LIB
    string "Bootloader configure file"
    default "mcuboot"
    help
      Bootloader configure file for Firmware Update partition

config TFM_CONFIG_FWU_MAX_WRITE_SIZE
    int "Max block size (byte) in psa_fwu_write"
    default 1024

config TFM_CONFIG_FWU_MAX_MANIFEST_SIZE
    int "Max size (byte) for manifest in psa_fwu_start"
    default 0

config FWU_DEVICE_CONFIG_FILE
    string "The device configuration file for Firmware Update partition"
    default ""

config FWU_SUPPORT_TRIAL_STATE
    bool
    default n
    help
      Device support TRIAL component state.

endif
```

## component/soc/common/trusted-firmware-m/secure_fw/partitions/firmware_update/Kconfig.comp
```kconfig
#-------------------------------------------------------------------------------
# Copyright (c) 2022-2023, Arm Limited. All rights reserved.
#
# SPDX-License-Identifier: BSD-3-Clause
#
#-------------------------------------------------------------------------------

menu "FWU component configs"
    depends on TFM_PARTITION_FIRMWARE_UPDATE

config TFM_FWU_BUF_SIZE
    int "Size of the FWU internal data transfer buffer"
    default TFM_CONFIG_FWU_MAX_WRITE_SIZE
    help
      Size of the FWU internal data transfer buffer
      (defaults to TFM_CONFIG_FWU_MAX_WRITE_SIZE if not set)

config FWU_STACK_SIZE
    hex "Stack size"
    default 0x600

endmenu
```

## component/soc/common/trusted-firmware-m/secure_fw/partitions/initial_attestation/Kconfig
```kconfig
#-------------------------------------------------------------------------------
# Copyright (c) 2023, Arm Limited. All rights reserved.
#
# SPDX-License-Identifier: BSD-3-Clause
#
#-------------------------------------------------------------------------------

menuconfig TFM_PARTITION_INITIAL_ATTESTATION
    bool "Initial attestation"
    depends on TFM_PARTITION_CRYPTO
    default n

if TFM_PARTITION_INITIAL_ATTESTATION

config SYMMETRIC_INITIAL_ATTESTATION
    bool "Symmetric key algorithm based Initial Attestation"
    default n
    help
      Use symmetric crypto for inital attestation

config ATTEST_INCLUDE_TEST_CODE
    bool "Include test code"
    depends on TEST_NS_ATTESTATION || TEST_S_ATTESTATION
    default n
    help
      Include minimal development tests in the initial attestation regression
      test suite

config ATTEST_KEY_BITS
    int "Key bit width"
    default 256
    help
      The size of the initial attestation key in bits

endif
```

## component/soc/common/trusted-firmware-m/secure_fw/partitions/initial_attestation/Kconfig.comp
```kconfig
#-------------------------------------------------------------------------------
# Copyright (c) 2022-2023, Arm Limited. All rights reserved.
#
# SPDX-License-Identifier: BSD-3-Clause
#
#-------------------------------------------------------------------------------

menu "Initial Attestation component options"
    depends on TFM_PARTITION_INITIAL_ATTESTATION

config ATTEST_INCLUDE_OPTIONAL_CLAIMS
    bool "Include optional claims"
    default y
    help
      Include optional claims in initial attestation token

config ATTEST_INCLUDE_COSE_KEY_ID
    bool "Include COSE key-id"
    default n
    help
      COSE key-id is an optional field in the COSE unprotected header.
      Key-id is calculated and added to the COSE header based on the value of this option.

choice ATTEST_TOKEN_PROFILE
    prompt "Token profile"
    default ATTEST_TOKEN_PROFILE_PSA_IOT_1

    config ATTEST_TOKEN_PROFILE_PSA_IOT_1
        bool "PSA_IOT_1"
    config ATTEST_TOKEN_PROFILE_PSA_2_0_0
        bool "PSA_2_0_0"
    config ATTEST_TOKEN_PROFILE_ARM_CCA
        bool "ARM_CCA"
endchoice

config ATTEST_STACK_SIZE
    hex "Stack size"
    default 0x700

endmenu
```

## component/soc/common/trusted-firmware-m/secure_fw/partitions/internal_trusted_storage/Kconfig
```kconfig
#-------------------------------------------------------------------------------
# Copyright (c) 2023, Arm Limited. All rights reserved.
#
# SPDX-License-Identifier: BSD-3-Clause
#
#-------------------------------------------------------------------------------

menuconfig TFM_PARTITION_INTERNAL_TRUSTED_STORAGE
    bool "Internal Trusted Storage"
    default n
```

## component/soc/common/trusted-firmware-m/secure_fw/partitions/internal_trusted_storage/Kconfig.comp
```kconfig
#-------------------------------------------------------------------------------
# Copyright (c) 2022-2023, Arm Limited. All rights reserved.
#
# SPDX-License-Identifier: BSD-3-Clause
#
#-------------------------------------------------------------------------------

menu "ITS component options"
  depends on TFM_PARTITION_INTERNAL_TRUSTED_STORAGE

config ITS_CREATE_FLASH_LAYOUT
    bool "Create flash layout"
    default y
    help
      Indicates that it is required to create an ITS flash layout.

config ITS_RAM_FS
    bool "RAM emulated file system"
    default n
    help
      Enables the use of RAM instead of the persistent storage device to store
      the FS in the ITS. The ITS regression tests write/erase storage multiple
      time, so enabling this option can increase the life of flash memory when
      testing.

      If this option enabled, ITS_RAM_FS_SIZE must also be provided by platforms
      in flash_layout.h to specify the size of the block of RAM to be used to
      simulate the flash.

config ITS_VALIDATE_METADATA_FROM_FLASH
    bool "Validate filesystem metadata"
    default y
    help
      Allows to enable the validation mechanism to check the metadata store in
      flash every time the flash data is read from flash. This validation is
      required if the flash is not hardware protected against data corruption.

config ITS_MAX_ASSET_SIZE
    int "Maximum asset size"
    default 512
    help
      The maximum asset size to be stored in the ITS area.

      When building for the PSA Crypto API tests, ensure the ITS max asset size
      is set to at least the size of the largest asset created by the tests.

config ITS_BUF_SIZE
    int "Internal buffer size"
    default ITS_MAX_ASSET_SIZE
    help
      Defines the size of the partition's internal data transfer buffer. If not
      provided, then ``ITS_MAX_ASSET_SIZE`` is used to allow asset data to be
      copied between the client and the filesystem in one iteration.

      Reducing the buffer size will decrease the RAM usage of the partition at
      the expense of latency, as data will be copied in multiple iterations.

      Note: when data is copied in multiple iterations, the atomicity property
      of the filesystem is lost in the case of an asynchronous power failure.

config ITS_NUM_ASSETS
    int "Number of assets"
    default 10
    help
      Defines the maximum number of assets to be stored in the ITS area. This
      number is used to dimension statically the filesystem metadata tables in
      RAM (fast access) and flash (persistent storage). The memory used by the
      filesystem metadata tables is allocated statically as ITS does not use
      dynamic memory allocation.

config ITS_STACK_SIZE
    hex "Stack size"
    default 0x720
    help
      Defines the stack size of the Internal Trusted Storage Secure Partition.
      This value mainly depends on the platform specific flash drivers, the
      build type (Debug, Release and MinSizeRel) and compiler.

endmenu
```

## component/soc/common/trusted-firmware-m/secure_fw/partitions/platform/Kconfig
```kconfig
#-------------------------------------------------------------------------------
# Copyright (c) 2023, Arm Limited. All rights reserved.
#
# SPDX-License-Identifier: BSD-3-Clause
#
#-------------------------------------------------------------------------------

menuconfig TFM_PARTITION_PLATFORM
    bool "Platform secure partition"
    default n
```

## component/soc/common/trusted-firmware-m/secure_fw/partitions/platform/Kconfig.comp
```kconfig
#-------------------------------------------------------------------------------
# Copyright (c) 2022-2023, Arm Limited. All rights reserved.
#
# SPDX-License-Identifier: BSD-3-Clause
#
#-------------------------------------------------------------------------------

menu "Platform partition component configs"
    depends on TFM_PARTITION_PLATFORM

config PLATFORM_SERVICE_INPUT_BUFFER_SIZE
    int "Size of input buffer"
    default 64
    help
      Size of the internal transiant buffer to hold input vectors from client.

config PLATFORM_SERVICE_OUTPUT_BUFFER_SIZE
    int "Size of output buffer"
    default 64
    help
      Size of the internal transiant buffer to hold service outputs.

config PLATFORM_SP_STACK_SIZE
    hex "Stack size"
    default 0x500

config PLATFORM_NV_COUNTER_MODULE_DISABLED
    bool "Disable Non-volatile counter module"
    default n

endmenu
```

## component/soc/common/trusted-firmware-m/secure_fw/partitions/protected_storage/Kconfig
```kconfig
#-------------------------------------------------------------------------------
# Copyright (c) 2023, Arm Limited. All rights reserved.
#
# SPDX-License-Identifier: BSD-3-Clause
#
#-------------------------------------------------------------------------------

menuconfig TFM_PARTITION_PROTECTED_STORAGE
    bool "Protected Storage"
    depends on TFM_PARTITION_INTERNAL_TRUSTED_STORAGE && TFM_PARTITION_PLATFORM && TFM_PARTITION_CRYPTO
    default n

if TFM_PARTITION_PROTECTED_STORAGE

config PS_ENCRYPTION
    bool "PS encryption"
    default y
    help
      Enable encryption option to encrypt the protected storage data.

config PS_CRYPTO_AEAD_ALG
    string "PS encryption AEAD algorithm"
    default "PSA_ALG_GCM"
    help
      Indicates the AEAD algorithm to use for authenticated encryption in
      Protected Storage.

      Note: For GCM/CCM it is essential that IV doesn't get repeated. If this
      flag is set to PSA_ALG_GCM or PSA_ALG_CCM, PS_ROLLBACK_PROTECTION must be
      enabled to protect against IV rollback.

endif
```
