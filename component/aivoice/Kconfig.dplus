## component/aivoice/Kconfig.dplus
```kconfig
config AIVOICE_EN_MENU
    bool "Enable AIVoice"
    select AIVOICE_EN if CORE_AS_AP
    select TFLITE_MICRO_EN if CORE_AS_AP

if AIVOICE_EN_MENU
    choice
        prompt "Select AFE Resource"
        default AFE_RES_1MIC_MENU

        config AFE_RES_1MIC_MENU
            bool "afe_res_1mic"
            select AFE_RES_1MIC if CORE_AS_AP

    endchoice

    choice
        prompt "Select KWS Resource"
        default KWS_XIAOQIANGXIAOQIANG_NIHAOXIAOQIANG_V5_125K_MENU

        config KWS_XIAOQIANGXIAOQIANG_NIHAOXIAOQIANG_V5_125K_MENU
            bool "kws_res_xqxq"
            select KWS_XIAOQIANGXIAOQIANG_NIHAOXIAOQIANG_V5_125K if CORE_AS_AP

    endchoice
endif

config AIVOICE_EN
    bool

config AFE_RES_1MIC
    bool

config KWS_XIAOQIANGXIAOQIANG_NIHAOXIAOQIANG_V5_125K
    bool
```

## component/application/speechmind/Kconfig
```kconfig
config SPEECHMIND_EN_MENU
    bool "Enable SpeechMind"
    default n
    select SPEECHMIND_EN if CORE_AS_AP
    select AUDIO_FWK if CORE_AS_AP
    select AUDIO_MIXER if CORE_AS_AP
    select MEDIA_PLAYER if CORE_AS_AP
    select MEDIA_DEMUX_WAV if CORE_AS_AP
    select MEDIA_DEMUX_MP3 if CORE_AS_AP
    select MEDIA_CODEC_PCM if CORE_AS_AP
    select MEDIA_CODEC_MP3 if CORE_AS_AP
    select IMQ_EN if AMEBALITE && CORE_AS_AP
    select RPC_EN if AMEBALITE && CORE_AS_AP

config SPEECHMIND_EN
    bool
```

## component/at_cmd/Kconfig
```kconfig
menu "CONFIG SHELL"
    config SHELL
        bool "Enable SHELL"
        default y
    if SHELL
        config LONGER_CMD
            bool "Enable Longer CMD"
        config SUPPORT_ATCMD
            depends on !PLATFORM_ZEPHYR
            bool "Enable ATCMD"
            default n
        if SUPPORT_ATCMD
            choice
                prompt "ATCMD Mode"
                config ATCMD_MANUAL_TEST
                    bool "Manual Test Mode"
                config ATCMD_HOST_CONTROL
                    bool "Host Control Mode"
                    select LONGER_CMD
                    select USB_OTG_EN_MENU if SUPPORT_USB
                    select USB_DEVICE_EN if !USB_HOST_EN_MENU
                    select USBD_CDC_ACM if !USB_HOST_EN_MENU
                    select USBH_CDC_ACM if USB_HOST_EN_MENU
            endchoice
            config ATCMD_NETWORK
                bool "Enable Network"
                default n
            if ATCMD_NETWORK
                config ATCMD_DNS
                    bool "Enable DNS"
                    default n
                config ATCMD_SNTP
                    bool "Enable SNTP"
                    default n
                config ATCMD_MDNS
                    bool "Enable MDNS"
                    default n
            endif
            config ATCMD_SOCKET
                bool "Enable Socket"
            config ATCMD_HTTP
                bool "Enable HTTP"
            config ATCMD_MQTT
                bool "Enable MQTT"
            config ATCMD_WEBSOCKET
                bool "Enable WEBSOCKET"
            config ATCMD_OTA
                bool "Enable OTA"
                default n
        endif
        config SHELL_TASK_STACK_BASIC_SIZE
            int
            # AP: TOTAL = BASIC_SIZE + CONTEXT_SAVE_SIZE + Margin
            # If Audio Enabled: extra cost about 904 (2296=1272+1024, it needs owner to update)
            default 2296 if AMEBAGREEN2 && (WHC_HOST || WHC_NONE) && SUPPORT_AUDIO_CMD_PLAYER
            # Default Required
            default 1272 if AMEBAGREEN2 && (WHC_HOST || WHC_NONE)
            # If Audio Enabled: extra cost about 832 (2440=1416+1024, it needs owner to update)
            default 2440 if AMEBADPLUS && (WHC_HOST || WHC_NONE) && SUPPORT_AUDIO_CMD_PLAYER
            # Default Required
            default 1416 if AMEBADPLUS && (WHC_HOST || WHC_NONE)
            # If Audio Enabled: extra cost about 604 (2672=1648+1024, it needs owner to update)
            default 2672 if AMEBALITE && (WHC_HOST || WHC_NONE) && SUPPORT_AUDIO_CMD_PLAYER
            # Default Required
            default 1648 if AMEBALITE && (WHC_HOST || WHC_NONE)
            # If Audio Enabled: extra cost about 800 (2440=1416+1024, it needs owner to update)
            default 2440 if AMEBASMART && (WHC_HOST || WHC_NONE) && SUPPORT_AUDIO_CMD_PLAYER
            # Default Required
            default 1416 if AMEBASMART && (WHC_HOST || WHC_NONE)
            default 1496 if AMEBAD && (WHC_HOST || WHC_NONE)
            # NP: TOTAL = BASIC_SIZE + CONTEXT_SAVE_SIZE + Margin,
            # Following IC share the same BASIC_SIZE, which is from the max size of all NP cores (Refers to the KR4 as NP)
            default 848 if (AMEBAGREEN2 || AMEBADPLUS || AMEBALITE || AMEBASMART || AMEBAD) && !WHC_HOST && !WHC_NONE
            # other ICs
            default 2048
            help
                This option sets the stack size for the shell task.

                Note: Priority order (top to bottom) means the first matching condition applies.
                As configurations are non-exclusive, place the largest required size at the top.
    endif
endmenu
```

## component/audio/Kconfig
```kconfig
menu "Audio Config"
    config AUDIO_FWK_MENU
        bool "Enable Audio Framework"
        select AUDIO_FWK if CORE_AS_AP
    if AUDIO_FWK_MENU
        choice
            prompt "Select Audio Interfaces"
            config AUDIO_MIXER_MENU
                bool "Mixer"
                select AUDIO_MIXER if CORE_AS_AP
            config AUDIO_PASSTHROUGH_MENU
                bool "PassThrough"
                select AUDIO_PASSTHROUGH if CORE_AS_AP
        endchoice

        if SUPPORT_AUDIO_DEVICE
            menu "Audio Devices"
                    comment "    Audio Devices"

                    config AUDIO_DEVICE_A2DP_MENU
                        bool "Bluetooth A2DP Device"
                        select AUDIO_DEVICE_A2DP if CORE_AS_AP

                    config AUDIO_DEVICE_USB_MENU
                        bool "Usb Device"
                        select AUDIO_DEVICE_USB if CORE_AS_AP
            endmenu
        endif
    endif


        config MEDIA_PLAYER_MENU
            bool "Enable Media Framework"
            select AUDIO_FWK_MENU
            select MEDIA_PLAYER if CORE_AS_AP

        if MEDIA_PLAYER_MENU
            menu "Demux"
                comment "    Demux"

                config MEDIA_DEMUX_WAV_MENU
                    bool "Demux WAV"
                    select MEDIA_DEMUX_WAV if CORE_AS_AP

                config MEDIA_DEMUX_MP3_MENU
                    bool "Demux MP3"
                    select MEDIA_DEMUX_MP3 if CORE_AS_AP

                config MEDIA_DEMUX_AAC_MENU
                    bool "Demux AAC"
                    select MEDIA_DEMUX_AAC if CORE_AS_AP

                config MEDIA_DEMUX_MP4_MENU
                    bool "Demux M4A"
                    select MEDIA_DEMUX_MP4 if CORE_AS_AP

                config MEDIA_DEMUX_FLAC_MENU
                    bool "Demux FLAC"
                    select MEDIA_DEMUX_FLAC if CORE_AS_AP

                config MEDIA_DEMUX_OGG_MENU
                    bool "Demux OGG"
                    select MEDIA_DEMUX_OGG if CORE_AS_AP

                config MEDIA_DEMUX_AMR_MENU
                    bool "Demux AMR"
                    select MEDIA_DEMUX_AMR if CORE_AS_AP

            endmenu

            menu "Codec"
                comment "    Codec"
                config MEDIA_CODEC_PCM_MENU
                    bool "Codec PCM"
                    select MEDIA_CODEC_PCM if CORE_AS_AP

                config MEDIA_CODEC_MP3_MENU
                    bool "Codec MP3"
                    select MEDIA_CODEC_MP3 if CORE_AS_AP

                config MEDIA_CODEC_HAAC_MENU
                    bool "Codec AAC"
                    select MEDIA_CODEC_HAAC if CORE_AS_AP

                config MEDIA_CODEC_VORBIS_MENU
                    bool "Codec VORBIS"
                    select MEDIA_CODEC_VORBIS if CORE_AS_AP

                config MEDIA_CODEC_OPUS_MENU
                    bool "Codec OPUS"
                    select MEDIA_CODEC_OPUS if CORE_AS_AP

                config MEDIA_CODEC_AMR_MENU
                    bool "Codec AMR"
                    select MEDIA_CODEC_AMR if CORE_AS_AP

                config MEDIA_CODEC_G711_MENU
                    bool "Codec G711"
                    select MEDIA_CODEC_G711 if CORE_AS_AP

                config MEDIA_CODEC_GSM_MENU
                    bool "Codec GSM"
                    select MEDIA_CODEC_GSM if CORE_AS_AP

            endmenu

            menu "Audio Output"
                comment "    Audio Output"
                config MEDIA_SINK_BT_MENU
                    bool "Bluetooth A2DP Output"
                    select SPEEX_LIB_MENU
                    select MEDIA_SINK_BT if CORE_AS_AP

                config MEDIA_SINK_UAC_MENU
                    bool "Usb Audio Output"
                    select SPEEX_LIB_MENU
                    select MEDIA_SINK_UAC if CORE_AS_AP

            endmenu
        endif


    menu "Third Party Lib"
        config SPEEX_LIB_MENU
            bool "Speex"
            default n
            select SPEEX_LIB if CORE_AS_AP
        config OPUS_LIB_MENU
            bool "OPUS"
            default n
            select OPUS_LIB if CORE_AS_AP
    endmenu

endmenu


config AUDIO_FWK
bool

config AUDIO_MIXER
bool

config AUDIO_PASSTHROUGH
bool

config AUDIO_DEVICE_A2DP
bool

config AUDIO_DEVICE_USB
bool

config MEDIA_PLAYER
bool

config MEDIA_DEMUX_WAV
bool

config MEDIA_DEMUX_MP3
bool

config MEDIA_DEMUX_AAC
bool

config MEDIA_DEMUX_MP4
bool

config MEDIA_DEMUX_FLAC
bool

config MEDIA_DEMUX_OGG
bool

config MEDIA_DEMUX_AMR
bool

config MEDIA_CODEC_PCM
bool

config MEDIA_CODEC_MP3
bool

config MEDIA_CODEC_HAAC
bool

config MEDIA_CODEC_VORBIS
bool

config MEDIA_CODEC_OPUS
bool

config MEDIA_CODEC_AMR
bool

config MEDIA_CODEC_G711
bool

config MEDIA_CODEC_GSM
bool

config MEDIA_SINK_BT
bool

config MEDIA_SINK_UAC
bool

config SPEEX_LIB
bool

config OPUS_LIB
bool
```
