## component/bluetooth/Kconfig
```kconfig
config BT_ADVANCED_FEATURE_MENU
    bool "BT Advanced Feature"
    default n

config BT_EXCLUDE_AT_COMMAND
    depends on BT_ADVANCED_FEATURE_MENU
    bool "Exclude BT AT Command"
    default n

config BT_ZEPHYR
    depends on BT_ADVANCED_FEATURE_MENU && !AMEBA_RLS    #internal
    bool "Use Zephyr BT Stack"
    default n

config BT_EXAMPLE_DEMO_MENU
    bool "BT Example Demo"
    default n

if BT_EXAMPLE_DEMO_MENU
    config BT_PERIPHERAL
        bool "BLE Peripheral"
        default n

    config BT_CENTRAL
        bool "BLE Central"
        default n

    config BT_SCATTERNET
        bool "BLE Scatternet"
        default n

    config BT_HOGP
        depends on AMEBASMART && !AMEBA_RLS    #amebasmart internal
        bool "BLE HOGP"
        default n

    config BT_THROUGHPUT
        depends on !AMEBA_RLS    #internal
        bool "BLE Throughput"
        default n

    config BT_TRANSFER_MODULE
        depends on AMEBADPLUS    #amebadplus
        bool "BLE Transfer Module"
        default n

    config BT_WIFIMATE_DEVICE
        depends on (AMEBASMART || AMEBALITE || AMEBADPLUS)    #amebasmart|amebalite|amebadplus
        bool "BLE WiFiMate Device"
        default n

    config BT_WIFIMATE_CONFIGURATOR
        depends on (AMEBASMART || AMEBALITE || AMEBADPLUS)    #amebasmart|amebalite|amebadplus
        bool "BLE WiFiMate Configurator"
        default n

    config BT_OTA_CENTRAL
        depends on (AMEBASMART || AMEBALITE || AMEBADPLUS) && !AMEBA_RLS    #amebasmart|amebalite|amebadplus internal
        bool "BLE OTA Central"
        default n

    config BT_OTA_PERIPHERAL
        depends on (AMEBASMART || AMEBALITE || AMEBADPLUS) && !AMEBA_RLS    #amebasmart|amebalite|amebadplus internal
        bool "BLE OTA Peripheral"
        default n

    if BT_HAS_MESH
        config BT_MESH_PROVISIONER_MENU
            bool "BLE Mesh Provisioner"
            default n

        config BT_MESH_DEVICE_MENU
            bool "BLE Mesh Device"
            default n

        config BT_MESH_PROVISIONER_SCATTERNET_MENU
            bool "BLE Mesh Provisioner and BLE Scatternet"
            default n

        config BT_MESH_DEVICE_SCATTERNET_MENU
            bool "BLE Mesh Device and BLE Scatternet"
            default n

        config BT_MESH_PROVISIONER_TEST_MENU
            depends on !AMEBA_RLS    #internal
            bool "BLE Mesh Provisioner Test"
            default n

        config BT_MESH_DEVICE_TEST_MENU
            depends on !AMEBA_RLS    #internal
            bool "BLE Mesh Device Test"
            default n
    endif

    if BT_HAS_LEAUDIO
        config BT_ISO_TEST_MENU
            bool "BLE ISO Test"
            default n

        config BT_LE_AUDIO_MENU
            bool "BLE Audio"
            default n

        if BT_LE_AUDIO_MENU
            config BT_LE_AUDIO_GENERIC_DEMO_MENU
                bool "BLE Audio Generic Demo"
                default n

            config BT_PBP_MENU
                bool "BLE Audio Public Broadcast Profile"
                default n

            config BT_TMAP_MENU
                bool "BLE Audio Telephony and Media Audio Profile"
                default n

            config BT_GMAP_MENU
                bool "BLE Audio Gaming Audio Profile"
                default n
        endif

        config BT_LE_AUDIO_GENERIC_DEMO_PERIPHERAL_MENU
            depends on !AMEBA_RLS    #internal
            bool "BLE Audio Generic Demo and BLE Peripheral"
            default n
    endif

    if BT_HAS_BREDR
        config BT_A2DP_MENU
            bool "BT A2DP"
            default n

        config BT_HFP_MENU
            bool "BT HFP"
            default n

        config BT_A2DP_HFP_MENU
            bool "BT A2DP and BT HFP"
            default n

        config BT_SPP_MENU
            bool "BT SPP"
            default n

        config BT_RFC_MENU
            bool "BT RFC"
            default n

        config BT_AUDIO_MP_TEST_MENU
            bool "BT Audio MP Test"
            default n

        config BT_A2DP_SCATTERNET_MENU
            bool "BT A2DP and BLE Scatternet"
            default n
    endif

    if BT_HAS_LEAUDIO && BT_HAS_BREDR
        config BT_A2DP_PBP_MENU
            depends on !AMEBA_RLS    #internal
            bool "BT A2DP and LE Audio PBP"
            default n

        config BT_A2DP_HFP_PBP_MENU
            bool "BT A2DP HFP and LE Audio PBP"
            default n

        config BT_A2DP_HFP_PBP_PERIPHERAL_MENU
            depends on !AMEBA_RLS    #internal
            bool "BT A2DP HFP and LE Audio PBP and BLE Peripheral"
            default n

        config BT_A2DP_TMAP_MENU
            depends on !AMEBA_RLS    #internal
            bool "BT A2DP and LE Audio TMAP"
            default n
    endif
endif

if BT
    config BT_MESH_PROVISIONER_MENU
        bool
        select BT_MESH_PROVISIONER
        select BT_MESH_PROVISIONER_SUPPORT

    config BT_MESH_DEVICE_MENU
        bool
        select BT_MESH_DEVICE
        select BT_MESH_DEVICE_SUPPORT

    config BT_MESH_PROVISIONER_SCATTERNET_MENU
        bool
        select BT_MESH_PROVISIONER_SCATTERNET
        select BT_MESH_PROVISIONER_SUPPORT

    config BT_MESH_DEVICE_SCATTERNET_MENU
        bool
        select BT_MESH_DEVICE_SCATTERNET
        select BT_MESH_DEVICE_SUPPORT

    config BT_MESH_PROVISIONER_TEST_MENU
        bool
        select BT_MESH_PROVISIONER_TEST
        select BT_MESH_PROVISIONER_SUPPORT

    config BT_MESH_DEVICE_TEST_MENU
        bool
        select BT_MESH_DEVICE_TEST
        select BT_MESH_DEVICE_SUPPORT

    config BT_ISO_TEST_MENU
        bool
        select BT_ISO_TEST
        select BT_ISO_SUPPORT

    config BT_LE_AUDIO_GENERIC_DEMO_MENU
        bool
        select BT_LE_AUDIO_GENERIC_DEMO
        select BT_LE_AUDIO_SUPPORT
        select BT_APP_AUDIO_DATA_SUPPORT
        select BT_AUDIO_CODEC_SUPPORT
        select BT_AUDIO_CODEC_LC3_SUPPORT

    config BT_PBP_MENU
        bool
        select BT_PBP
        select BT_LE_AUDIO_SUPPORT
        select BT_APP_AUDIO_DATA_SUPPORT
        select BT_AUDIO_CODEC_SUPPORT
        select BT_AUDIO_CODEC_LC3_SUPPORT

    config BT_TMAP_MENU
        bool
        select BT_TMAP
        select BT_TMAP_SUPPORT
        select BT_LE_AUDIO_SUPPORT
        select BT_APP_AUDIO_DATA_SUPPORT
        select BT_AUDIO_CODEC_SUPPORT
        select BT_AUDIO_CODEC_LC3_SUPPORT

    config BT_GMAP_MENU
        bool
        select BT_GMAP
        select BT_GMAP_SUPPORT
        select BT_LE_AUDIO_SUPPORT
        select BT_APP_AUDIO_DATA_SUPPORT
        select BT_AUDIO_CODEC_SUPPORT
        select BT_AUDIO_CODEC_LC3_SUPPORT

    config BT_LE_AUDIO_GENERIC_DEMO_PERIPHERAL_MENU
        bool
        select BT_LE_AUDIO_GENERIC_DEMO_PERIPHERAL
        select BT_LE_AUDIO_SUPPORT
        select BT_APP_AUDIO_DATA_SUPPORT
        select BT_AUDIO_CODEC_SUPPORT
        select BT_AUDIO_CODEC_LC3_SUPPORT

    config BT_A2DP_MENU
        bool
        select BT_A2DP
        select BT_APP_AUDIO_DATA_SUPPORT
        select BT_AUDIO_CODEC_SUPPORT
        select BT_AUDIO_CODEC_SBC_SUPPORT
        select BT_PROFILE_A2DP_SUPPORT
        select BT_PROFILE_AVRCP_SUPPORT
        select BT_PROFILE_SDP_SUPPORT

    config BT_HFP_MENU
        bool
        select BT_HFP
        select BT_APP_AUDIO_DATA_SUPPORT
        select BT_AUDIO_CODEC_SUPPORT
        select BT_AUDIO_CODEC_SBC_SUPPORT
        select BT_AUDIO_CODEC_CVSD_SUPPORT
        select BT_PROFILE_HFP_SUPPORT
        select BT_PROFILE_PBAP_SUPPORT
        select BT_PROFILE_SDP_SUPPORT

    config BT_A2DP_HFP_MENU
        bool
        select BT_A2DP_HFP
        select BT_APP_AUDIO_DATA_SUPPORT
        select BT_AUDIO_CODEC_SUPPORT
        select BT_AUDIO_CODEC_SBC_SUPPORT
        select BT_AUDIO_CODEC_CVSD_SUPPORT
        select BT_PROFILE_A2DP_SUPPORT
        select BT_PROFILE_AVRCP_SUPPORT
        select BT_PROFILE_HFP_SUPPORT
        select BT_PROFILE_PBAP_SUPPORT
        select BT_PROFILE_SDP_SUPPORT

    config BT_SPP_MENU
        bool
        select BT_SPP
        select BT_PROFILE_SPP_SUPPORT
        select BT_PROFILE_SDP_SUPPORT

    config BT_RFC_MENU
        bool
        select BT_RFC
        select BT_PROFILE_RFC_SUPPORT
        select BT_PROFILE_SDP_SUPPORT

    config BT_AUDIO_MP_TEST_MENU
        bool
        select BT_AUDIO_MP_TEST
        select BT_APP_AUDIO_DATA_SUPPORT
        select BT_AUDIO_CODEC_SUPPORT
        select BT_AUDIO_CODEC_SBC_SUPPORT
        select BT_AUDIO_CODEC_CVSD_SUPPORT
        select BT_PROFILE_A2DP_SUPPORT
        select BT_PROFILE_AVRCP_SUPPORT
        select BT_PROFILE_HFP_SUPPORT
        select BT_PROFILE_PBAP_SUPPORT
        select BT_PROFILE_SPP_SUPPORT
        select BT_PROFILE_SDP_SUPPORT

    config BT_A2DP_SCATTERNET_MENU
        bool
        select BT_A2DP_SCATTERNET
        select BT_APP_AUDIO_DATA_SUPPORT
        select BT_AUDIO_CODEC_SUPPORT
        select BT_AUDIO_CODEC_SBC_SUPPORT
        select BT_PROFILE_A2DP_SUPPORT
        select BT_PROFILE_AVRCP_SUPPORT
        select BT_PROFILE_SDP_SUPPORT

    config BT_A2DP_PBP_MENU
        bool
        select BT_A2DP_PBP
        select BT_LE_AUDIO_SUPPORT
        select BT_AUDIO_CODEC_SUPPORT
        select BT_AUDIO_CODEC_LC3_SUPPORT
        select BT_AUDIO_CODEC_SBC_SUPPORT
        select BT_PROFILE_A2DP_SUPPORT
        select BT_PROFILE_AVRCP_SUPPORT
        select BT_PROFILE_SDP_SUPPORT

    config BT_A2DP_HFP_PBP_MENU
        bool
        select BT_A2DP_HFP_PBP
        select BT_LE_AUDIO_SUPPORT
        select BT_APP_AUDIO_DATA_SUPPORT
        select BT_AUDIO_CODEC_SUPPORT
        select BT_AUDIO_CODEC_LC3_SUPPORT
        select BT_AUDIO_CODEC_SBC_SUPPORT
        select BT_AUDIO_CODEC_CVSD_SUPPORT
        select BT_PROFILE_A2DP_SUPPORT
        select BT_PROFILE_AVRCP_SUPPORT
        select BT_PROFILE_HFP_SUPPORT
        select BT_PROFILE_PBAP_SUPPORT
        select BT_PROFILE_SDP_SUPPORT

    config BT_A2DP_HFP_PBP_PERIPHERAL_MENU
        bool
        select BT_A2DP_HFP_PBP_PERIPHERAL
        select BT_LE_AUDIO_SUPPORT
        select BT_APP_AUDIO_DATA_SUPPORT
        select BT_AUDIO_CODEC_SUPPORT
        select BT_AUDIO_CODEC_LC3_SUPPORT
        select BT_AUDIO_CODEC_SBC_SUPPORT
        select BT_AUDIO_CODEC_CVSD_SUPPORT
        select BT_PROFILE_A2DP_SUPPORT
        select BT_PROFILE_AVRCP_SUPPORT
        select BT_PROFILE_HFP_SUPPORT
        select BT_PROFILE_PBAP_SUPPORT
        select BT_PROFILE_SDP_SUPPORT

    config BT_A2DP_TMAP_MENU
        bool
        select BT_A2DP_TMAP
        select BT_TMAP_SUPPORT
        select BT_LE_AUDIO_SUPPORT
        select BT_AUDIO_CODEC_SUPPORT
        select BT_AUDIO_CODEC_LC3_SUPPORT
        select BT_AUDIO_CODEC_SBC_SUPPORT
        select BT_PROFILE_A2DP_SUPPORT
        select BT_PROFILE_AVRCP_SUPPORT
        select BT_PROFILE_SDP_SUPPORT
endif

# Only select item needs following
config BT_MESH_PROVISIONER
    bool
config BT_MESH_DEVICE
    bool
config BT_MESH_PROVISIONER_SCATTERNET
    bool
config BT_MESH_DEVICE_SCATTERNET
    bool
config BT_MESH_PROVISIONER_TEST
    bool
config BT_MESH_DEVICE_TEST
    bool
config BT_ISO_TEST
    bool
config BT_LE_AUDIO_GENERIC_DEMO
    bool
config BT_PBP
    bool
config BT_TMAP
    bool
config BT_GMAP
    bool
config BT_LE_AUDIO_GENERIC_DEMO_PERIPHERAL
    bool
config BT_A2DP
    bool
config BT_HFP
    bool
config BT_A2DP_HFP
    bool
config BT_SPP
    bool
config BT_RFC
    bool
config BT_AUDIO_MP_TEST
    bool
config BT_A2DP_SCATTERNET
    bool
config BT_A2DP_PBP
    bool
config BT_A2DP_HFP_PBP
    bool
config BT_A2DP_HFP_PBP_PERIPHERAL
    bool
config BT_A2DP_TMAP
    bool
config BT_MESH_PROVISIONER_SUPPORT
    bool
config BT_MESH_DEVICE_SUPPORT
    bool
config BT_ISO_SUPPORT
    bool
config BT_LE_AUDIO_SUPPORT
    bool
config BT_TMAP_SUPPORT
    bool
config BT_GMAP_SUPPORT
    bool
config BT_APP_AUDIO_DATA_SUPPORT
    bool
config BT_AUDIO_CODEC_SUPPORT
    bool
config BT_AUDIO_CODEC_LC3_SUPPORT
    bool
config BT_AUDIO_CODEC_SBC_SUPPORT
    bool
config BT_AUDIO_CODEC_CVSD_SUPPORT
    bool
config BT_PROFILE_A2DP_SUPPORT
    bool
config BT_PROFILE_AVRCP_SUPPORT
    bool
config BT_PROFILE_HFP_SUPPORT
    bool
config BT_PROFILE_PBAP_SUPPORT
    bool
config BT_PROFILE_SPP_SUPPORT
    bool
config BT_PROFILE_RFC_SUPPORT
    bool
config BT_PROFILE_SDP_SUPPORT
    bool
```

## component/bluetooth/Kconfig.inic
```kconfig
# set this to 'y' to debug BT inic without WiFi WHC
config BT_INIC_DEBUG
    depends on (!WHC_DEV_MENU) && (!WHC_HOST_MENU)
    bool
    default n

# set this to 'y' to debug BT inic host without WiFi WHC
config BT_INIC_HOST_DEBUG
    depends on !WHC_DEV_MENU && !WHC_HOST_MENU
    bool
    default n

choice
    depends on (WHC_DEV_MENU || BT_INIC_DEBUG || WHC_HOST_MENU || BT_INIC_HOST_DEBUG)
    prompt "HW Interface"
    default BT_INIC_SHARE
    config BT_INIC_SHARE
        depends on (WHC_DEV_MENU || WHC_HOST_MENU)
        bool "Share interface with WiFi"
    config BT_INIC_H4
        bool "UART H4"
    config BT_INIC_H5
        bool "UART H5"
    config BT_INIC_NONE
        bool "Internal"
    config BT_INIC_SPI_D
        depends on (BT_INIC_DEBUG || BT_INIC_HOST_DEBUG)
        bool "SPI"
    config BT_INIC_SDIO_D
        depends on (BT_INIC_DEBUG || BT_INIC_HOST_DEBUG)
        bool "SDIO"
    config BT_INIC_USB_D
        depends on AMEBAGREEN2 && (BT_INIC_DEBUG || BT_INIC_HOST_DEBUG)
        bool "USB"
endchoice

config BT_INIC_SPI
    def_bool (BT_INIC_SHARE && WHC_INTF_SPI) || BT_INIC_SPI_D

config BT_INIC_SDIO
    def_bool (BT_INIC_SHARE && WHC_INTF_SDIO) || BT_INIC_SDIO_D

config BT_INIC_USB
    def_bool (BT_INIC_SHARE && WHC_INTF_USB) || BT_INIC_USB_D

config BT_INIC
    def_bool (WHC_DEV_MENU && !BT_INIC_NONE) || BT_INIC_DEBUG

config BT_INIC_HOST
    def_bool WHC_HOST_MENU || BT_INIC_HOST_DEBUG
```

## component/dynamic_app/Kconfig
```kconfig
menu "Dynamic App Load Config"
    config DYNAMIC_APP_LOAD_EN
        bool "Dynamic App Load Enable"
endmenu
```
