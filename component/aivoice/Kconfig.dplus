## component/soc/amebalite/Kconfig
```kconfig
config TEST_KM4_MENU
    bool "Test code run on km4"

config TEST_KR4_MENU
    bool "Test code run on kr4"

if TEST_KM4_MENU||TEST_KR4_MENU

menu "CONFIG FUNCTION TEST"
    config PER_TEST_MENU
        bool "Enable Peripheral Test"
        select PER_TEST_FOR_KM4 if TEST_KM4_MENU
        select PER_TEST_FOR_KR4 if TEST_KR4_MENU

    config PER_TEST_FOR_KM4
        bool

    config PER_TEST_FOR_KR4
        bool

    if PER_TEST_MENU
        config SYS_VERIFY
            bool "System_Verify_Mode"
        if SYS_VERIFY
            choice
                prompt "System Verify Type"
                config FT
                    bool "FT_Test"
                config EQC
                    bool "EQC_Test"
                config QA
                    bool "QA_Test"
                config OLT
                    bool "OLT_Test"
                config CORNER
                    bool "Corner_Test"
                config SIMULATION
                    bool "IMG_SIM"
            endchoice
        endif
        config WIFI_FW_VERIFY
        bool "WIFI FW Test"
        config DBGPORT_VERIFY
        bool "DBGPORT_Verify_Mode"
        config TIMER_VERIFY
        bool "Timer_Verify_Mode"
        config PRS_VERIFY
        bool "PRS_Verify_Mode"
        config WDG_VERIFY
        bool "WDG_Verify_Mode"
        config TRNG_VERIFY
        bool "TRNG_Verify_Mode"
        config GDMA_VERIFY
        bool "Gdma_Verify_Mode"
        config GPIO_VERIFY
        bool "GPIO_Verify_Mode"
        config PINMUX_VERIFY
        bool "PINMUX_Verify_Mode"
        config ZB_INT_VERIFY
        bool "ZB_INT_Verify_Mode"
        config SPI_COM_VERIFY
        bool "SPI_COM_Verify_Mode"
        config UART_VERIFY
        bool "UART_Verify_Mode"
        config LCDC_VERIFY
        bool "LCDC_Verify_Mode"
        config LEDC_VERIFY
        bool "LEDC_Verify_Mode"
        config I2C_VERIFY
        bool "I2C_Verify_Mode"
        config PMC_VERIFY
        bool "PMC_Verify_Mode"
        config SGPIO_VERIFY
        bool "SGPIO_Verify_Mode"
        config PSRAM_VERIFY
        bool "PSRAM_Verify_Mode"
        config I2S_VERIFY
        bool "I2S_Verify_Mode"
        config AUDIO_VERIFY
        bool "AUDIO_Verify_Mode"
        config SOC_PS_VERIFY
        bool "SOC_PS_Verify_Mode"
        config CRYPTO_VERIFY
        bool "Crypto_Verify_Mode"
        config EFUSE_VERIFY
        bool "EFUSE_Verify_Mode"
        config SPIC_VERIFY
        bool "SPIC_Verify_Mode"
        config FTL_VERIFY
        bool "FTL_Verify_Mode"
        config ADC_VERIFY
        bool "ADC_Verify_Mode"
        config CAPTOUCH_VERIFY
        bool "CapTouch_Verify_Mode"
        config THERMAL_VERIFY
        bool "Thermal_Verify_Mode"
        config RSIP_VERIFY
        bool "RSIP_Verify_Mode"
        config SDIO_DEVICE_VERIFY
        bool "SDIO_DEVICE_Verify_Mode"
        config SDIOH_VERIFY
        bool "SDIO_HOST_Verify_Mode"
        config CHIP_RST_VERIFY
        bool "chip_reset_verify"
        config DBG_TIMER_VERIFY
        bool "debugtimer_verify"
        config DHRYSTONE_TEST
        bool "Dhrystone Test"
        config RTLIB_VERIFY
        bool "RTLIB ROM Test"
        config IPC_VERIFY
        bool "IPC Test"
        config IR_VERIFY
        bool "IR Test"
        config MPU_VERIFY
        bool "MPU Test"
        config CACHE_VERIFY
        bool "CACHE Test"
        config WFE_VERIFY
        bool "WFE Test"
        config DDR_VERIFY
        bool "DDR Test"
        config RSA_VERIFY
        bool "RSA Test"
        config ECDSA_VERIFY
        bool "ECDSA Test"
        config ED25519_VERIFY
        bool "ED25519 Test"
        config LOGUART_VERIFY
        bool "LOGUART Test"
        config MEMSHARE_VERIFY
        bool "Memory Share Test"
        config AF_VERIFY
        bool "AF Test"
        config FLASH_AVL
        bool "Flash_AVL"
        config SOCZB_PTA_VERIFY
        bool "SOCZB_PTA_Verify_Mode"
        config QDEC_VERIFY
        bool "Qdecoder_Verify_Mode"
        config SSL_ROM_TEST
        bool "SSL ROM Test"
        config SBOOT_VERIFY
        bool "SecureBoot Test"

        config WIFI_VERIFY_MENU
            bool "WIFI Test"
            select WIFI_VERIFY if CORE_AS_NP

        if WIFI_VERIFY_MENU
            choice
                prompt "WIFI Verify Type"
                default WIFI_VERIFY_ASIC_MENU
                config WIFI_VERIFY_ASIC_MENU
                    bool "WIFI_ASIC"
                    select WIFI_VERIFY_ASIC if CORE_AS_NP
                config MAC_LBK_MENU
                    bool "WIFI_MAC_LBK"
                    select MAC_LBK if CORE_AS_NP
                config WIFI_VERIFY_PSPHY_MENU
                    bool "WIFI_2MAC_WITH_PSPHY"
                    select WIFI_VERIFY_PSPHY if CORE_AS_NP
                config WIFI_VERIFY_TRUEPHY_MENU
                    bool "WIFI_2MAC_WITH_TUREPHY"
                    select WIFI_VERIFY_TRUEPHY if CORE_AS_NP
            endchoice
        endif
    endif

    config WIFI_VERIFY
        bool
    config WIFI_VERIFY_ASIC
        bool
    config MAC_LBK
        bool
    config WIFI_VERIFY_PSPHY
        bool
    config WIFI_VERIFY_TRUEPHY
        bool
endmenu

menu "CONFIG SECURE TEST"
    config SEC_VERIFY_MENU
        bool "SEC_Verify_Mode"
        select SEC_VERIFY_FOR_KM4 if TEST_KM4_MENU
        select SEC_VERIFY_FOR_KR4 if TEST_KR4_MENU

    config SEC_VERIFY_FOR_KM4
        bool

    config SEC_VERIFY_FOR_KR4
        bool

    if SEC_VERIFY_MENU
        config EFUSE_SEC_VERIFY
            bool "EFUSE Secure Test"
        config GDMA_SEC_VERIFY
            bool "GDMA Secure Test"
        config CRYPTO_SEC_VERIFY
            bool "Crypto Secure Test"
        config WDG_SEC_VERIFY
            bool "WDG Secure Test"
        config TRNG_SEC_VERIFY
            bool "TRNG Secure Test"
        config TIMER_SEC_VERIFY
            bool "TIMER Secure Test"
        config TZ_SEC_VERIFY
            bool "Trustzone Secure Test"
    endif
endmenu

endif
```

## component/soc/amebasmart/Kconfig
```kconfig
config TEST_KM0_MENU
    bool "Test code run on km0"

config TEST_KM4_MENU
    bool "Test code run on km4"

config TEST_CA32_MENU
    bool "Test code run on ca32"

if TEST_KM0_MENU||TEST_KM4_MENU||TEST_CA32_MENU

menu "CONFIG FUNCTION TEST"
    config PER_TEST_MENU
        bool "Enable Peripheral Test"
        select PER_TEST_FOR_KM0  if TEST_KM0_MENU
        select PER_TEST_FOR_KM4  if TEST_KM4_MENU
        select PER_TEST_FOR_CA32 if TEST_CA32_MENU

    config PER_TEST_FOR_KM0
        bool

    config PER_TEST_FOR_KM4
        bool

    config PER_TEST_FOR_CA32
        bool

    if PER_TEST_MENU
        config SYS_VERIFY
            bool "System_Verify_Mode"

        if SYS_VERIFY
            choice
                prompt "System Verify Type"
                config FT
                    bool "FT_Test"
                config EQC
                    bool "EQC_Test"
                config OLT
                    bool "OLT_Test"
                config QA
                    bool "QA_Test"
                config EMC
                    bool "EMC_Test"
                config CORNER
                    bool "Corner_Test"
                config SIMULATION
                    bool "IMG_SIM"
            endchoice
        endif

        config DBGPORT_ENABLE
            bool "DBGPORT_Verify_Mode"
        config TIMER_VERIFY
            bool "Timer_Verify_Mode"
        config WDG_VERIFY
            bool "WDG_Verify_Mode"
        config TRNG_VERIFY
            bool "TRNG_Verify_Mode"
        config GDMA_VERIFY
            bool "Gdma_Verify_Mode"
        config GPIO_VERIFY
            bool "GPIO_Verify_Mode"
        config ZB_INT_VERIFY
            bool "ZB_INT_Verify_Mode"
        config SPI_COM_VERIFY
            bool "SPI_COM_Verify_Mode"
        config UART_VERIFY
            bool "UART_Verify_Mode"
        config LCDC_VERIFY
            bool "LCDC_Verify_Mode"
        config LEDC_VERIFY
            bool "LEDC_Verify_Mode"
        config I2C_VERIFY
            bool "I2C_Verify_Mode"
        config PMC_VERIFY
            bool "PMC_Verify_Mode"
        config EFUSE_VERIFY
            bool "EFUSE_Verify_Mode"
        config SPIC_VERIFY
            bool "SPIC_Verify_Mode"
        config FTL_VERIFY
            bool "FTL_Verify_Mode"
        config RF_Interference_Flash_VERIFY
            bool "RF_Interference_Flash"
        config ADC_VERIFY
            bool "ADC_Verify_Mode"
        config RSIP_VERIFY
            bool "RSIP_Verify_Mode"
        config SDIO_DEVICE_VERIFY
            bool "SDIO_DEVICE_Verify_Mode"
        config SDIOH_VERIFY
            bool "SDIO_HOST_Verify_Mode"
        config CHIP_RST_VERIFY
            bool "chip_reset_verify"
        config DBG_TIMER_VERIFY
            bool "debugtimer_verify"
        config Flash_AVL
            bool "Flash_AVL_Mode"
        config KEYSCAN_VERIFY
            bool "KeyScan_Verify_Mode"
        config CAPTOUCH_VERIFY
            bool "CapTouch_Verify_Mode"
        config THERMAL_VERIFY
            bool "Thermal_Verify_Mode"
        config SGPIO_VERIFY
            bool "SGPIO_Verify_Mode"
        config PSRAM_VERIFY
            bool "PSRAM_Verify_Mode"
        config QDEC_VERIFY
            bool "Qdecoder_Verify_Mode"
        config DDR_VERIFY
            bool "DDR Test"
        config RSA_VERIFY
            bool "RSA Test"
        config ECDSA_VERIFY
            bool "ECDSA Test"
        config ED25519_VERIFY
            bool "ED25519 Test"
        config SPINAND_VERIFY
            bool "SpiNand Test"
        config LOGUART_VERIFY
            bool "LOGUART Test"
        config FLASH_RW_VERIFY
            bool "Flash RW Test"
        config DHRYSTONE_TEST
            bool "Dhrystone Test"
        config VMIN_TEST_FOR_CA32
            bool "Vmin Test"
        config SSL_ROM_TEST
            bool "SSL ROM Test"
        config RTLIB_VERIFY
            bool "RTLIB ROM Test"
        config SBOOT_VERIFY
            bool "SecureBoot Test"
        config IPC_VERIFY
            bool "IPC Test"
        config IR_VERIFY
            bool "IR Test"
        config MPU_VERIFY
            bool "MPU Test"
        config CACHE_VERIFY
            bool "CACHE Test"
        config WFE_VERIFY
            bool "WFE Test"
        config SDH_VERIFY
            bool "SDH_HOST_Verify_Mode"
        config AUDIO_VERIFY
            bool "AUDIO_Verify_Mode"
        config SOC_PS_VERIFY
            bool "SOC_PS_Verify_Mode"
        config CRYPTO_VERIFY
            bool "Crypto_Verify_Mode"
        config MULTI_INT_VERIFY
            bool "Multi-int Test"
        config DIAGPRINTF_VERIFY
            bool "DiagPrintf Test"
        config MEMORY_VERIFY
            bool "MEMORY_Verify_Mode"
        config USB_VERIFY
            bool "USB Test"

        if USB_VERIFY
            config USBD_VERIFY
                depends on USB_DEVICE_EN_MENU || USB_DRD_EN_MENU
                bool "USB Device Verification"

            config USBH_VERIFY
                depends on USB_HOST_EN_MENU || USB_DRD_EN_MENU
                bool "USB Host Verification"
        endif

        config WIFI_VERIFY_MENU
            bool "WIFI Test"
            select WIFI_VERIFY if CORE_AS_NP

        if WIFI_VERIFY_MENU
            choice
                prompt "WIFI Verify Type"
                default WIFI_VERIFY_ASIC_MENU
                config WIFI_VERIFY_ASIC_MENU
                    bool "WIFI_ASIC"
                    select WIFI_VERIFY_ASIC if CORE_AS_NP
                config MAC_LBK_MENU
                    bool "WIFI_MAC_LBK"
                    select MAC_LBK if CORE_AS_NP
                config WIFI_VERIFY_PSPHY_MENU
                    bool "WIFI_2MAC_WITH_PSPHY"
                    select WIFI_VERIFY_PSPHY if CORE_AS_NP
                config WIFI_VERIFY_TRUEPHY_MENU
                    bool "WIFI_2MAC_WITH_TUREPHY"
                    select WIFI_VERIFY_TRUEPHY if CORE_AS_NP
            endchoice
        endif
    endif

    config WIFI_VERIFY
        bool
    config WIFI_VERIFY_ASIC
        bool
    config MAC_LBK
        bool
    config WIFI_VERIFY_PSPHY
        bool
    config WIFI_VERIFY_TRUEPHY
        bool
endmenu # CONFIG PER TEST


menu "CONFIG SECURE TEST"
    config SEC_VERIFY_MENU
        bool "SEC_Verify_Mode"
        select SEC_VERIFY_FOR_KM0  if TEST_KM0_MENU
        select SEC_VERIFY_FOR_KM4  if TEST_KM4_MENU
        select SEC_VERIFY_FOR_CA32 if TEST_CA32_MENU


    config SEC_VERIFY_FOR_KM0
        bool

    config SEC_VERIFY_FOR_KM4
        bool

    config SEC_VERIFY_FOR_CA32
        bool

    if SEC_VERIFY_MENU
        config CACHE_SEC_VERIFY
            bool "CACHE Secure Test"
        config EFUSE_SEC_VERIFY
            bool "EFUSE Secure Test"
        config GDMA_SEC_VERIFY
            bool "GDMA Secure Test"
        config AES_SEC_VERIFY
            bool "AES Secure Test"
        config CRYPTO_SEC_VERIFY
            bool "Crypto Secure Test"
        config CRC_SEC_VERIFY
            bool "CRC Secure Test"
        config RDP_SEC_VERIFY
            bool "RDP Secure Test"
        config WDG_SEC_VERIFY
            bool "WDG Secure Test"
        config TRNG_SEC_VERIFY
            bool "TRNG Secure Test"
        config TIMER_SEC_VERIFY
            bool "TIMER Secure Test"
        config LCDC_SEC_VERIFY
            bool "LCDC Secure Test"
        config UART_SEC_VERIFY
            bool "UART_Secure_TEST"
        config SPI_SEC_VERIFY
            bool "SPI_Secure_TEST"
        config I2C_SEC_VERIFY
            bool "I2C_Secure_TEST"
        config EDDSA_SEC_VERIFY
            bool "EDDSA Secure Test"
        config ECDSA_SEC_VERIFY
            bool "ECDSA Secure Test"
        config RSA_SEC_VERIFY
            bool "RSA Secure Test"
        config LEDC_SEC_VERIFY
            bool "LEDC Secure Test"
        config IRDA_SEC_VERIFY
            bool "IRDA Secure Test"
        config TZ_SEC_VERIFY
            bool "Trustzone Secure Test"
        config AUDIO_SEC_VERIFY
            bool "AUDIO Secure Test"
    endif
endmenu

endif
```

## component/soc/common/diagnose/Kconfig
```kconfig
config DIAGNOSE_EN_MENU
    bool "Enable diagnose"
    depends on SUPPORT_ATCMD || WLAN_MENU
    select DIAGNOSE_EN
    default y
config DIAGNOSE_EN
    bool
```

## component/soc/common/libc_wrap/Kconfig
```kconfig
choice
    prompt "Heap Selection"
    default DEFAULT_HEAP5
    config DEFAULT_HEAP5
        bool "Default heap5"
    config TLSF_HEAP
        bool "tlsf heap"
endchoice
```

## component/soc/common/log_forward/Kconfig
```kconfig
config LOG_FWD
    bool
    default y
    help
      When enabled, intercepts all console output via the ROM DiagFunc
      character sink and forwards it to the Linux host over the WHC/SDIO
      command path, allowing log visibility without a UART connection.
```

## component/soc/common/rtk_assert/Kconfig
```kconfig
menu "CONFIG RTK Assert Level"
    choice
        prompt "RTK Assert Level"
        default ASSERTION_COMP
        config ASSERTION_DETAIL
            bool "Assert Detail (print file & line)"
        config ASSERTION_COMP
            bool "Assert Component (print component tag & line)"
        config ASSERTION_DISABLE
            bool "Assert Disable"
    endchoice
endmenu
```
