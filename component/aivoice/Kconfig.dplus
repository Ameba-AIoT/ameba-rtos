## component/os/Kconfig
```kconfig
menu "CONFIG OS"
    config KERNEL
        bool "Enable Kernel"
        default n

    if KERNEL
        choice
            prompt "Kernel Selecte"
            default PLATFORM_FREERTOS
            config PLATFORM_FREERTOS
                bool "FREERTOS"
            config PLATFORM_FREERTOS_ROM  #amebagreen2
                bool "FREERTOS_ROM"
                depends on AMEBAGREEN2
        endchoice
    endif

    if SUPPORT_SMP
        choice
            prompt "CA32 SMP FreeRTOS OS version select"
            default CA32_FREERTOS_V10_2_1_SMP_FOR_CA32
            config CA32_FREERTOS_V10_2_1_SMP_FOR_CA32
                bool "v10.2.1_smp"
            config CA32_FREERTOS_V11_1_0_FOR_CA32
                bool "v11.1.0"
        endchoice
    endif

    # the back trace setting is only valid for KM4 / KR4 core
    config BACK_TRACE_DEPTH_LIMIT
        int "Crash Back Trace Depth Limit"
        default 8
        range 4 16
        help
            This defines the maximum depth of back trace. The value must be at least 4.

    # freertos v11 not support heap protect currently. Other versions all supprot.
    if !CA32_FREERTOS_V11_1_0_FOR_CA32
        config HEAP_PROTECTOR
            bool "Enable Heap Protector"
            default n
            help
                Protect the block header. A heap corruption error will be printed if any of the heap's internal data structures appear overwritten.

        config HEAP_CORRUPTION_DETECT_LITE
            bool "Corruption Detection with Lite Impact"
            default n
            select HEAP_PROTECTOR
            help
                Head and Tail Canary are used to guard the boundary of buffer. More precise: even a single-byte overrun can be detected. Increases the memory usage.

        config HEAP_CORRUPTION_DETECT_COMPREHENSIVE
            bool "Corruption Detection Comperhensive (Increase CPU load)"
            default n
            select HEAP_CORRUPTION_DETECT_LITE
            help
                Checks for uninitialized-access and use-after-free bugs. Huge impact on runtime performance, only enable this mode when debugging.

        if SUPPORT_HEAP_TRACE
            config HEAP_INTEGRITY_CHECK_IN_TASK_SWITCHED_OUT
                bool "Check Heap Integrity in Task Switched Out Hook (Increase CPU load)"
                default n
                select HEAP_PROTECTOR
                help
                    call ulPortCheckHeapIntegrity API in traceTASK_SWITCHED_OUT.
                    Huge impact on runtime performance, only enable this mode when debugging. Especially when HEAP_CORRUPTION_DETECT_COMPREHENSIVE enabled.
                    1. if HEAP_PROTECTOR enabled: head protector, check block header.
                    2. if HEAP_CORRUPTION_DETECT_LITE enabled: boundary protector, check block header, head/tail canary.
                    3. HEAP_CORRUPTION-DELECTCOMPREHENSIVE does not perform heap content checks regardless of whether it is enabled or not.
                        This check is too time-consuming and executing it in the hook will affect the normal scheduling of the system.

            config HEAP_TRACE
                bool "Enable Heap Trace"
                default n
                select HEAP_PROTECTOR
                help
                    Malloc and free calling flow during a period of time. Dump un-freed memory when a task or function has finished(Memory Leak).

            if HEAP_TRACE
                config HEAP_TRACE_MALLOC_FREE_LOG
                    bool "Enable all Malloc / Free Logs"
                    default n
                    help
                        Print out the address and size of the buffer every time malloc/free occurs.
                        Note that this selection will print a large amount of logs.
                        Huge impact on runtime performance.

                config HEAP_TRACE_STACK_DEPTH
                    int "Heap Trace Stack Depth"
                    default 16
                    range 1 BACK_TRACE_DEPTH_LIMIT
                    help
                        This defines the stack depth for heap tracing. It must be less than
                        or equal to the back trace depth limit.

                config HEAP_TRACE_MAX_TASK_NUMBER
                    int "Heap Trace Max Task Number"
                    default 16
                    range 10 9999
                    help
                        This defines the max task count for heap tracing.
            endif
        endif
    endif
    config STANDARD_TICKLESS
        depends on !AMEBASMART && !AMEBALITE && !AMEBAPRO3 && !AMEBAD
        bool "Enable FreeRTOS Standard Tickless Flow"
        default n
        help
            When enabled, AP core will only sleep xExpectedIdleTime after enter tickless.
endmenu
```

## component/ota/Kconfig
```kconfig
menu "CONFIG OTA OPTION"
    config OTA_SWITCH_STRATEGY
        bool "OTA Image Switch Strategy"
        default y
        help
            Select the strategy for choosing which OTA image to boot from.

    if OTA_SWITCH_STRATEGY
        choice
            prompt "Select Strategy"
            default OTA_SWITCH_BY_VERSION

            config OTA_SWITCH_BY_VERSION
                bool "Version Number Based"
                help
                    Always boot from the image with the higher version number.
                    This method preserves both OTA1 and OTA2 for rollback capability.
                    Suitable for production environments requiring version tracking.

            config OTA_SWITCH_BY_VALID_HEADER
                bool "Valid Header Based"
                help
                    Mark the old image as invalid by corrupting its header,
                    forcing the bootloader to use the newly updated image.
                    This method actively invalidates the fallback image.
                    Suitable for longrun test or when rollback is not needed.
        endchoice
    endif

    config UPGRADE_BOOTLOADER
        bool "Enable Bootloader OTA"
    config COMPRESS_OTA_IMG
        bool "Enable Compress APP Image"
endmenu
```

## component/rtk_coex/Kconfig.coex
```kconfig
if WLAN_MENU 
    menu "CONFIG COEX"
        config COEX_MENU
            bool "Enable Coex" if !AMEBA_RLS
            default y if !AMEBAL2
        if COEX_MENU
            config BT_COEXIST
                bool 
                # AP core, Follow different scenario
                default y if (CORE_AS_AP && WHC_INTF_IPC)
                # NP core, Follow WLAN
                default y if (CORE_AS_NP)
            
                select COEXIST_HOST if (CORE_AS_AP && WHC_INTF_IPC)
                select COEXIST_DEV if (CORE_AS_NP)

            config COEXIST_HOST
                bool            
            config COEXIST_DEV
                bool
        endif

        config COEXIST_EXT_MENU
            depends on (COEX_MENU && (!MP_SHRINK))
            bool "Enable Ext Coex Support"
            default n
            select COEX_EXT_CHIP_SUPPORT

        if COEXIST_EXT_MENU
            choice
                prompt "PTA Mode"
                default EXT_PTA_MODE_SIMPLE
                config EXT_PTA_MODE_SIMPLE
                    bool "PTA Mode Simple"
                config EXT_PTA_MODE_MULTIPLE
                    bool "PTA Mode Multiple"
            endchoice

            choice
                prompt "Ext Protocol"
                default EXT_PROTOCOL_WPAN
                config EXT_PROTOCOL_WPAN
                    bool "Ext WPAN"
                config EXT_PROTOCOL_BT
                    bool "Ext BT"
                config EXT_PROTOCOL_BT_WPAN
                    bool "Ext BT&WPAN"
            endchoice

            choice
                prompt "Priority Mode"
                default EXT_PRIORITY_DIRECTIONAL
                config EXT_PRIORITY_DIRECTIONAL
                    bool "Directional"
                config EXT_PRIORITY_STATIC
                    depends on EXT_PTA_MODE_SIMPLE
                    bool "Static"
            endchoice
            choice
                prompt "Request Polar"
                default EXT_REQUEST_POLAR_HIGH
                config EXT_REQUEST_POLAR_HIGH
                    bool "Request Active High"
                config EXT_REQUEST_POLAR_LOW
                    depends on EXT_PTA_MODE_SIMPLE
                    bool "Request Active Low"
            endchoice
            choice
                prompt "Gnt Polar"
                default EXT_GNT_POLAR_LOW
                config EXT_GNT_POLAR_LOW
                    bool "Gnt Active Low"
                config EXT_GNT_POLAR_HIGH
                    depends on EXT_PTA_MODE_SIMPLE
                    bool "Gnt Active High"
            endchoice

            config EXT_PRI_DET_TIME
                int "Priority Det Time"
                range 0 254 
                # 2 for RTL8771H; 0 for Silicon Thread RCP
                default 2 

            config EXT_TRX_DET_TIME
                int "TRX Det Time"
                range 0 254 
                # 8 for RTL8771H; 20 for Silicon Thread RCP
                default 8    

            # PTA PINMUX PIN set
            config EXT_PTA_PIN_REQ
                string "Pin PTA Request"
                default "PA_10" if AMEBASMART
                default "PA_15" if AMEBALITE
                default "PB_0" if AMEBADPLUS
                default "PA_21" if AMEBAGREEN2

            config EXT_PTA_PIN_PRI
                string "Pin PTA Priority"
                default "PA_6" if AMEBASMART
                default "PA_17" if AMEBALITE
                default "PB_2" if AMEBADPLUS
                default "PA_18" if AMEBAGREEN2

            config EXT_PTA_PIN_GNT
                string "Pin PTA Gnt"
                default "PA_9" if AMEBASMART
                default "PA_16" if AMEBALITE
                default "PB_1" if AMEBADPLUS
                default "PA_19" if AMEBAGREEN2

            config COEX_EXT_CHIP_SUPPORT
                bool
        
        endif
    endmenu

endif
```

## component/soc/Kconfig
```kconfig
# RSIP Key Configuration
# Legacy group (single key, 1 group 2 keys): RTL8721Dx, RTL8720E, RTL8710E, RTL8713E, RTL8726E, RTL8730E
# Default group (dual key, 2 groups 4 keys): RTL8721F, RTL8720F

config RSIP_SINGLE_KEY
	bool
	default y if AMEBADPLUS || AMEBALITE || AMEBASMART

# GPIO IRQ table size
config GPIO_IRQ_TABLE_MAX_NUM
	int "GPIO IRQ table maximum number"
	depends on !AMEBADPLUS && !AMEBALITE && !AMEBASMART
	default 4
```
