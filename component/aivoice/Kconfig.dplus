## component/soc/common/trusted-firmware-m/Kconfig
```kconfig
#-------------------------------------------------------------------------------
# Copyright (c) 2022-2023, Arm Limited. All rights reserved.
#
# SPDX-License-Identifier: BSD-3-Clause
#
#-------------------------------------------------------------------------------

mainmenu "TF-M Configuration"

# Load platform Kconfig file if exists
osource "$(PLATFORM_PATH)/Kconfig"
osource "$(TFM_SOURCE_DIR)/config/build_type/Kconfig.$(CMAKE_BUILD_TYPE)"

################################# System options ###############################

rsource "Kconfig.bl"
rsource "secure_fw/spm/Kconfig"
rsource "secure_fw/partitions/Kconfig" # These are partition switches.
rsource "platform/Kconfig"
rsource "Kconfig.misc"

################################# Test options #################################

menu "TF-M tests"
rsource "lib/ext/tf-m-tests/Kconfig"
rsource "lib/ext/psa_arch_tests/Kconfig"
endmenu

################################# Component ####################################

# These configs in this menu are local to a component or externally referenced
# when components are coupled. Usually, such options are located in C header
# file. The Header File Config System has more details about it.

# Other configs above which are not in component menu are TF-M build options to
# select which file or component to include into compilation. These are options,
# usually used by a build system to enable/disable modules, specify location of
# external dependency or other selection, global to a project. These options
# shall be considered while adopting TF-M to other build systems.

menu "TF-M component configs"

# Load configurations set by PSA arch test
if TEST_PSA_API != ""
    rsource "$(TFM_SOURCE_DIR)/config/tests/Kconfig.test_psa_api"
endif

rsource "secure_fw/spm/Kconfig.comp"

menu "Secure Partitions component configs"
    rsource "secure_fw/partitions/*/Kconfig.comp"
endmenu
endmenu
```

## component/soc/common/trusted-firmware-m/Kconfig.bl
```kconfig
#-------------------------------------------------------------------------------
# Copyright (c) 2023, Arm Limited. All rights reserved.
#
# SPDX-License-Identifier: BSD-3-Clause
#
#-------------------------------------------------------------------------------

rsource "bl1/Kconfig"
rsource "bl2/ext/mcuboot/Kconfig"

menu "BL options"

config CONFIG_TFM_BOOT_STORE_MEASUREMENTS
    bool "Store measurement values from all the boot stages"
    default y
    help
       Used for initial attestation token.

config CONFIG_TFM_BOOT_STORE_ENCODED_MEASUREMENTS
    bool "Enable storing of encoded measurements in boot"
    default y

config MCUBOOT_DATA_SHARING
    bool
    default y if TFM_PARTITION_FIRMWARE_UPDATE || \
                 (BL2 && CONFIG_TFM_BOOT_STORE_MEASUREMENTS && \
                  !CONFIG_TFM_BOOT_STORE_ENCODED_MEASUREMENTS)
    default n
    help
      Add sharing of application specific data using the same shared data area
      as for the measured boot
endmenu
```
