## component/lwip/Kconfig
```kconfig
menu "CONFIG LWIP"
    config FAST_DHCP_MENU
        bool "Enable Fast DHCP"
        select FAST_DHCP if WHC_HOST || WHC_NONE

    config RNAT_MENU
        bool "Enable R-NAT"
        select RNAT if WHC_HOST || WHC_NONE

    config LWIP_IPV6_MENU
        bool "Enable LWIP IPV6"
        select LWIP_IPV6 if WHC_HOST || WHC_NONE

    config LWIP_SKIP_CHECK_UDP_CHECKSUM
        bool "Skip check UDP checksum"
        help
            Skip checksum for UDP RX packet
            Skipping it will provide higher throughput but reduce reliability.

    config USB_ETHERNET_PROVIDER
        bool
    config USB_ETHERNET_BRIDGE_PROVIDER
        bool

    config LWIP_USB_ETHERNET_MENU
        bool "Enable LWIP USB ETHERNET"
        depends on USB_ETHERNET_PROVIDER
        default y
        select LWIP_USB_ETHERNET if WHC_HOST || WHC_NONE

    config LWIP_USB_ETHERNET_BRIDGE_MENU
        bool "Enable LWIP USB ETHERNET BRIDGE"
        depends on USB_ETHERNET_BRIDGE_PROVIDER
        default y
        select LWIP_USB_ETHERNET_BRIDGE if WHC_HOST || WHC_NONE

    config LWIP_USB_ETHERNET
        bool

    config LWIP_USB_ETHERNET_BRIDGE
        bool

    config LWIP_ETHERNET
        depends on ETHERNET
        bool "Enable LWIP ETHERNET"

    config FAST_DHCP
        bool
    config RNAT
        bool
    config LWIP_IPV6
        bool

    config LWIP_DEBUG
        bool "Enable LWIP Debug"
        default n

    config LWIP_STATS
        bool "Enable LWIP Stats"
        default n

    if LWIP_DEBUG
        config ETHARP_DEBUG
            bool "Enable ETHARP DEBUG"
        config NETIF_DEBUG
            bool "Enable NETIF DEBUG"
        config PBUF_DEBUG
            bool "Enable PBUF DEBUG"
        config API_LIB_DEBUG
            bool "Enable API LIB DEBUG"
        config API_MSG_DEBUG
            bool "Enable API MSG DEBUG"
        config SOCKETS_DEBUG
            bool "Enable SOCKETS DEBUG"
        config ICMP_DEBUG
            bool "Enable ICMP DEBUG"
        config IPNAT_DEBUG
            bool "Enable IPNAT DEBUG"
        config IGMP_DEBUG
            bool "Enable IGMP DEBUG"
        config INET_DEBUG
            bool "Enable INET DEBUG"
        config IP_DEBUG
            bool "Enable IP DEBUG"
        config IP_REASS_DEBUG
            bool "Enable IP REASS DEBUG"
        config RAW_DEBUG
            bool "Enable RAW DEBUG"
        config MEM_DEBUG
            bool "Enable MEM DEBUG"
        config MEMP_DEBUG
            bool "Enable MEMP DEBUG"
        config SYS_DEBUG
            bool "Enable SYS DEBUG"
        config TIMERS_DEBUG
            bool "Enable TIMERS DEBUG"
        config TCP_DEBUG
            bool "Enable TCP DEBUG"
        config TCP_INPUT_DEBUG
            bool "Enable TCP INPUT DEBUG"
        config TCP_FR_DEBUG
            bool "Enable TCP FR DEBUG"
        config TCP_RTO_DEBUG
            bool "Enable TCP RTO DEBUG"
        config TCP_CWND_DEBUG
            bool "Enable TCP CWND DEBUG"
        config TCP_WND_DEBUG
            bool "Enable TCP WND DEBUG"
        config TCP_OUTPUT_DEBUG
            bool "Enable TCP OUTPUT DEBUG"
        config TCP_RST_DEBUG
            bool "Enable TCP RST DEBUG"
        config TCP_QLEN_DEBUG
            bool "Enable TCP QLEN DEBUG"
        config UDP_DEBUG
            bool "Enable UDP DEBUG"
        config TCPIP_DEBUG
            bool "Enable TCPIP DEBUG"
        config SLIP_DEBUG
            bool "Enable SLIP DEBUG"
        config DHCP_DEBUG
            bool "Enable DHCP DEBUG"
        config AUTOIP_DEBUG
            bool "Enable AUTOIP DEBUG"
        config DNS_DEBUG
            bool "Enable DNS DEBUG"
        config IP6_DEBUG
            bool "Enable IP6 DEBUG"
        config DHCP6_DEBUG
            bool "Enable DHCP6 DEBUG"
    endif

    config PBUF_POOL_BUFSIZE
        int "Len of pbuf pool"
        default 508
        range 508 1536

    config LWIP_MAX_SOCKETS
        int "Maximum number of sockets"
        default 20
        range 1 253
        help
            Upper limit of lwIP netconns (MEMP_NUM_NETCONN), i.e. how many
            sockets can exist at the same time.
            The socket table is statically allocated, so each extra socket
            adds to the RAM usage fixed at build time.
            UDP and TCP sockets are also bounded by LWIP_MAX_UDP_PCBS and
            LWIP_MAX_ACTIVE_TCP, raise them together with this option.
            Adjusting it is not recommended. If it must be changed, do not
            use the MQTT and WebSocket functionalities.

    config LWIP_MAX_UDP_PCBS
        int "Maximum number of UDP PCBs"
        default 16
        range 1 1024
        help
            Upper limit of UDP protocol control blocks (MEMP_NUM_UDP_PCB).
            Each UDP socket uses one. The blocks are allocated from the heap
            on demand, so the limit is also bounded by the free heap.

    config LWIP_MAX_ACTIVE_TCP
        int "Maximum number of active TCP PCBs"
        default 16
        range 1 1024
        help
            Upper limit of TCP protocol control blocks in use by
            connections (MEMP_NUM_TCP_PCB). The blocks are allocated from
            the heap on demand, so raising the limit alone does not increase
            RAM usage, it only allows more connections to be opened.

    config LWIP_MAX_LISTENING_TCP
        int "Maximum number of listening TCP PCBs"
        default 16
        range 1 1024
        help
            Upper limit of TCP control blocks in listen state
            (MEMP_NUM_TCP_PCB_LISTEN), i.e. how many server sockets can
            listen at the same time. The blocks are allocated from the heap
            on demand.

    config LWIP_TCP_SACK_OUT
        bool "Send TCP selective acknowledgements"
        default n
        help
            Report out-of-order data to the peer with SACK options
            (LWIP_TCP_SACK_OUT), so that only the missing segments need to
            be retransmitted. It relies on out-of-order queueing
            (TCP_QUEUE_OOSEQ), which is enabled by default in lwIP.

endmenu
```

## component/soc/RTL8720F/project/project_km55ns/Kconfig
```kconfig
comment "----------CPU config----------"

menu "CONFIG Chip Arch"
    # Adding the suffix _FOR_KM55NS is not allowed here
endmenu

menu "CONFIG CHIP"
    choice
        prompt "ArmCore"
        default ARM_CORE_CM4_KM4NS_FOR_KM55NS
        config ARM_CORE_CM4_KM4NS_FOR_KM55NS
            bool "ARM_CM4_KM4NS (KM55NS)"
            help
              KM55 is compatible with the previous KM4 core, so the KM4 core macro
              CONFIG_ARM_CORE_CM4_KM4NS is still used here.
    endchoice

    config ARM_CORE_CM4_FOR_KM55NS
        bool
        default y

    choice
        prompt "Chip Version"
        default RTL8720F_A_CUT_FOR_KM55NS
        config RTL8720F_A_CUT_FOR_KM55NS
            bool "RTL8720F_A_Cut"
    endchoice
endmenu
```

## component/soc/RTL8720F/project/project_km55tz/Kconfig
```kconfig
comment "----------CPU config----------"

menu "CONFIG CHIP"
    choice
        prompt "ArmCore"
        default ARM_CORE_CM4_KM4TZ_FOR_KM55TZ
        config ARM_CORE_CM4_KM4TZ_FOR_KM55TZ
            bool "ARM_CM4_KM4TZ (KM55TZ)"
            help
              KM55 is compatible with the previous KM4 core, so the KM4 core macro
              CONFIG_ARM_CORE_CM4_KM4TZ is still used here.
    endchoice

    config ARM_CORE_CM4_FOR_KM55TZ
        bool
        default y

    choice
        prompt "Chip Version"
        default RTL8720F_A_CUT_FOR_KM55TZ
        config RTL8720F_A_CUT_FOR_KM55TZ
            bool "RTL8720F_A_Cut"
    endchoice

    config CPU_HAS_FPU_FOR_KM55TZ
        bool
        default y
endmenu
```

## component/soc/common/image3/Kconfig.trustzone
```kconfig
# Common TrustZone Kconfig for Ameba SoCs
# This file provides unified TrustZone configuration across different ICs

menu "CONFIG TrustZone"

config TRUSTZONE
    bool "Enable TrustZone"
config TRUSTZONE_EN
    depends on TRUSTZONE
    bool
    default y

if TRUSTZONE
    config TRUSTZONE_MBEDTLS
        bool "Enable MbedTLS in Image3"
        default n
        help
            Enable MbedTLS library in TrustZone secure image (Image3).
            When enabled, CONFIG_TZ_S_SIZE default will be increased to 128K.

    config IMG3_RSA_CLIENT_SERVICE
        bool "Include RSA client key service in Image3"
        depends on TRUSTZONE_MBEDTLS
        default n
        help
            Compile secure_client_service.c into image3.
            Required only by the rdp_mutual_auth_rsa example (RSA-2048 mTLS client).
            Leave disabled for all other examples to keep image3 smaller.

    config IMG3_ECDSA_CLIENT_SERVICE
        bool "Include ECDSA client key service in Image3"
        depends on TRUSTZONE_MBEDTLS
        default n
        help
            Compile secure_ecdsa_client_service.c into image3.
            Required only by the rdp_mutual_auth_ecdsa example (ECDSA P-256 mTLS client).
            Leave disabled for all other examples to keep image3 smaller.
endif

endmenu
```

## component/soc/usrcfg/amebagreen2/Kconfig
```kconfig
menu "Clock Configuration"

choice
    prompt "SoC Clock Config"
    default CLKCFG_1P0_AUDIO98P304M_USB if WHC_INTF_USB
    default CLKCFG_0P9_RMII
    help
        Select the SoC clock configuration. The leading [N] is the index into
        SocClk_Info[] in ameba_bootcfg.c (assigned to Boot_SocClk_Info_Idx via
        CONFIG_CLKCFG_IDX).

config CLKCFG_0P9_NO_SYSPLL
    bool "[0] 0.9V, no SysPLL, CPU 240MHz (low power)"
    depends on !WHC_INTF_USB

config CLKCFG_0P9_RMII
    bool "[1] 0.9V, RMII, CPU 240MHz"
    depends on !WHC_INTF_USB

config CLKCFG_1P0_AUDIO98P304M_USB
    bool "[2] 1.0V, Audio(98.304MHz)/USB, CPU 240MHz"

config CLKCFG_1P0_AUDIO45P1584M_USB
    bool "[3] 1.0V, Audio(45.1584MHz)/USB, CPU 240MHz"

config CLKCFG_0P9_AUDIO_RMII
    bool "[4] 0.9V, Audio/RMII, CPU 266.7MHz"
    depends on !WHC_INTF_USB

config CLKCFG_1P0_RMII_USB
    bool "[5] 1.0V, RMII/USB, CPU 320MHz"

config CLKCFG_1P0_AUDIO_USB
    bool "[6] 1.0V, Audio/USB, CPU 320MHz"

config CLKCFG_1P0_AUDIO_RMII
    bool "[7] 1.0V, Audio/RMII, CPU 333.3MHz"

endchoice

config CLKCFG_IDX
    int
    default 0 if CLKCFG_0P9_NO_SYSPLL
    default 1 if CLKCFG_0P9_RMII
    default 2 if CLKCFG_1P0_AUDIO98P304M_USB
    default 3 if CLKCFG_1P0_AUDIO45P1584M_USB
    default 4 if CLKCFG_0P9_AUDIO_RMII
    default 5 if CLKCFG_1P0_RMII_USB
    default 6 if CLKCFG_1P0_AUDIO_USB
    default 7 if CLKCFG_1P0_AUDIO_RMII
    default 1

endmenu

menu "GPIO IRQ Configuration"

# GPIO IRQ table size
config GPIO_IRQ_TABLE_MAX_NUM
	int "GPIO IRQ table maximum number"
	range 1 94
	default 4

endmenu
```
