## component/usb/device/Kconfig
```kconfig
comment "USB Device Global Settings"

config USBD_COMPOSITE_MENU
    bool "Composite function enable"
    select USBD_COMPOSITE if WHC_HOST || WHC_NONE
    help
      Composite Device — combine multiple class functions into one USB device.
      Select one or more class options below to build together.

comment "USB Device Class Selection"

config USBD_CDC_ACM_MENU
    bool "CDC ACM"
    select USBD_CDC_ACM if WHC_HOST || WHC_NONE

config USBD_CDC_ECM_MENU
    bool "CDC ECM"
    select USBD_CDC_ECM if WHC_HOST || WHC_NONE
    select USB_ETHERNET_PROVIDER

config USBD_CDC_NCM_MENU
    bool "CDC NCM"
    select USBD_CDC_NCM if WHC_HOST || WHC_NONE
    select USB_ETHERNET_PROVIDER

    if USBD_CDC_NCM_MENU
        config USBD_CDC_NCM_TX_AGGREGATION
            bool "Enable NCM TX aggregation"
            default n
    endif

config USBD_HID_MENU
    bool "HID"
    select USBD_HID if WHC_HOST || WHC_NONE
    if USBD_HID_MENU
        choice
            prompt "Select HID device type"
            default USBD_HID_MOUSE
            config USBD_HID_MOUSE
                bool "Mouse"
            config USBD_HID_KEYBOARD
                bool "Keyboard"
            config USBD_HID_VENDOR
                bool "Vendor"
                depends on USBD_COMPOSITE_MENU
        endchoice
    endif

config USBD_WHC_MENU
    bool "WHC"
    depends on SUPPORT_USBD_WHC
    select USBD_WHC if WHC_HOST || WHC_NONE

config USBD_MSC_MENU
    bool "MSC"
    select USBD_MSC if WHC_HOST || WHC_NONE
    if USBD_MSC_MENU
        choice
            prompt "Select storage media"
            default USBD_MSC_SD_CARD
            config USBD_MSC_FLASH
                bool "FLASH (on-chip)"
                depends on VFS_MENU
                select VFS_FATFS_INCLUDED if WHC_HOST || WHC_NONE
            config USBD_MSC_SECOND_FLASH
                bool "Second FLASH (NOR)"
                depends on VFS_MENU
                select VFS_FATFS_INCLUDED if WHC_HOST || WHC_NONE
                select VFS_SECOND_FLASH if WHC_HOST || WHC_NONE
                help
                  Needs a NOR second flash: keep "Second flash is external SPI NAND"
                  unchecked under CONFIG File System. A NAND selection fails the build.
            config USBD_MSC_SD_CARD
                bool "SD card, SDIO mode"
                depends on SUPPORT_SDIOH && VFS_MENU
                select VFS_FATFS_INCLUDED if WHC_HOST || WHC_NONE
                select VFS_SD_CARD if WHC_HOST || WHC_NONE
            config USBD_MSC_SD_SPI
                bool "SD card, SPI mode"
                depends on VFS_MENU
                select VFS_FATFS_INCLUDED if WHC_HOST || WHC_NONE
                select VFS_SD_SPI if WHC_HOST || WHC_NONE
            config USBD_MSC_RAM
                bool "RAM disk"
                depends on VFS_MENU
                select VFS_FATFS_INCLUDED if WHC_HOST || WHC_NONE
                select VFS_RAM if WHC_HOST || WHC_NONE
        endchoice
    endif

config USBD_UAC_MENU
    bool "UAC"
    depends on SUPPORT_USBD_UAC
    select USBD_UAC if WHC_HOST || WHC_NONE
    select AUDIO_FWK_MENU if SUPPORT_AUDIO_FOR_USB
    choice
        prompt "Select UAC Version"
        depends on USBD_UAC_MENU
        config USBD_UAC1_MENU
            bool "UAC 1.0"
            select USBD_UAC1 if WHC_HOST || WHC_NONE
        config USBD_UAC2_MENU
            bool "UAC 2.0"
            select USBD_UAC2 if WHC_HOST || WHC_NONE
    endchoice

    if USBD_UAC_MENU
        choice
            prompt "Playback max channels"
            default USBD_UAC_OUT_CH_2
            help
              One streaming alt setting is declared per channel count from 2 up to this value.
              The ISOC OUT ring is sized for it, set it to the channels the product can play.
              Full Speed carries 48 kHz only if channels x bytes per sample <= 20.
            config USBD_UAC_OUT_CH_2
                bool "2"
            config USBD_UAC_OUT_CH_4
                bool "4"
            config USBD_UAC_OUT_CH_6
                bool "6"
            config USBD_UAC_OUT_CH_8
                bool "8"
        endchoice

        choice
            prompt "Playback bit width"
            default USBD_UAC_OUT_BIT_16
            help
              Subslot size declared by every playback alt setting. AmebaSmart cannot play 32-bit.
            config USBD_UAC_OUT_BIT_16
                bool "16-bit"
            config USBD_UAC_OUT_BIT_24
                bool "24-bit"
            config USBD_UAC_OUT_BIT_32
                bool "32-bit"
        endchoice

        choice
            prompt "Playback max sampling rate"
            depends on USBD_UAC2_MENU
            default USBD_UAC_OUT_FREQ_48K
            help
              The clock RANGE lists 44.1 kHz up to this rate. A Full-Speed connection of an HS-capable
              SoC declares only the rates that fit Full Speed. The ring grows with the rate, e.g.
              about 4.5 KB at 2ch/16-bit/48 kHz and 16 KB at 192 kHz on High Speed.
            config USBD_UAC_OUT_FREQ_48K
                bool "48 kHz"
            config USBD_UAC_OUT_FREQ_96K
                bool "96 kHz"
            config USBD_UAC_OUT_FREQ_192K
                bool "192 kHz"
        endchoice
    endif

config USBD_VENDOR_MENU
    bool "VENDOR"
    select USBD_VENDOR if WHC_HOST || WHC_NONE

config USBD_DFU_MENU
    bool "DFU"
    select USBD_DFU if WHC_HOST || WHC_NONE
    if USBD_DFU_MENU
        config USBD_DFU_WILL_DETACH
            bool "Device generates its own detach after DFU_DETACH"
            default y
            help
              Sets bmAttributes bit 3 (bitWillDetach, Ref DFU 1.1 4.1.3).
              Y: the device toggles its own D+ pull-up after DFU_DETACH and the host must NOT
              issue a USB Reset; no detach timer is built.
              N: the device waits for the host to issue a USB Reset within wDetachTimeOut; a
              one-shot detach timer reverts to Run-Time mode if the reset never arrives.

        config USBD_DFU_MANIFESTATION_TOLERANT
            bool "Tolerate further operations after manifestation"
            default y
            help
              Sets bmAttributes bit 2 (bitManifestationTolerant, Ref DFU 1.1 4.1.3).
              Y: the device returns to dfuIDLE right after manifest, so the host may continue
              with further operations such as an UPLOAD verify.
              N: the device enters dfuMANIFEST-WAIT-RESET and the host must issue a USB bus
              reset to activate the new firmware.

        config USBD_DFU_CAN_UPLOAD
            bool "Support DFU_UPLOAD"
            default y
            help
              Sets bmAttributes bit 1 (bitCanUpload, Ref DFU 1.1 4.1.3).
              Y: DFU_UPLOAD is accepted and the application shall provide the read callback.
              N: every DFU_UPLOAD is stalled into dfuERROR, saving the upload state and code.
    endif

config USBD_UVC_MENU
    bool "UVC"
    select USBD_UVC if WHC_HOST || WHC_NONE
```

## component/usb/host/Kconfig
```kconfig
config USBH_CDC_ACM_MENU
    bool "CDC ACM"
    select USBH_CDC_ACM if WHC_HOST || WHC_NONE

    if USBH_CDC_ACM_MENU
        config USBH_CDC_ACM_4G_DONGLE_MENU
            bool "4G LTE dongle support"
            default n
            select USBH_CDC_ACM_4G_DONGLE if WHC_HOST || WHC_NONE
    endif

config USBH_CDC_ECM_MENU
    bool "CDC ECM"
    depends on SUPPORT_USBH_ECM || SUPPORT_USBH_ECM_BRIDGE
    select USBH_CDC_ECM if WHC_HOST || WHC_NONE

    if USBH_CDC_ECM_MENU
        choice
            prompt "Select USB Ethernet"
            default USBH_ECM_ETHERNET_MENU
            config  USBH_ECM_ETHERNET_MENU
                bool "USB Ethernet"
                depends on SUPPORT_USBH_ECM
                select USB_ETHERNET_PROVIDER
                select USBH_ECM_ETHERNET if WHC_HOST || WHC_NONE
            config  USBH_ECM_ETHERNET_BRIDGE_MENU
                bool "USB Ethernet Bridge"
                depends on SUPPORT_USBH_ECM_BRIDGE
                select USB_ETHERNET_PROVIDER
                select USB_ETHERNET_BRIDGE_PROVIDER
                select USBH_ECM_ETHERNET_BRIDGE if WHC_HOST || WHC_NONE
        endchoice
    endif

config USBH_CDC_NCM_MENU
    bool "CDC NCM"
    select USB_ETHERNET_PROVIDER
    select USBH_CDC_NCM if WHC_HOST || WHC_NONE

    if USBH_CDC_NCM_MENU
        config USBH_CDC_NCM_TX_AGGREGATION
            bool "Enable NCM TX datagram aggregation"
            default n
    endif

config USBH_MSC_MENU
    bool "MSC"
    select USBH_MSC if WHC_HOST || WHC_NONE
    select VFS_FATFS_INCLUDED if WHC_HOST || WHC_NONE

config USBH_UAC_MENU
    bool "UAC"
    select USB_UAC  if WHC_HOST || WHC_NONE
    select USBH_UAC  if WHC_HOST || WHC_NONE
    select AUDIO_FWK_MENU if SUPPORT_AUDIO_FOR_USB

config USBH_HID_MENU
    bool "HID"
    select USBH_HID if WHC_HOST || WHC_NONE

config USBH_UVC_MENU
    bool "UVC"
    select USBH_UVC if WHC_HOST || WHC_NONE

config USBH_VENDOR_MENU
    bool "VENDOR"
    select USBH_VENDOR if WHC_HOST || WHC_NONE

config USBH_DFU_MENU
    bool "DFU"
    select USBH_DFU if WHC_HOST || WHC_NONE
```

## component/wifi/whc/whc_host_linux/Kconfig
```kconfig
# SPDX-License-Identifier: GPL-2.0
# NOTE: no 'mainmenu' here on purpose — this file must be both usable standalone
# (out-of-tree host: kconfiglib menuconfig) and 'source'-able into a kernel/SDK
# Kconfig tree (IPC host). A sourced Kconfig must not declare a mainmenu.

config WIFI_RTK_CFG80211_FULLMAC
	tristate "Fullmac for wifi driver"
	select CFG80211_DEFAULT_PS
	select CFG80211_CRDA_SUPPORT
	select CFG80211_WEXT
	select WLAN_VENDOR_INTEL

	help
	  Realtek wifi driver.
	  802.11 a/b/g/n/ac/ax AXI wireless network adapter

menu "WHC host options"

choice
	prompt "Host controller interface (HCI)"
	default WHC_HCI_IPC
	help
	  How this host talks to the Realtek device. IPC is the same-chip
	  (in kernel-tree) path; SDIO/SPI/USB are external out-of-tree hosts.

config WHC_HCI_IPC
	bool "IPC"

config WHC_HCI_SDIO
	bool "SDIO"

config WHC_HCI_SPI
	bool "SPI"

config WHC_HCI_USB
	bool "USB"

endchoice

choice
	prompt "Target IC"
	depends on !WHC_HCI_IPC
	default AMEBADPLUS
	help
	  The Realtek device this host is paired with. Availability depends
	  on the selected interface.

config AMEBADPLUS
	bool "AmebaDplus (RTL8721Dx)"

config AMEBAGREEN2
	bool "AmebaGreen2"

config AMEBALITE
	bool "AmebaLite"
	depends on WHC_HCI_SPI

config AMEBAX
	bool "AmebaX (RTL8720F)"
	depends on WHC_HCI_SDIO || WHC_HCI_SPI

endchoice

config WHC_WIFI_API_PATH
	bool "WPAoH host with cfg80211 (WIFI API path)"
	default y
	help
	  y: WPAoH host, supplicant runs on the host with cfg80211.
	  n: WPAoD host, supplicant runs on the device (no cfg80211).

config WHC_CMD_PATH
	bool "WHC command path"
	default y

config FW_DOWNLOAD
	bool "Firmware download over the host interface"
	depends on (WHC_HCI_SDIO && (AMEBAGREEN2 || AMEBAX)) || (WHC_HCI_USB && AMEBAGREEN2)
	help
	  Download device firmware from the host over the data interface.
	  Only supported on AmebaGreen2/AmebaX (SDIO) and AmebaGreen2 (USB).

comment "Features"

config NAN
	bool "NAN (Wi-Fi Aware)"

config P2P
	bool "Wi-Fi Direct (P2P)"

config MCC
	bool "Multi-channel concurrency (MCC)"

config BT_INIC
	bool "Bluetooth over the host interface"
	depends on !WHC_HCI_IPC
	help
	  Pulls the matching rtb_spi/rtb_sdio/rtb_usb host glue into the build

config IEEE80211R
	bool "802.11r fast BSS transition"
	depends on !WHC_HCI_IPC

config SUPPLICANT_SME
	bool "Supplicant-side SME"

config RMESH
	bool "Realtek mesh (RMESH)"
	depends on !WHC_HCI_IPC

config WHC_HOST_RTW_CLI
	bool "RTW CLI on the host"
	depends on !WHC_HCI_IPC

config WHCH
	bool "WHCH"
	depends on !WHC_HCI_IPC

endmenu
```

## component/wifi/whc/whc_host_linux/configs/amebadplus_spi_wpaod_defconfig
```kconfig
CONFIG_WHC_HCI_SPI=y
CONFIG_AMEBADPLUS=y
CONFIG_WHC_CMD_PATH=y
# CONFIG_WHC_WIFI_API_PATH is not set
```

## component/wifi/whc/whc_host_linux/configs/amebagreen2_gspi_wpaoh_fwdl_defconfig
```kconfig
CONFIG_WHC_HCI_GSPI=y
CONFIG_AMEBAGREEN2=y
CONFIG_WHC_CMD_PATH=y
CONFIG_WHC_WIFI_API_PATH=y
CONFIG_FW_DOWNLOAD=y
```

## component/wifi/whc/whc_host_linux/configs/amebagreen2_sdio_wpaod_fwdl_defconfig
```kconfig
CONFIG_WHC_HCI_SDIO=y
CONFIG_AMEBAGREEN2=y
CONFIG_WHC_CMD_PATH=y
CONFIG_FW_DOWNLOAD=y
CONFIG_WHC_HOST_RTW_CLI=y
```

## component/wifi/whc/whc_host_linux/configs/amebagreen2_sdio_wpaoh_defconfig
```kconfig
CONFIG_WHC_HCI_SDIO=y
CONFIG_AMEBAGREEN2=y
CONFIG_WHC_CMD_PATH=y
CONFIG_WHC_WIFI_API_PATH=y
```

## component/wifi/whc/whc_host_linux/configs/amebagreen2_usb_wpaoh_fwdl_defconfig
```kconfig
CONFIG_WHC_HCI_USB=y
CONFIG_AMEBAGREEN2=y
CONFIG_WHC_CMD_PATH=y
CONFIG_WHC_WIFI_API_PATH=y
CONFIG_FW_DOWNLOAD=y
```

## component/wifi/whc/whc_host_linux/configs/amebax_spi_wpaoh_defconfig
```kconfig
CONFIG_WHC_HCI_SPI=y
CONFIG_AMEBAX=y
CONFIG_WHC_CMD_PATH=y
CONFIG_WHC_WIFI_API_PATH=y
```
