## amebadplus_gcc_project/menuconfig/config.in
```kconfig
# ATTENTION:
# Brief explaination:
#
# 1. "make menuconfig" will see this file.
# 2. make menuconfig save file will produce "/.config" and "/autoconf.h" two files.
# 3. makefile will see the "/.config" file
# 4. C code will see the "/autoconf.h"
#
# in this file, declare variable xxx, please add the prefix "CONFIG_" word.  Example: "CONFIG_XXX"


#===========================================================================
mainmenu_name 'RTL Bootcode Configuration'

separator "GeneralStart"

comment '--------------General config------------'

mainmenu_option next_comment
comment '< CONFIG TrustZone'
bool "Enable TrustZone"			CONFIG_TRUSTZONE_FOR_KM4
if [ "$CONFIG_TRUSTZONE_FOR_KM4" = "y" ]; then
	choice 'TrustZone by RDP or TFM'		" RDP_BASIC		CONFIG_RDP_BASIC_FOR_KM4 \
											  RDP_TFM		CONFIG_RDP_TFM_FOR_KM4 \
											" RDP_BASIC
	define_bool CONFIG_TRUSTZONE_EN_FOR_KM4 y
	if [ "$CONFIG_RDP_TFM_FOR_KM4" = "y" ]; then
		bool "TFM Test Suite Enable"						CONFIG_TFM_TEST_ENABLE_FOR_KM4
	else
		define_bool CONFIG_TFM_TEST_ENABLE_FOR_KM4			n
	fi
	if [ "$CONFIG_TFM_TEST_ENABLE_FOR_KM4" = "y" ]; then
		choice 'TFM Test Suite Select'	" Regression_Tests	CONFIG_TFM_TEST_REGRESSION_FOR_KM4 \
										  PSA_API_Tests		CONFIG_TFM_TEST_PSA_API_FOR_KM4 \
										"
		if [ "$CONFIG_TFM_TEST_REGRESSION_FOR_KM4" = "y" ]; then
			bool " TFM secure regression tests"				CONFIG_TFM_TEST_S_FOR_KM4
			bool " TFM non-secure regression tests"			CONFIG_TFM_TEST_NS_FOR_KM4
		fi
		if [ "$CONFIG_TFM_TEST_PSA_API_FOR_KM4" = "y" ]; then
			choice 'TEST_PSA_API Select'	" STORAGE				CONFIG_TEST_PSA_API_STORAGE_FOR_KM4 \
											  CRYPTO				CONFIG_TEST_PSA_API_CRYPTO_FOR_KM4 \
											  INITIAL_ATTESTATION	CONFIG_TEST_PSA_API_INITIAL_ATTESTATION_FOR_KM4 \
											"
		fi
	fi
fi
endmenu

mainmenu_option next_comment
comment '< CONFIG Link Option'

choice 'IMG1(Bootloader) running on FLASH or SRAM?'			"FLASH			CONFIG_IMG1_FLASH \
															SRAM			CONFIG_IMG1_SRAM  \
															" FLASH

choice 'IMG2(Application) running on FLASH or PSRAM ?'		"FLASH			CONFIG_IMG2_FLASH \
															PSRAM			CONFIG_IMG2_PSRAM	\
															" FLASH
if [ "$CONFIG_IMG2_FLASH" = "y" ]; then
	bool "PSRAM AS HEAP"				CONFIG_PSRAM_AS_HEAP
fi
if [ "$CONFIG_TRUSTZONE_FOR_KM4" = "y" ]; then
	choice 'IMG3(SecureImage) running on PSRAM or SRAM?'	"PSRAM			CONFIG_IMG3_PSRAM \
															SRAM			CONFIG_IMG3_SRAM	\
															" PSRAM
fi
endmenu

mainmenu_option next_comment
comment '< CONFIG Mass Production'
bool "Enable MP"			CONFIG_MP_INCLUDED
if [ "$CONFIG_MP_INCLUDED" = "y" ]; then
	choice 'MP Mode'	"expand			CONFIG_MP_EXPAND \
						shrink			CONFIG_MP_SHRINK	\
						" shrink
fi
endmenu

mainmenu_option next_comment
comment '< CONFIG Shell CMD'
bool "Enable ATCMD"			CONFIG_SUPPORT_ATCMD
if [ "$CONFIG_SUPPORT_ATCMD" = "y" ]; then
choice 'ATCMD IO Type'	"LOGUART	CONFIG_ATCMD_IO_LOGUART \
						UART		CONFIG_ATCMD_IO_UART \
						"
bool "Enable Longer CMD"	CONFIG_LONGER_CMD
fi
endmenu

mainmenu_option next_comment
comment '< CONFIG VFS'
bool "Enable VFS LITTLEFS"                     CONFIG_VFS_LITTLEFS_INCLUDED
bool "Enable VFS FATFS"                        CONFIG_VFS_FATFS_INCLUDED
if [ "$CONFIG_VFS_FATFS_INCLUDED" = "y" ]; then
choice 'FATFS Memory Type'     "
                                FlASH           FATFS_DISK_FLASH \
                                "
bool "FATFS within APP Image"				CONFIG_FATFS_WITHIN_APP_IMG
fi
endmenu

mainmenu_option next_comment
comment '< CONFIG OTA OPTION'
bool "Upgrade Bootloader"				CONFIG_UPGRADE_BOOTLOADER
bool "Support Compressed APP Image"		CONFIG_COMPRESS_OTA_IMG
endmenu

comment '--------------Network config------------'


mainmenu_option next_comment
comment '< CONFIG WIFI'
bool "Enable Wifi"                CONFIG_WLAN_MENU
if [ "$CONFIG_WLAN_MENU" = "y" ]; then
	choice 'INIC Mode'		"INIC_IPC	CONFIG_KM0_NP_KM4_AP \
								SPI_FULLMAC		CONFIG_SPI_FULLMAC	\
								USB_FULLMAC		CONFIG_USB_FULLMAC	\
								SDIO_FULLMAC		CONFIG_SDIO_FULLMAC	\
								SDIO_BRIDGE		CONFIG_SDIO_BRIDGE_FOR_KM4 \
								"
	if [ "$CONFIG_SDIO_FULLMAC" = "y" -o "$CONFIG_SPI_FULLMAC" = "y" -o "$CONFIG_USB_FULLMAC" = "y" ]; then
		choice 'WIFI Driver Location'	"KM0	CONFIG_KM0_AS_NP \
						KM4	CONFIG_KM4_AS_NP \
						"
	fi
	bool "Enable HIGH TP"	CONFIG_HIGH_TP_TEST
	if [ "$CONFIG_KM0_NP_KM4_AP" = "y" ]; then
		define_bool CONFIG_INIC_INTF_IPC y
		define_bool CONFIG_WLAN_FOR_KM0 y
		define_bool CONFIG_WLAN_FOR_KM4 y
		define_bool CONFIG_AS_INIC_NP_FOR_KM0 y
		define_bool CONFIG_AS_INIC_AP_FOR_KM4 y
		if [ "$CONFIG_MP_SHRINK" = "y" ]; then
			define_bool CONFIG_LWIP_LAYER_FOR_KM4 n
		else
			define_bool CONFIG_LWIP_LAYER_FOR_KM4 y
		fi
		define_bool CONFIG_FW_DRIVER_COEXIST_FOR_KM0 y
	fi
	if [ "$CONFIG_SDIO_FULLMAC" = "y" -o "$CONFIG_SPI_FULLMAC" = "y" -o "$CONFIG_USB_FULLMAC" = "y" ]; then
		if [ "$CONFIG_SDIO_FULLMAC" = "y" ]; then
			define_bool CONFIG_INIC_INTF_SDIO y
		elif [ "$CONFIG_SPI_FULLMAC" = "y" ]; then
			define_bool CONFIG_INIC_INTF_SPI y
		else
			define_bool CONFIG_INIC_INTF_USB y
		fi
		if [ "$CONFIG_KM0_AS_NP" = "y" ]; then
			define_bool CONFIG_WLAN_FOR_KM0 y
			define_bool CONFIG_AS_INIC_NP_FOR_KM0 y
			define_bool CONFIG_FW_DRIVER_COEXIST_FOR_KM0 y
			define_bool CONFIG_WIFI_FW_EN_FOR_KM0 y
		else
			define_bool CONFIG_WLAN_FOR_KM4 y
			define_bool CONFIG_AS_INIC_NP_FOR_KM4 y
			define_bool CONFIG_FW_DRIVER_COEXIST_FOR_KM4 y
			define_bool CONFIG_WIFI_FW_EN_FOR_KM4 y
		fi
	else
		#	KM0 firmware follow WLAN menu
		if [ "$CONFIG_MP_SHRINK" = "y" ]; then
			define_bool CONFIG_WIFI_FW_EN_FOR_KM0 n
		else
			define_bool CONFIG_WIFI_FW_EN_FOR_KM0 y
		fi
	fi

	if [ "$CONFIG_SDIO_BRIDGE_FOR_KM4" = "y" ]; then
		define_bool CONFIG_WLAN_FOR_KM4 y
		define_bool CONFIG_SINGLE_CORE_WIFI_FOR_KM4 y
		define_bool CONFIG_INIC_INTF_SDIO_FOR_KM4 y
		define_bool CONFIG_LWIP_LAYER_FOR_KM4 y
		define_bool CONFIG_FW_DRIVER_COEXIST_FOR_KM0 n
	fi

	if [ "$CONFIG_WIFI_KM4_SINGLE_CORE" = "y" ]; then
		define_bool CONFIG_WLAN_FOR_KM4 y
		define_bool CONFIG_SINGLE_CORE_WIFI_FOR_KM4 y
		define_bool CONFIG_LWIP_LAYER_FOR_KM4 y
		define_bool CONFIG_FW_DRIVER_COEXIST_FOR_KM0 n
	fi
	if [ "$CONFIG_MAC_LBK" = "y" ]; then
		define_bool CONFIG_LWIP_LAYER_FOR_KM4 n
	fi

	if [ "$CONFIG_KM0_NP_KM4_AP" = "y" ]; then
		bool "Enable WPS"		CONFIG_ENABLE_WPS_FOR_KM4
		if [ "$CONFIG_ENABLE_WPS_FOR_KM4" = "y" ]; then
			define_bool CONFIG_ENABLE_WPS_DISCOVERY_FOR_KM4 y
		fi
	fi

	if [ "$CONFIG_WIFI_KM4_SINGLE_CORE" = "y" ]; then
		bool "Enable WPS"		CONFIG_ENABLE_WPS_FOR_KM4
		if [ "$CONFIG_ENABLE_WPS_FOR_KM4" = "y" ]; then
			define_bool CONFIG_ENABLE_WPS_DISCOVERY_FOR_KM4 y
		fi
	fi

	bool "Enable CSI"		CONFIG_WIFI_CSI_ENABLE
	bool "Enable ANTDIV"		CONFIG_WIFI_ANTDIV_ENABLE
	bool "Enable 11K"		CONFIG_WIFI_11K_ENABLE
	bool "Enable 11V"		CONFIG_WIFI_11V_ENABLE
	bool "Enable 11R"		CONFIG_WIFI_11R_ENABLE
	bool "Enable WIFI SPEAKER"		CONFIG_WIFI_SPEAKER_ENABLE
else
	define_bool CONFIG_WLAN n
	define_bool CONFIG_AS_INIC_AP_FOR_KM4 y
	define_bool CONFIG_SINGLE_CORE_WIFI_FOR_KM4 n
	define_bool CONFIG_AS_INIC_NP_FOR_KM0 y
	define_bool CONFIG_LWIP_LAYER n

#	KM0 firmware follow WLAN menu
	define_bool CONFIG_FW_DRIVER_COEXIST_FOR_KM0 n
	define_bool CONFIG_WIFI_FW_EN_FOR_KM0 n
fi
endmenu

mainmenu_option next_comment
comment '< CONFIG BT'
bool "Enable BT"												CONFIG_BT_MENU
# !!Notice that "[ ]" both side and "$CONFIG_XXX" should has a whitespace
if [ "$CONFIG_BT_MENU" = "y" ]; then
	define_bool CONFIG_BT_FOR_KM4 y
	define_bool CONFIG_FTL_ENABLED_FOR_KM4 y
	if [ "$CONFIG_MATTER_EN" = "y" ]; then
		bool "BLE_Matter_Adapter"	CONFIG_BLE_MATTER_ADAPTER
	fi
	if [ "$CONFIG_MP_INCLUDED" = "y" ]; then
		define_bool CONFIG_BT_ENABLE_FAST_MP y
	fi
#	bool "  Enable iNIC"										CONFIG_BT_INIC
	if [ "$CONFIG_BT_INIC" = "y" ]; then
		choice 'Interface'	"Uart_H4							CONFIG_BT_INIC_H4 \
							Uart_H5								CONFIG_BT_INIC_H5 \
							SPI									CONFIG_BT_INIC_SPI \
							" Uart_H4
	else
		bool "BT Advanced Feature"								CONFIG_BT_ADVANCED_FEATURE_MENU
		if [ "$CONFIG_BT_ADVANCED_FEATURE_MENU" = "y" ]; then
			bool "  Exclude BT AT Command"						CONFIG_BT_EXCLUDE_AT_COMMAND
#			bool "  Use Zephyr BT Stack"						CONFIG_BT_ZEPHYR
			bool "  Enable BT Mesh Based on CODED PHY"			CONFIG_BT_MESH_BASED_ON_CODED_PHY
		fi
		bool "BT Example Demo"									CONFIG_BT_EXAMPLE_DEMO_MENU
		if [ "$CONFIG_BT_EXAMPLE_DEMO_MENU" = "y" ]; then
			bool "  BLE Peripheral"								CONFIG_BT_PERIPHERAL
			bool "  BLE Central"								CONFIG_BT_CENTRAL
			bool "  BLE Scatternet"								CONFIG_BT_SCATTERNET
#			bool "  BLE Throughput"								CONFIG_BT_THROUGHPUT
			bool "  BLE Transfer Module"						CONFIG_BT_TRANSFER_MODULE
			bool "  BLE WiFiMate Device"						CONFIG_BT_WIFIMATE_DEVICE
			bool "  BLE WiFiMate Configurator"					CONFIG_BT_WIFIMATE_CONFIGURATOR
			bool "  BLE Mesh Provisioner"						CONFIG_BT_MESH_PROVISIONER_MENU
			bool "  BLE Mesh Device"							CONFIG_BT_MESH_DEVICE_MENU
			bool "  BLE Mesh Provisioner and BLE Scatternet"	CONFIG_BT_MESH_PROVISIONER_SCATTERNET_MENU
			bool "  BLE Mesh Device and BLE Scatternet"			CONFIG_BT_MESH_DEVICE_SCATTERNET_MENU
			if [ "$CONFIG_BT_MESH_PROVISIONER_MENU" = "y" ]; then
				define_bool CONFIG_BT_MESH_PROVISIONER y
				define_bool CONFIG_BT_MESH_PROVISIONER_SUPPORT y
			fi
			if [ "$CONFIG_BT_MESH_DEVICE_MENU" = "y" ]; then
				define_bool CONFIG_BT_MESH_DEVICE y
				define_bool CONFIG_BT_MESH_DEVICE_SUPPORT y
			fi
			if [ "$CONFIG_BT_MESH_PROVISIONER_SCATTERNET_MENU" = "y" ]; then
				define_bool CONFIG_BT_MESH_PROVISIONER_SCATTERNET y
				define_bool CONFIG_BT_MESH_PROVISIONER_SUPPORT y
			fi
			if [ "$CONFIG_BT_MESH_DEVICE_SCATTERNET_MENU" = "y" ]; then
				define_bool CONFIG_BT_MESH_DEVICE_SCATTERNET y
				define_bool CONFIG_BT_MESH_DEVICE_SUPPORT y
			fi
		fi
	fi
fi
endmenu

mainmenu_option next_comment
comment '< CONFIG LWIP'
if [ "$CONFIG_KM0_NP_KM4_AP" = "y" ]; then
	bool "Enable Fast DHCP"		CONFIG_FAST_DHCP_FOR_KM4
fi
if [ "$CONFIG_WIFI_KM4_SINGLE_CORE" = "y" ]; then
	bool "Enable Fast DHCP"		CONFIG_FAST_DHCP_FOR_KM4
fi

bool "Enable LWIP Debug"		CONFIG_LWIP_DEBUG
if [ "$CONFIG_LWIP_DEBUG" = "y" ]; then
	mainmenu_option next_comment
	comment '< CONFIG LWIP DEBUG'
		bool "Enable ETHARP DEBUG"				CONFIG_ETHARP_DEBUG
		bool "Enable NETIF DEBUG"				CONFIG_NETIF_DEBUG
		bool "Enable PBUF DEBUG"				CONFIG_PBUF_DEBUG
		bool "Enable API LIB DEBUG"				CONFIG_API_LIB_DEBUG
		bool "Enable API MSG DEBUG"				CONFIG_API_MSG_DEBUG
		bool "Enable SOCKETS DEBUG"				CONFIG_SOCKETS_DEBUG
		bool "Enable ICMP DEBUG"				CONFIG_ICMP_DEBUG
		bool "Enable IPNAT DEBUG"				CONFIG_IPNAT_DEBUG
		bool "Enable IGMP DEBUG"				CONFIG_IGMP_DEBUG
		bool "Enable INET DEBUG"				CONFIG_INET_DEBUG
		bool "Enable IP DEBUG"					CONFIG_IP_DEBUG
		bool "Enable IP REASS DEBUG"			CONFIG_IP_REASS_DEBUG
		bool "Enable RAW DEBUG"					CONFIG_RAW_DEBUG
		bool "Enable MEM DEBUG"					CONFIG_MEM_DEBUG
		bool "Enable MEMP DEBUG"				CONFIG_MEMP_DEBUG
		bool "Enable SYS DEBUG"					CONFIG_SYS_DEBUG
		bool "Enable TIMERS DEBUG"				CONFIG_TIMERS_DEBUG
		bool "Enable TCP DEBUG"					CONFIG_TCP_DEBUG
		bool "Enable TCP INPUT DEBUG"			CONFIG_TCP_INPUT_DEBUG
		bool "Enable TCP FR DEBUG"				CONFIG_TCP_FR_DEBUG
		bool "Enable TCP RTO DEBUG"				CONFIG_TCP_RTO_DEBUG
		bool "Enable TCP CWND DEBUG"			CONFIG_TCP_CWND_DEBUG
		bool "Enable TCP WND DEBUG"				CONFIG_TCP_WND_DEBUG
		bool "Enable TCP OUTPUT DEBUG"			CONFIG_TCP_OUTPUT_DEBUG
		bool "Enable TCP RST DEBUG"				CONFIG_TCP_RST_DEBUG
		bool "Enable TCP QLEN DEBUG"			CONFIG_TCP_QLEN_DEBUG
		bool "Enable UDP DEBUG"					CONFIG_UDP_DEBUG
		bool "Enable TCPIP DEBUG"				CONFIG_TCPIP_DEBUG
		bool "Enable SLIP DEBUG"				CONFIG_SLIP_DEBUG
		bool "Enable DHCP DEBUG"				CONFIG_DHCP_DEBUG
		bool "Enable AUTOIP DEBUG"				CONFIG_AUTOIP_DEBUG
		bool "Enable DNS DEBUG"					CONFIG_DNS_DEBUG
		bool "Enable IP6 DEBUG"					CONFIG_IP6_DEBUG
		bool "Enable DHCP6 DEBUG"				CONFIG_DHCP6_DEBUG
	endmenu
fi
endmenu

separator "GeneralEnd"
separator "KM0Start"

comment '--------------KM0 config------------'
mainmenu_option next_comment
comment '< MENUCONFIG FOR KM0 CONFIG'

comment '--------------CPU config Start------------'

mainmenu_option next_comment
comment '< CONFIG CHIP'
comment 'Target Platform Selection'
comment 'Choose a Vendor/Product combination.'

choice 'Product' "AMEBADPLUS CONFIG_AMEBADPLUS_FOR_KM0  \
		" AMEBADPLUS

choice 'ArmCore' "ARM_KM0 ARM_CORE_CM0_FOR_KM0  \
		"ARM_KM0

bool "Select FPGA"            CONFIG_FPGA_FOR_KM0

choice 'Chip Version' "AMEBADPLUS_A_Cut			CONFIG_AMEBADPLUS_A_CUT_FOR_KM0
		" AMEBADPLUS_A_Cut

endmenu

#===========================================================================
# Common Config with every IC have this function in here. Don't litmit someone ic.
#
comment '--------------OS config Start------------'
mainmenu_option next_comment
comment '< CONFIG OS'

bool "Enable Kernel"                     CONFIG_KERNEL_FOR_KM0

if [ "$CONFIG_KERNEL_FOR_KM0" = "y" ]; then
choice 'Kernel Selecte' "FREERTOS        PLATFORM_FREERTOS_FOR_KM0 \
						"FREERTOS
define_int TASK_SCHEDULER_DISABLED_FOR_KM0 0
fi
endmenu #CONFIG OS

#===========================================================================

#===========================================================================
# Normall function config
#

comment '--------------Matter Config Start--------------'
mainmenu_option next_comment
comment '< Matter Config '
bool "Enable Matter"							CONFIG_MATTER_EN
endmenu
comment '--------------Matter Config End--------------'

comment '--------------Peripheral Test start---------------'
mainmenu_option next_comment
comment '< CONFIG FUNCTION TEST'
bool "Enable Peripheral Test"		CONFIG_PER_TEST_FOR_KM0
if [ "$CONFIG_PER_TEST_FOR_KM0" = "y" ]; then
	bool "System_Verify_Mode"	CONFIG_SYS_VERIFY_FOR_KM0
	if [ "$CONFIG_SYS_VERIFY_FOR_KM0" = "y" ]; then
	choice 'System Verify Type'	"IMG_SIM	CONFIG_SIMULATION_FOR_KM0 \
								"
	fi
	bool "DBGPORT Enable"		CONFIG_DBGPORT_ENABLE_FOR_KM0
	bool "Timer_Verify_Mode"	CONFIG_TIMER_VERIFY_FOR_KM0
	bool "WDG_Verify_Mode"		CONFIG_WDG_VERIFY_FOR_KM0
	bool "Gdma_Verify_Mode"		CONFIG_GDMA_VERIFY_FOR_KM0
	bool "GPIO_Verify_Mode"		CONFIG_GPIO_VERIFY_FOR_KM0
	bool "SPI_COM_Verify_Mode"	CONFIG_SPI_COM_VERIFY_FOR_KM0
	bool "UART_Verify_Mode"		CONFIG_UART_VERIFY_FOR_KM0
	bool "I2C_Verify_Mode"		CONFIG_I2C_VERIFY_FOR_KM0
	bool "PMC_Verify_Mode"		CONFIG_PMC_VERIFY_FOR_KM0
	bool "EFUSE_Verify_Mode"	CONFIG_EFUSE_VERIFY_FOR_KM0
	bool "SPIC_Verify_Mode"		CONFIG_SPIC_VERIFY_FOR_KM0
	bool "ADC_Verify_Mode"		CONFIG_ADC_VERIFY_FOR_KM0
	bool "RSIP_Verify_Mode"		CONFIG_RSIP_VERIFY_FOR_KM0
	bool "CapTouch_Verify_Mode"	CONFIG_CAPTOUCH_VERIFY_FOR_KM0
	bool "SGPIO_Verify_Mode"	CONFIG_SGPIO_VERIFY_FOR_KM0
	bool "Qdecoder_Verify_Mode"	CONFIG_QDEC_VERIFY_FOR_KM0
	bool "Dhrystone Test"		CONFIG_DHRYSTONE_TEST_FOR_KM0
	bool "Performance_Verify_Mode"		CONFIG_PERFORMANCE_VERIFY_FOR_KM0
	bool "SSL ROM Test"		CONFIG_SSL_ROM_TEST_FOR_KM0
	bool "RTLIB ROM Test"		CONFIG_RTLIB_VERIFY_FOR_KM0
	bool "SecureBoot Test"		CONFIG_SBOOT_VERIFY_FOR_KM0
	bool "IPC Test"			CONFIG_IPC_VERIFY_FOR_KM0
	bool "MPU Test"			CONFIG_MPU_VERIFY_FOR_KM0
	bool "CACHE Test"		CONFIG_CACHE_VERIFY_FOR_KM0
	bool "WFE Test"			CONFIG_WFE_VERIFY_FOR_KM0
	bool "Thermal_Verify_Mode"	CONFIG_THERMAL_VERIFY_FOR_KM0
	bool "chip_reset_verify"		CONFIG_CHIP_RST_VERIFY_FOR_KM0
	bool "debugtimer_verify"		CONFIG_DBG_TIMER_VERIFY_FOR_KM0
	bool "SPI Nand Test"		CONFIG_SPINAND_VERIFY_FOR_KM0
	bool "LOGUART Test"		CONFIG_LOGUART_VERIFY_FOR_KM0
	bool "KeyScan Test"		CONFIG_KEYSCAN_VERIFY_FOR_KM0
	bool "Flash_AVL"        CONFIG_FLASH_AVL_FOR_KM0
	bool "WIFI Test"        CONFIG_WIFI_VERIFY_FOR_KM0
	if [ "$CONFIG_WIFI_VERIFY_FOR_KM0" = "y" ]; then
	choice 'WIFI Verify Type'         "WIFI_ASIC              CONFIG_WIFI_VERIFY_ASIC_FOR_KM0 \
									   WIFI_MAC_LBK           CONFIG_MAC_LBK_FOR_KM0 \
									   WIFI_2MAC_WITH_PSPHY   CONFIG_WIFI_VERIFY_PSPHY_FOR_KM0 \
									   WIFI_2MAC_WITH_TUREPHY CONFIG_WIFI_VERIFY_TRUEPHY_FOR_KM0 \
									  "
	fi
fi #CONFIG_PER_TEST_FOR_KM0
endmenu #CONFIG PER TEST

#===========================================================================
# Normal: Build all code, includes ROM code. Normally for FPGA verification.
# Release: Build user application code and link with ROM + RAM libraries.
# Build_ROM_Lib: Build the ROM code library only.
# Build_RAM_Lib: Build the RAM code library only.
# Build_RAM_All: Build all RAM code, includes user application, and link with ROM library.
comment '--------------Build Config------------'
mainmenu_option next_comment

comment '< Build Option'

comment 'Select toolchain  '
choice 'Toolchain'		"ASDK             CONFIG_TOOLCHAIN_ASDK_FOR_KM0  \
                                 ARM_GCC          CONFIG_TOOLCHAIN_ARM_GCC_FOR_KM0  \
 			           		" ASDK

comment 'Choose the build configuration '
choice 'Link ROM Mode ' 			"Link_ROM_Library      CONFIG_LINK_ROM_LIB_FOR_KM0  \
                                     Link_ROM_Symbol       CONFIG_LINK_ROM_SYMB_FOR_KM0  \
					               " Link_ROM_Library
endmenu

comment '--------------------------'
endmenu


separator "KM0End"

separator "KM4Start"

comment '--------------KM4 config------------'
mainmenu_option next_comment
comment '< MENUCONFIG FOR KM4 CONFIG'

comment '--------------CPU config Start------------'

mainmenu_option next_comment
comment '< CONFIG CHIP'
comment 'Target Platform Selection'
comment 'Choose a Vendor/Product combination.'

choice 'Product' "AMEBADPLUS CONFIG_AMEBADPLUS_FOR_KM4  \
		" AMEBADPLUS

choice 'ArmCore' "ARM_CM4 ARM_CORE_CM4_FOR_KM4 \
		"ARM_CM4

bool "Select FPGA"            CONFIG_FPGA_FOR_KM4

choice 'Chip Version' "AMEBADPLUS_A_Cut			CONFIG_AMEBADPLUS_A_CUT_FOR_KM4
                       AMEBADPLUS_B_Cut			CONFIG_AMEBADPLUS_B_CUT_FOR_KM4
		" AMEBADPLUS_B_Cut

endmenu

#===========================================================================
# Common Config with every IC have this function in here. Don't litmit someone ic.
#
comment '--------------OS config Start------------'
mainmenu_option next_comment
comment '< CONFIG OS'

bool "Enable Kernel"                     CONFIG_KERNEL_FOR_KM4

if [ "$CONFIG_KERNEL_FOR_KM4" = "y" ]; then
choice 'Kernel Selecte' "FREERTOS        PLATFORM_FREERTOS_FOR_KM4 \
						"FREERTOS
define_int TASK_SCHEDULER_DISABLED_FOR_KM4 0
fi
endmenu #CONFIG OS

#===========================================================================

#===========================================================================
# Normall function config
#


comment '--------------Peripheral config Start------------'

mainmenu_option next_comment
comment '< CONFIG USB'
bool "Enable USB Device"		CONFIG_USB_DEVICE_EN_FOR_KM4
if [ "$CONFIG_USB_DEVICE_EN_FOR_KM4" = "y" ]; then
bool "CDC ACM"                          CONFIG_USBD_CDC_ACM_FOR_KM4
bool "Composite"                        CONFIG_USBD_COMPOSITE_FOR_KM4
bool "HID"                              CONFIG_USBD_HID_FOR_KM4
bool "INIC"                             CONFIG_USBD_INIC_FOR_KM4
bool "UAC(Experimental)"                CONFIG_USBD_UAC_FOR_KM4
bool "Vendor"                           CONFIG_USBD_VENDOR_FOR_KM4
fi
endmenu

comment '--------------Peripheral Test start---------------'
mainmenu_option next_comment
comment '< CONFIG FUNCTION TEST'
bool "Enable Peripheral Test"		CONFIG_PER_TEST_FOR_KM4
if [ "$CONFIG_PER_TEST_FOR_KM4" = "y" ]; then
	bool "System_Verify_Mode"	CONFIG_SYS_VERIFY_FOR_KM4
	if [ "$CONFIG_SYS_VERIFY_FOR_KM4" = "y" ]; then
	choice 'System Verify Type'	"FT_Test		CONFIG_FT_FOR_KM4\
								EQC_Test		CONFIG_EQC_FOR_KM4\
								QA_Test		CONFIG_QA_FOR_KM4 \
								OLT_Test		CONFIG_OLT_FOR_KM4 \
								EMC_Test		CONFIG_EMC_FOR_KM4 \
								Corner_Test		CONFIG_CORNER_FOR_KM4 \
								IMG_SIM			CONFIG_SIMULATION_FOR_KM4 \
								"
	fi
	bool "WIFI FW Test"		CONFIG_WIFI_FW_VERIFY_FOR_KM4
	bool "DBGPORT_Verify_Mode"	CONFIG_DBGPORT_VERIFY_FOR_KM4
	bool "Timer_Verify_Mode"	CONFIG_TIMER_VERIFY_FOR_KM4
	bool "PRS_Verify_Mode"		CONFIG_PRS_VERIFY_FOR_KM4
	bool "WDG_Verify_Mode"		CONFIG_WDG_VERIFY_FOR_KM4
	bool "TRNG_Verify_Mode"		CONFIG_TRNG_VERIFY_FOR_KM4
	bool "Gdma_Verify_Mode"		CONFIG_GDMA_VERIFY_FOR_KM4
	bool "GPIO_Verify_Mode"		CONFIG_GPIO_VERIFY_FOR_KM4
	bool "PINMUX_Verify_Mode"       CONFIG_PINMUX_VERIFY_FOR_KM4
	bool "ZB_INT_Verify_Mode"	CONFIG_ZB_INT_VERIFY_FOR_KM4
	bool "SPI_COM_Verify_Mode"	CONFIG_SPI_COM_VERIFY_FOR_KM3
	bool "UART_Verify_Mode"		CONFIG_UART_VERIFY_FOR_KM4
	bool "LCDC_Verify_Mode"		CONFIG_LCDC_VERIFY_FOR_KM4
	bool "LEDC_Verify_Mode"		CONFIG_LEDC_VERIFY_FOR_KM4
	bool "I2C_Verify_Mode"		CONFIG_I2C_VERIFY_FOR_KM4
	bool "PMC_Verify_Mode"		CONFIG_PMC_VERIFY_FOR_KM4
	bool "SGPIO_Verify_Mode"	CONFIG_SGPIO_VERIFY_FOR_KM4
	bool "PSRAM_Verify_Mode"	CONFIG_PSRAM_VERIFY_FOR_KM4
	bool "AUDIO_Verify_Mode"	CONFIG_AUDIO_VERIFY_FOR_KM4
	if [ "$CONFIG_AUDIO_VERIFY_FOR_KM4" = "y" ]; then
	choice 'AUDIO Verify Type'	"AUDIO_SNR_VERIFY		CONFIG_AUDIO_SNR_VERIFY_FOR_KM4 \
								"
	fi
	bool "SOC_PS_Verify_Mode"	CONFIG_SOC_PS_VERIFY_FOR_KM4
	bool "Crypto_Verify_Mode"	CONFIG_CRYPTO_VERIFY_FOR_KM4
	bool "EFUSE_Verify_Mode"	CONFIG_EFUSE_VERIFY_FOR_KM4
	bool "SPIC_Verify_Mode"		CONFIG_SPIC_VERIFY_FOR_KM4
	if [ "$CONFIG_SPIC_VERIFY_FOR_KM4" = "y" ]; then
	choice 'SPIC Verify Type'	"MCM_MEMORY_VERIFY		CONFIG_MCM_MEM_VERIFY_FOR_KM4 \
									  "
	fi
	bool "FTL_Verify_Mode"		CONFIG_FTL_VERIFY_FOR_KM4
	bool "ADC_Verify_Mode"		CONFIG_ADC_VERIFY_FOR_KM4
	bool "CapTouch_Verify_Mode"	CONFIG_CAPTOUCH_VERIFY_FOR_KM4
	bool "Thermal_Verify_Mode"	CONFIG_THERMAL_VERIFY_FOR_KM4
	bool "RSIP_Verify_Mode"		CONFIG_RSIP_VERIFY_FOR_KM4
	bool "SDIO_DEVICE_Verify_Mode"	CONFIG_SDIO_DEVICE_VERIFY_FOR_KM4
	bool "SDIO_HOST_Verify_Mode"	CONFIG_SDIOH_VERIFY_FOR_KM4
	bool "chip_reset_verify"		CONFIG_CHIP_RST_VERIFY_FOR_KM4
	bool "debugtimer_verify"		CONFIG_DBG_TIMER_VERIFY_FOR_KM4
	bool "Dhrystone Test"		CONFIG_DHRYSTONE_TEST_FOR_KM4
	bool "Performance_Verify_Mode"		CONFIG_PERFORMANCE_VERIFY_FOR_KM4
	bool "RTLIB ROM Test"		CONFIG_RTLIB_VERIFY_FOR_KM4
	bool "IPC Test"			CONFIG_IPC_VERIFY_FOR_KM4
	bool "IR Test"			CONFIG_IR_VERIFY_FOR_KM4
	bool "MPU Test"			CONFIG_MPU_VERIFY_FOR_KM4
	bool "CACHE Test"		CONFIG_CACHE_VERIFY_FOR_KM4
	bool "WFE Test"			CONFIG_WFE_VERIFY_FOR_KM4
	bool "DDR Test"			CONFIG_DDR_VERIFY_FOR_KM4
	bool "RSA Test"			CONFIG_RSA_VERIFY_FOR_KM4
	bool "ECDSA Test"		CONFIG_ECDSA_VERIFY_FOR_KM4
	bool "ED25519 Test"		CONFIG_ED25519_VERIFY_FOR_KM4
	bool "SpiNand Test"		CONFIG_SPINAND_VERIFY_FOR_KM4
	bool "LOGUART Test"		CONFIG_LOGUART_VERIFY_FOR_KM4
	bool "KeyScan Test"		CONFIG_KEYSCAN_VERIFY_FOR_KM4
	bool "SDM Test"			CONFIG_SDM_VERIFY_FOR_KM4
	bool "PPE Test"			CONFIG_PPE_VERIFY_FOR_KM4
	bool "QSPI Test"		CONFIG_QSPI_VERIFY_FOR_KM4
	bool "Memory Test"		CONFIG_MEMORY_VERIFY_FOR_KM4
	bool "AF Test"			CONFIG_AF_VERIFY_FOR_KM4
	bool "mbedtls Test"		CONFIG_MBEDTLS_VERIFY_FOR_KM4
	bool "Flash_AVL"        CONFIG_FLASH_AVL_FOR_KM4
	bool "USB Test"			CONFIG_USBD_VERIFY_FOR_KM4
	bool "WIFI Test"        CONFIG_WIFI_VERIFY_FOR_KM4
	if [ "$CONFIG_WIFI_VERIFY_FOR_KM4" = "y" ]; then
	choice 'WIFI Verify Type'         "WIFI_ASIC              CONFIG_WIFI_VERIFY_ASIC_FOR_KM4 \
									   WIFI_MAC_LBK           CONFIG_MAC_LBK_FOR_KM4 \
									   WIFI_2MAC_WITH_PSPHY   CONFIG_WIFI_VERIFY_PSPHY_FOR_KM4 \
									   WIFI_2MAC_WITH_TUREPHY CONFIG_WIFI_VERIFY_TRUEPHY_FOR_KM4 \
									  "
	fi

fi #CONFIG_PER_TEST_FOR_KM4
endmenu #CONFIG PER TEST

comment '--------------Secure Test start---------------'
mainmenu_option next_comment
comment '< CONFIG SECURE TEST'
bool "SEC_Verify_Mode"			CONFIG_SEC_VERIFY_FOR_KM4
if [ "$CONFIG_SEC_VERIFY_FOR_KM4" = "y" ]; then
	bool "CACHE Secure Test"	CONFIG_CACHE_SEC_VERIFY_FOR_KM4
	bool "EFUSE Secure Test"	CONFIG_EFUSE_SEC_VERIFY_FOR_KM4
	bool "GDMA Secure Test"		CONFIG_GDMA_SEC_VERIFY_FOR_KM4
	bool "AES Secure Test"		CONFIG_AES_SEC_VERIFY_FOR_KM4
	bool "Crypto Secure Test"	CONFIG_CRYPTO_SEC_VERIFY_FOR_KM4
	bool "CRC Secure Test"		CONFIG_CRC_SEC_VERIFY_FOR_KM4
	bool "RDP Secure Test"		CONFIG_RDP_SEC_VERIFY_FOR_KM4
	bool "WDG Secure Test"		CONFIG_WDG_SEC_VERIFY_FOR_KM4
	bool "TRNG Secure Test"		CONFIG_TRNG_SEC_VERIFY_FOR_KM4
	bool "TIMER Secure Test"	CONFIG_TIMER_SEC_VERIFY_FOR_KM4
	bool "DBGTIM Secure Test"	CONFIG_DBGTIM_SEC_VERIFY_FOR_KM4
	bool "GPIO Secure Test"		CONFIG_GPIO_SEC_VERIFY_FOR_KM4
	bool "RTC Secure Test"		CONFIG_RTC_SEC_VERIFY_FOR_KM4
	bool "ADC Secure Test"		CONFIG_ADC_SEC_VERIFY_FOR_KM4
	bool "THERMAL Secure Test"	CONFIG_THERMAL_SEC_VERIFY_FOR_KM4
	bool "LCDC Secure Test"		CONFIG_LCDC_SEC_VERIFY_FOR_KM4
	bool "LOG_UART_Secure_TEST"	CONFIG_LOG_UART_SEC_VERIFY_FOR_KM4
	bool "UART_Secure_TEST"		CONFIG_UART_SEC_VERIFY_FOR_KM4
	bool "SPI_Secure_TEST"		CONFIG_SPI_SEC_VERIFY_FOR_KM4
	bool "I2C_Secure_TEST"		CONFIG_I2C_SEC_VERIFY_FOR_KM4
	bool "EDDSA Secure Test"	CONFIG_EDDSA_SEC_VERIFY_FOR_KM4
	bool "ECDSA Secure Test"	CONFIG_ECDSA_SEC_VERIFY_FOR_KM4
	bool "RSA Secure Test"		CONFIG_RSA_SEC_VERIFY_FOR_KM4
	bool "LEDC Secure Test"		CONFIG_LEDC_SEC_VERIFY_FOR_KM4
	bool "IRDA Secure Test"		CONFIG_IRDA_SEC_VERIFY_FOR_KM4
	bool "Trustzone Secure Test"		CONFIG_TZ_SEC_VERIFY_FOR_KM4
	bool "AUDIO Secure Test"	CONFIG_AUDIO_SEC_VERIFY_FOR_KM4
	bool "KEYSCAN Secure Test"	CONFIG_KEYSCAN_SEC_VERIFY_FOR_KM4
fi #CONFIG_PER_TEST_FOR_KM4
endmenu #CONFIG PER TEST

comment '--------------Application Config Start------------'
mainmenu_option next_comment
comment '< LWIP Config'
bool "NAT REPEATER Enable"		CONFIG_IP_NAT
endmenu

mainmenu_option next_comment
comment '< SSL Config'
define_bool CONFIG_USE_MBEDTLS_ROM_FOR_KM4 y
bool "MBEDTLS Enable"		CONFIG_MBED_TLS_ENABLED_FOR_KM4
bool "SSL ROM Test"		CONFIG_SSL_ROM_TEST_FOR_KM4
if [ "$CONFIG_MATTER_EN" = "y" ]; then
	bool "Matter MBEDTLS Enable"		MBEDTLS_MATTER_ENABLE
	if [ "$MATTER_V_1_4_EN" = "y" ]; then
		if [ "$MBEDTLS_MATTER_ENABLE" = "y" ]; then
			choice 'Matter MBEDTLS Version' "MBEDTLS_MATTER_V_2_28_1   MBEDTLS_MATTER_V_2_28_1_ENABLE \
											MBEDTLS_MATTER_V_3_6_1   MBEDTLS_MATTER_V_3_6_1_ENABLE
											"
		fi
	fi
fi
endmenu

mainmenu_option next_comment
comment '< 802154 Config'
bool "Enable 802154"                     CONFIG_802154_EN_FOR_KM4
if [ "$CONFIG_802154_EN_FOR_KM4" = "y" ]; then
	if [ "$CONFIG_MBED_TLS_ENABLED_FOR_KM4" = "n" ]; then
		comment '    Must Enable MBEDTLS Before Enable THREAD'
	fi
	if [ "$CONFIG_MBED_TLS_ENABLED_FOR_KM4" = "y" ]; then
		bool "Enable THREAD"                	CONFIG_802154_THREAD_EN_FOR_KM4
		if [ "$CONFIG_802154_THREAD_EN_FOR_KM4" = "y" ]; then
			choice 'THREAD ROLE'      "BORDER_ROUTER		CONFIG_802154_THREAD_BORDER_ROUTER_EN_FOR_KM4 \
							FTD			        CONFIG_802154_THREAD_FTD_EN_FOR_KM4 \
							MTD			        CONFIG_802154_THREAD_MTD_EN_FOR_KM4 \
							"
		fi
		bool "USE FLASH FOR OPENTHREAD SETTING" CONFIG_802154_THREAD_FLASH_API_EN_FOR_KM4
		bool "STABILITY TEST"                	CONFIG_802154_THREAD_STABILITY_TEST_EN_FOR_KM4
	fi
	bool "Enable 802154 Test"               CONFIG_802154_TEST_EN_FOR_KM4
	if [ "$CONFIG_802154_TEST_EN_FOR_KM4" = "y" ]; then
		define_bool CONFIG_802154_THREAD_EN_FOR_KM4 n
	fi
fi
endmenu

mainmenu_option next_comment
comment '< Matter Config '
bool "Enable Matter"							CONFIG_MATTER_EN
if [ "$CONFIG_MATTER_EN" = "y" ]; then
	define_bool CONFIG_MATTER y
	choice 'Matter Version' "MATTER_V_1_3   MATTER_V_1_3_EN \
							MATTER_V_1_4   MATTER_V_1_4_EN
							"
	if [ "$MATTER_V_1_4_EN" = "y" ]; then
		bool "Enable Matter Terms and Condition"		CONFIG_MATTER_TC_EN
		if [ "$CONFIG_MATTER_TC_EN" = "y" ]; then
			define_bool CHIP_ENABLE_AMEBA_TERMS_AND_CONDITION y
		fi
	fi
	if [ "$CONFIG_TRUSTZONE_FOR_KM4" = "y" ]; then
		bool "Enable Matter Secure"					CONFIG_MATTER_SECURE_EN
		if [ "$CONFIG_MATTER_SECURE_EN" = "y" ]; then
			define_bool CONFIG_MATTER_SECURE y
		fi
	fi
fi
endmenu

mainmenu_option next_comment
comment '< GUI Config'
bool "Enable GUI"                    		CONFIG_GUI_EN_FOR_KM4
if [ "$CONFIG_GUI_EN_FOR_KM4" = "y" ]; then
	bool "LVGL"		CONFIG_LVGL_EN_FOR_KM4
fi
endmenu

mainmenu_option next_comment
comment '< Audio Config'

bool "Enable Audio Framework"		CONFIG_AUDIO_FWK_FOR_KM4
if [ "$CONFIG_AUDIO_FWK_FOR_KM4" = "y" ]; then
	choice 'Select Audio Interfaces' "Mixer	CONFIG_AUDIO_MIXER_FOR_KM4 \
								PassThrough	CONFIG_AUDIO_PASSTHROUGH_FOR_KM4"
fi

mainmenu_option next_comment
comment 'Third Party Lib'
        bool "Speex"        CONFIG_SPEEX_LIB_FOR_KM4
        bool "OPUS"         CONFIG_OPUS_LIB_FOR_KM4
endmenu
endmenu

mainmenu_option next_comment
comment '< IMQ Config'
bool "Enable IMQ"                    		CONFIG_IMQ_EN_FOR_KM4
endmenu

mainmenu_option next_comment
comment '< Wifi Audio Config'
bool "Enable WIFI AUDIO"           CONFIG_WIFI_AUDIO_FOR_KM4
bool "Enable WFA SRC"              CONFIG_WFA_SRC_FOR_KM4
if [ "$CONFIG_WIFI_AUDIO_FOR_KM4" = "y" -o "$CONFIG_WFA_SRC_FOR_KM4" = "y" ]; then
	define_bool CONFIG_AUDIO_FWK_FOR_KM4 y
	define_bool CONFIG_AUDIO_PASSTHROUGH_FOR_KM4 y
	bool "Enable FEC USE SRAM"        CONFIG_WFA_FEC_USE_SRAM
fi

endmenu

#===========================================================================
# Normal: Build all code, includes ROM code. Normally for FPGA verification.
# Release: Build user application code and link with ROM + RAM libraries.
# Build_ROM_Lib: Build the ROM code library only.
# Build_RAM_Lib: Build the RAM code library only.
# Build_RAM_All: Build all RAM code, includes user application, and link with ROM library.
comment '--------------Build Config------------'
mainmenu_option next_comment

comment '< Build Option'

comment 'Select toolchain  '
choice 'Toolchain'		"ASDK             CONFIG_TOOLCHAIN_ASDK_FOR_KM4  \
                                 ARM_GCC          CONFIG_TOOLCHAIN_ARM_GCC_FOR_KM4  \
 			           		" ASDK

comment 'Choose the build configuration '
choice 'Link ROM Mode ' 			"Link_ROM_Library      CONFIG_LINK_ROM_LIB_FOR_KM4  \
                                     Link_ROM_Symbol       CONFIG_LINK_ROM_SYMB_FOR_KM4  \
					               " Link_ROM_Library
endmenu

comment '--------------------------'
endmenu

separator "KM4End"
```
