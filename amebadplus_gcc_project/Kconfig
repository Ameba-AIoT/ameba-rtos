## amebalite_gcc_project/Kconfig
```kconfig
mainmenu "${RTK_SOC_NAME} Configuration"

comment "--------MENUCONFIG FOR General---------"

#Release flag, set to y after release
config AMEBA_RLS
  def_bool y

config AMEBALITE
    def_bool y

config SUPPORT_HEAP_TRACE
    def_bool y

#---------- FEATURE LIST START-----------#
#All features are invisible in menuconfig


#---------- FEATURE LIST END-------------#

menu "CONFIG DSP Enable"
    config DSP_EN
        bool "Enable DSP"
    config DSP_WITHIN_APP_IMG
        depends on DSP_EN
        bool "DSP within APP image"
    config DSP_IMAGE_TARGET_DIR
       string "DSP_IMAGE_TARGET_DIR"
       depends on DSP_WITHIN_APP_IMG
endmenu

menu "CONFIG TrustZone"
    config TRUSTZONE
        bool "Enable TrustZone"
    config TRUSTZONE_EN
        depends on TRUSTZONE
        bool
        default y
endmenu

menu "CONFIG Link Option"
    choice
        prompt "IMG1(Bootloader) running on FLASH or SRAM?"
        default IMG1_FLASH
        config IMG1_FLASH
            bool "FLASH"
        config IMG1_SRAM
            bool "SRAM"
    endchoice

    choice
        prompt "IMG2(Application) running on FLASH or PSRAM?"
        default IMG2_FLASH
        config IMG2_FLASH
            bool "FLASH"
        config IMG2_PSRAM
            bool "PSRAM"
            select PSRAM_USED
    endchoice

    choice
        prompt "IMG2 Data and Heap in SRAM or PSRAM?"
        default DATA_HEAP_SRAM
        config DATA_HEAP_SRAM
            bool "SRAM"
        config DATA_HEAP_PSRAM
            bool "PSRAM"
            select PSRAM_USED
    endchoice

    if TRUSTZONE
        choice
            prompt "IMG3(SecureImage) running on PSRAM or SRAM?"
            default IMG3_SRAM
            config IMG3_PSRAM
                bool "PSRAM"
                select PSRAM_USED
            config IMG3_SRAM
                bool "SRAM"
        endchoice
    endif

    config PSRAM_ALL_FOR_AP_HEAP
        depends on !IMG2_PSRAM && !DATA_HEAP_PSRAM
        bool "ALL PSRAM USED FOR APPLICATION HEAP"
        default y

    config PSRAM_USED
        bool
endmenu

menu "CONFIG Mass Production"
    config MP_INCLUDED
        bool "Enable MP"
    if MP_INCLUDED
        choice
            prompt "MP Mode"
            default MP_EXPAND
            config MP_EXPAND
                bool "expand"
        endchoice
    endif
endmenu

rsource "../component/at_cmd/Kconfig"

rsource "../component/soc/common/rtk_assert/Kconfig"

rsource "../component/file_system/Kconfig"

rsource "../component/os/Kconfig"

orsource "../component/utils/Kconfig"

menu "CONFIG OTA OPTION"
    config UPGRADE_BOOTLOADER
        bool "Enable Bootloader OTA"
    config COMPRESS_OTA_IMG
        bool "Enable Compress APP Image"
endmenu

menu "CONFIG APPLICATION"

    orsource "../component/ui/Kconfig"

    orsource "../component/audio/Kconfig"

    rsource "../component/utils/ipc/Kconfig"

    menu "AI Config"
        orsource "../component/tflite_micro/Kconfig"
        if DSP_EN
            orsource "../component/aivoice/Kconfig.dsp"
        endif
        if AIVOICE_EN_MENU
            orsource "../component/application/speechmind/Kconfig"
        endif
    endmenu

    orsource "../component/application/Kconfig"

    orsource "${RTK_APP_DIR}/Kconfig"

    orsource "../component/application/matter/project/cmake/Kconfig"

    rsource "../component/soc/common/diagnose/Kconfig"

endmenu

comment "-----Connectivity Config-----"

menu "CONFIG WHC INTF"
	choice
		prompt "WHC MODE"
		default WHC_INTF_IPC_MENU
			config WHC_INTF_IPC_MENU
				bool "WHC_IPC"
                select WHC_INTF_IPC

            config WIFI_SINGLE_CORE_MENU
                bool "SINGLE CORE"
            config FULLMAC_DEV
                bool "FULLMAC_DEV"
            config WHC_FULLMAC_HOST
                bool "FULLMAC_HOST"
                select WHC_FULLMAC_HOST_IMPL
                select WHC_HOST_FOR_KM4
	endchoice

    if !WHC_INTF_IPC_MENU && !WIFI_SINGLE_CORE_MENU
        choice
            prompt "HW INTERFACE"
            config WHC_INTF_SPI
                bool "WHC_INTF_SPI"
        endchoice
    endif

    if FULLMAC_DEV
        choice
            prompt "WIFI Driver Location"
            default KR4_AS_NP
            config KR4_AS_NP
                bool "KR4"
                select WHC_DEV_FOR_KR4

            #config KM4_AS_NP
            #    bool "KM4"
            #    select WHC_DEV_FOR_KM4
        endchoice
        menu "FULLMAC config"
        config WHC_CMD_PATH
            default y if FULLMAC_DEV && !WHC_INTF_USB
            bool "Support WHC CMD PATH"
        config WHC_WIFI_API_PATH
            default y if FULLMAC_DEV
            bool "Support WHC WIFI API PATH"

        config WHC_WPA_SUPPLICANT_OFFLOAD_FOR_KR4
            depends on KR4_AS_NP
            bool "Support WHC SUPPLICANT OFFLOAD"
        #config WHC_WPA_SUPPLICANT_OFFLOAD_FOR_KM4
        #    depends on KM4_AS_NP
        #    bool "Support WHC SUPPLICANT OFFLOAD"

        config WHC_DEV_TCPIP_KEEPALIVE_FOR_KR4
            depends on KR4_AS_NP
            bool "Support WHC DEV TCPIP KEEPALIVE"
        #config WHC_DEV_TCPIP_KEEPALIVE_FOR_KM4
        #    depends on KM4_AS_NP
        #    bool "Support WHC DEV TCPIP KEEPALIVE"

        endmenu
    endif

    if WHC_FULLMAC_HOST && !WHC_INTF_IPC_MENU
        menu "FULLMAC HOST config"
        config WHC_CMD_PATH
            default y
            bool "Support WHC CMD PATH"
        config WHC_WIFI_API_PATH
            default y
            bool "Support WHC WIFI API PATH"
        endmenu
    endif

    if WHC_INTF_IPC_MENU || WIFI_SINGLE_CORE_MENU
        choice
            prompt "Select AP Core"
            default AP_CORE_KM4
            config AP_CORE_KM4
                bool "KM4"
                select WHC_HOST_FOR_KM4 if WHC_INTF_IPC_MENU
                select WHC_DEV_FOR_KR4 if WHC_INTF_IPC_MENU
                select WHC_NONE_FOR_KM4 if WIFI_SINGLE_CORE_MENU
            config AP_CORE_KR4
                bool "KR4"
                select WHC_HOST_FOR_KR4 if WHC_INTF_IPC_MENU
                select WHC_DEV_FOR_KM4 if WHC_INTF_IPC_MENU
                select WHC_NONE_FOR_KR4 if WIFI_SINGLE_CORE_MENU
        endchoice
    endif


    config WHC_HOST_FOR_KM4
        bool
    config WHC_DEV_FOR_KR4
        bool
    config WHC_HOST_FOR_KR4
        bool
    config WHC_DEV_FOR_KM4
        bool
    config WHC_NONE_FOR_KM4
        bool
    config WHC_NONE_FOR_KR4
        bool
    config WHC_WIFI_API_PATH
        bool
    config WHC_CMD_PATH
        bool
    #config WHC_WPA_SUPPLICANT_OFFLOAD_FOR_KM4
    #    bool
    #config WHC_DEV_TCPIP_KEEPALIVE_FOR_KM4
    #    bool
    config WHC_WPA_SUPPLICANT_OFFLOAD_FOR_KR4
        bool
    config WHC_DEV_TCPIP_KEEPALIVE_FOR_KR4
        bool
endmenu

menu "CONFIG WIFI"
    config WLAN_MENU
        bool "Enable Wifi"
        default y
    if WLAN_MENU

        rsource "../component/wifi/Kconfig.wifi"

        config WHC_INTF_IPC_MENU
            bool
            select WHC_WIFI_API_PATH
            select WLAN
            select LWIP_LAYER if WHC_HOST && !MP_SHRINK
            select FW_DRIVER_COEXIST if WHC_DEV
            select ENABLE_WPS if WHC_HOST && WIFI_WPS_ENABLE_MENU
            select ENABLE_WPS_DISCOVERY if ENABLE_WPS

        config WIFI_SINGLE_CORE_MENU
            bool
            depends on WHC_NONE
            select WHC_INTF_IPC
            select WLAN
            select LWIP_LAYER if !MP_SHRINK
            select FW_DRIVER_COEXIST
            select ENABLE_WPS if WIFI_WPS_ENABLE_MENU
            select ENABLE_WPS_DISCOVERY if ENABLE_WPS

        config FULLMAC_DEV
            bool
            depends on WHC_DEV # only work in NP
            select WLAN
            select FW_DRIVER_COEXIST
            select WIFI_FW_EN
            select WIFI_HOST_CONTROL
            select LWIP_LAYER if WHC_DEV_TCPIP_KEEPALIVE_FOR_KR4 || WHC_DEV_TCPIP_KEEPALIVE_FOR_KM4

        config WHC_FULLMAC_HOST_IMPL
            bool
            depends on WHC_HOST
            select WLAN
            select LWIP_LAYER
    endif

    if !WLAN_MENU
        config WLAN_DISABLE
            bool
            select AS_INIC_AP if WHC_HOST
            select AS_INIC_NP if WHC_DEV
    endif


    config WLAN
        bool
    config WHC_INTF_IPC
        bool
    config AS_INIC_NP
        bool
    config AS_INIC_AP
        bool
    config LWIP_LAYER
        bool
    config FW_DRIVER_COEXIST
        bool
    config WHC_INTF_SDIO
        bool
    config WHC_INTF_SPI
        bool
    config WHC_INTF_USB
        bool
    config WIFI_FW_EN
        bool
    config ENABLE_WPS
        bool
    config ENABLE_WPS_DISCOVERY
        bool
    config FULLMAC_HOST
        bool
    config WIFI_HOST_CONTROL
        bool
    config WHC_FULLMAC_HOST_IMPL
        bool

endmenu

menu "CONFIG BT"
    config BT_MENU
        bool "Enable BT"
    if BT_MENU
        # IC BT capability
        config BT_HAS_BREDR
            def_bool y
        config BT_HAS_MESH
            def_bool y
#       config BT_HAS_LEAUDIO
#           def_bool y

        choice
            prompt "BT Mode Selection"
            default BT_BLE_ONLY
            config BT_BLE_ONLY
                bool "BLE_ONLY"

            config BT_DUAL_MODE
                bool "DUAL_MODE"
        endchoice

        config BT
            depends on WHC_HOST || WHC_NONE
            bool
            default y
            select FTL_ENABLED

        config FTL_ENABLED
            bool

        rsource "../component/bluetooth/Kconfig"

    endif
endmenu

rsource "../component/lwip/Kconfig"

rsource "../component/ssl/Kconfig"

#orsource "../component/wpan/Kconfig"

rsource "../component/rtk_coex/Kconfig.coex"

if !AMEBA_RLS
comment "---------Test Config---------"

menu "Verification and Test"
    rsource "../component/soc/amebalite/Kconfig"
endmenu
endif

comment "--------Build Config---------"
menu "Build Option"

config FPGA
    bool "Select FPGA"
    depends on !AMEBA_RLS

comment "Choose the build configuration"
    choice
        prompt "Link ROM Mode"
        default LINK_ROM_SYMB
        config LINK_ROM_LIB
            bool "Link_ROM_Library"

        config LINK_ROM_SYMB
            bool "Link_ROM_Symbol"
    endchoice
endmenu

comment "-----end of MENUCONFIG FOR General-----"

menu "MENUCONFIG FOR KR4 CONFIG"
    rsource "project_kr4/Kconfig"
endmenu

menu "MENUCONFIG FOR KM4 CONFIG"
    rsource "project_km4/Kconfig"
endmenu


comment "----- DO NOT ENTER IN THIS BUTTON ------"
menu "MENUCONFIG FOR Private"
config WHC_HOST
    bool "--DO NOT CHOOSE THIS CONFIG--"
config WHC_DEV
    bool "--DO NOT CHOOSE THIS CONFIG--"
config WHC_NONE
    bool "--DO NOT CHOOSE THIS CONFIG--"
endmenu
```

## amebalite_gcc_project/Kconfig.bt
```kconfig
choice
    prompt "BT Mode Selection"
    default BT_BLE_ONLY
    config BT_BLE_ONLY
        bool "BLE_ONLY"

    config BT_DUAL_MODE
        bool "DUAL_MODE"
endchoice

config BT_ADVANCED_FEATURE_MENU
    bool "BT Advanced Feature"
    default n

config BT_EXCLUDE_AT_COMMAND
    depends on BT_ADVANCED_FEATURE_MENU
    bool "Exclude BT AT Command"
    default n

# config BT_ZEPHYR
#     depends on BT_ADVANCED_FEATURE_MENU
#     bool "Use Zephyr BT Stack"
#     default n

config BT_EXAMPLE_DEMO_MENU
    bool "BT Example Demo"
    default n

if BT_EXAMPLE_DEMO_MENU
    config BT_PERIPHERAL_MENU
        bool "BLE Peripheral"
        default n

    config BT_CENTRAL_MENU
        bool "BLE Central"
        default n

    config BT_SCATTERNET_MENU
        bool "BLE Scatternet"
        default n

    config BT_MESH_PROVISIONER_MENU
        bool "BLE Mesh Provisioner"
        default n

    config BT_MESH_DEVICE_MENU
        bool "BLE Mesh Device"
        default n

    config BT_MESH_PROVISIONER_SCATTERNET_MENU
        bool "BLE Mesh Provisioner and BLE Scatternet"
        default n

    config BT_MESH_DEVICE_SCATTERNET_MENU
        bool "BLE Mesh Device and BLE Scatternet"
        default n

    #config BT_MESH_PROVISIONER_TEST_MENU
    #    bool "BLE Mesh Provisioner Test"
    #    default n

    #config BT_MESH_DEVICE_TEST_MENU
    #    bool "BLE Mesh Device Test"
    #    default n

    #config BT_ISO_TEST
    #    bool "BLE ISO Test"
    #    default n


    config BT_LE_AUDIO_MENU
        bool "BLE Audio"
        default n

    if BT_LE_AUDIO_MENU
        config BT_PBP_MENU
            bool "BLE Audio Public Broadcast Profile"
            default n

        config BT_TMAP_MENU
            bool "BLE Audio Telephony and Media Audio Profile"
            default n

    endif

    config BT_A2DP_MENU
        bool "BT A2DP"
        default n


    config BT_HFP_MENU
        bool "BT HFP"
        default n


    config BT_A2DP_HFP_MENU
        bool "BT A2DP and BT HFP"
        default n


    config BT_SPP_MENU
        bool "BT SPP"
        default n

    config BT_RFC_MENU
        bool "BT RFC"
        default n

    config BT_AUDIO_MP_TEST_MENU
        bool "BT Audio MP Test"
        default n


    config BT_A2DP_SCATTERNET_MENU
        bool "BT A2DP and BLE Scatternet"
        default n


    config BT_A2DP_LE_AUDIO_PBP_MENU
        bool "BT A2DP and BLE Audio PBP"
        default n


    config BT_A2DP_LE_AUDIO_TMAP_MENU
        bool "BT A2DP and BLE Audio TMAP"
        default n

endif
```
