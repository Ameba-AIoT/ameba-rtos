## amebadplus_gcc_project/Kconfig
```kconfig
mainmenu "AmebaDplus Configuration"

comment "--------MENUCONFIG FOR General---------"

#Release flag, set to y after release
config AMEBA_RLS
  def_bool y

config AMEBADPLUS
    def_bool y

#---------- FEATURE LIST START-----------#
#All features are invisible in menuconfig

config SUPPORT_SDIO_DEVICE
    def_bool y

#
# USB features
#

# USB function
config SUPPORT_USB
    def_bool y

# USB device mode only
config SUPPORT_USB_DEVICE_ONLY
    def_bool y

# USB full-speed only
config SUPPORT_USB_FS_ONLY
    def_bool y

# NO USB PHY
config SUPPORT_USB_NO_PHY
    def_bool y

# USB shared DFIFO mode
config SUPPORT_USB_SHARED_DFIFO
    def_bool y

# USB INIC device
config SUPPORT_USBD_INIC
    def_bool y

# USB UAC device
config SUPPORT_USBD_UAC
    def_bool y

config SUPPORT_HEAP_TRACE
    def_bool y

config WIFI_POWER_TABLE_USRCFG_1v8
    def_bool y

config WIFI_POWER_TABLE_USRCFG_3v3_1v25
    def_bool y

#---------- FEATURE LIST END-------------#

menu "CONFIG TrustZone"
    rsource "project_km4/Kconfig.tz"
endmenu

menu "CONFIG Memory Arch"
    config DISABLE_PSRAM
        bool "DISABLE PSRAM"
    if DISABLE_PSRAM
        config SECOND_FLASH_NOR
            bool "Second flash NOR"
    endif
endmenu

menu "CONFIG Link Option"
    choice
        prompt "IMG1(Bootloader) running on FLASH or SRAM?"
        default IMG1_FLASH
        config IMG1_FLASH
            bool "FLASH"
        config IMG1_SRAM
            bool "SRAM"
    endchoice

    choice
        prompt "IMG2(Application) running on FLASH or PSRAM?"
        default IMG2_FLASH
        config IMG2_FLASH
            bool "FLASH"
        config IMG2_PSRAM
            depends on !DISABLE_PSRAM
            bool "PSRAM"
            select PSRAM_USED
    endchoice

    choice
        prompt "IMG2 Data and Heap in SRAM or PSRAM?"
        default DATA_HEAP_SRAM
        config DATA_HEAP_SRAM
            bool "SRAM"
        config DATA_HEAP_PSRAM
            depends on !DISABLE_PSRAM
            bool "PSRAM"
            select PSRAM_USED
    endchoice

    if TRUSTZONE
        choice
            prompt "IMG3(SecureImage) running on PSRAM or SRAM?"
            default IMG3_SRAM
            config IMG3_PSRAM
                depends on !DISABLE_PSRAM
                bool "PSRAM"
                select PSRAM_USED
            config IMG3_SRAM
                bool "SRAM"
        endchoice
    endif

    config PSRAM_USED
        bool

    config PSRAM_ALL_FOR_AP_HEAP
        depends on !IMG2_PSRAM && !DATA_HEAP_PSRAM && !DISABLE_PSRAM
        bool "ALL PSRAM USED FOR APPLICATION HEAP"
        default y

endmenu


rsource "../component/at_cmd/Kconfig"

rsource "../component/soc/common/rtk_assert/Kconfig"

rsource "../component/file_system/Kconfig"

rsource "../component/os/Kconfig"

menu "CONFIG OTA OPTION"
    config UPGRADE_BOOTLOADER
        bool "Enable Bootloader OTA"
    config COMPRESS_OTA_IMG
        bool "Enable Compress APP Image"
endmenu

rsource "../component/usb/Kconfig"

menu "CONFIG APPLICATION"

    orsource "../component/ui/Kconfig"

    orsource "../component/audio/Kconfig"

    menu "AI Config"
        orsource "../component/tflite_micro/Kconfig"
        orsource "../component/aivoice/Kconfig.dplus"
    endmenu

    orsource "${RTK_APP_DIR}/Kconfig"

    orsource "../component/application/matter/project/cmake/Kconfig"

    rsource "../component/soc/common/diagnose/Kconfig"

endmenu


comment "-----Connectivity config-----"
menu "CONFIG WHC INTF"
    choice
        prompt "WHC MODE"
        # FULLMAC_MENU only run NP, WHC_HOST only run AP, other mode run both AP and NP.
        default WHC_INTF_IPC_MENU
            config WHC_INTF_IPC_MENU
                bool "WHC_IPC"
                select WHC_DEV_FOR_KM0
                select WHC_HOST_FOR_KM4
            config FULLMAC_DEV
                bool "FULLMAC_DEV"
                select WHC_DEV_FOR_KM4
            config WHC_FULLMAC_HOST
                bool "FULLMAC_HOST"
                select WHC_FULLMAC_HOST_IMPL
                select WHC_HOST_FOR_KM4
            #config WIFI_SINGLE_CORE_MENU
                # bool "Single Core"
                # select WHC_NONE_FOR_KM4
    endchoice

    if !WHC_INTF_IPC_MENU
        choice
           prompt "HW INTERFACE"
           config WHC_INTF_SDIO
                bool "WHC_INTF_SDIO"
            config WHC_INTF_USB
                bool "WHC_INTF_USB"
                select USB_DEVICE_EN
                select USBD_INIC
            config WHC_INTF_SPI
                bool "WHC_INTF_SPI"
        endchoice
    endif

    if FULLMAC_DEV
        menu "FULLMAC config"
        config WHC_CMD_PATH
            default y if FULLMAC_DEV && !WHC_INTF_USB
            bool "Support WHC CMD PATH"
        config WHC_WIFI_API_PATH
            default y if FULLMAC_DEV
            bool "Support WHC WIFI API PATH"
        config WHC_WPA_SUPPLICANT_OFFLOAD_FOR_KM4
            bool "Support WHC SUPPLICANT OFFLOAD"
        config WHC_DUAL_TCPIP_FOR_KM4
            bool "Support WHC DUAL TCPIP"
        endmenu
    endif

    if WHC_FULLMAC_HOST && !WHC_INTF_IPC_MENU
        menu "FULLMAC HOST config"
        config WHC_CMD_PATH
            default y
            bool "Support WHC CMD PATH"
        config WHC_WIFI_API_PATH
            default y
            bool "Support WHC WIFI API PATH"
        endmenu
    endif

    if FULLMAC_DEV

        menu "Debug"

        choice
            prompt "WIFI Driver Location"
            default KM4_AS_NP
            config KM0_AS_NP
                bool "KM0"
                select WHC_DEV_FOR_KM0

            config KM4_AS_NP
                bool "KM4"
                select WHC_DEV_FOR_KM4
        endchoice

        #choose WPA_STD will compile std supplicant in device side.
        choice
            prompt "WPA Supplicant STD"
            config WPA_NONE
                bool "NONE"
            config WPA_STD
                bool "STD"
        endchoice

        endmenu
    endif

    config WHC_HOST_FOR_KM4
        bool
    config WHC_DEV_FOR_KM0
        bool
    config WHC_HOST_FOR_KM0
        bool
    config WHC_DEV_FOR_KM4
        bool
    config WHC_NONE_FOR_KM4
        bool
    config WHC_WIFI_API_PATH
        bool
    config WHC_CMD_PATH
        bool
    config WHC_WPA_SUPPLICANT_OFFLOAD_FOR_KM4
        bool
    config WHC_DUAL_TCPIP_FOR_KM4
        bool
endmenu

menu "CONFIG WIFI"
    config WLAN_MENU
        bool "Enable Wifi"
        default y

    if WLAN_MENU

        choice
            depends on !AMEBA_RLS
            prompt "SDK MODE"
            default NORMAL_SDK
            config NORMAL_SDK
                bool "NORMAL_INIC"
            config ZEPHYR_SDK
                bool "ZEPHYR_INIC"
        endchoice
        orsource "../component/wifi/Kconfig.wifi"

        config WHC_INTF_IPC_MENU
            bool
            select WHC_INTF_IPC
            select WHC_WIFI_API_PATH
            select WLAN
            select LWIP_LAYER if WHC_HOST && !MP_SHRINK && !ZEPHYR_SDK
            select FW_DRIVER_COEXIST if WHC_DEV
            select ENABLE_WPS if WHC_HOST && WIFI_WPS_ENABLE_MENU
            select ENABLE_WPS_DISCOVERY if ENABLE_WPS

        config FULLMAC_DEV
            bool
            depends on WHC_DEV # only work in NP
            select WLAN
            select FW_DRIVER_COEXIST
            select WIFI_FW_EN
            select WIFI_HOST_CONTROL
            select LWIP_LAYER if WHC_DUAL_TCPIP_FOR_KM4

        config WHC_FULLMAC_HOST_IMPL
            bool
            depends on WHC_HOST
            select WLAN
            select LWIP_LAYER

        config WIFI_SINGLE_CORE_MENU # this case will never be selected
            bool
            depends on WHC_NONE
            select WLAN
            select LWIP_LAYER
            select FW_DRIVER_COEXIST
            select ENABLE_WPS if WIFI_WPS_ENABLE_MENU
            select ENABLE_WPS_DISCOVERY if ENABLE_WPS

        config WIFI_FW_EN_FOR_KM0
            depends on !FULLMAC_DEV
            bool
            default !MP_SHRINK


    endif
    if !WLAN_MENU
        config WLAN_DISABLE
            bool
            select AS_INIC_AP if WHC_HOST
            select AS_INIC_NP if WHC_DEV
    endif

    config WLAN
        bool
    config WHC_INTF_IPC
        bool
    config AS_INIC_NP
        bool
    config AS_INIC_AP
        bool
    config LWIP_LAYER
        bool
    config FW_DRIVER_COEXIST
        bool
    config WHC_INTF_SDIO
        bool
    config WHC_INTF_SPI
        bool
    config WHC_INTF_USB
        bool
    config WIFI_FW_EN
        bool
    config ENABLE_WPS
        bool
    config ENABLE_WPS_DISCOVERY
        bool
    config FULLMAC_HOST
        bool
    config WIFI_HOST_CONTROL
        bool
    config WHC_FULLMAC_HOST_IMPL
        bool

endmenu

menu "CONFIG BT"
    config  BT_MENU
        bool "Enable BT"

    if BT_MENU
        # IC BT capability
        config BT_HAS_MESH
            def_bool y

        rsource "../component/bluetooth/Kconfig.inic"

        if !BT_INIC
            rsource "../component/bluetooth/Kconfig"
        endif

        config BT
            def_bool WHC_HOST || WHC_NONE || (FULLMAC_DEV && WHC_DEV)
            select FTL_ENABLED

        config FTL_ENABLED
            bool

        config BT_ENABLE_FAST_MP
            def_bool MP_INCLUDED && !BT_INIC

    endif
endmenu

rsource "../component/lwip/Kconfig"

rsource "../component/ssl/Kconfig"

orsource "../component/wpan/Kconfig"

rsource "../component/rtk_coex/Kconfig.coex"

if !AMEBA_RLS
comment "---------Test Config---------"

menu "Verification and Test"
    rsource "../component/soc/amebadplus/Kconfig"
endmenu
endif

comment "--------Build Config---------"
menu "Build Option"

config FPGA
    bool "Select FPGA"
    depends on !AMEBA_RLS

comment "Choose the build configuration"
    choice
        prompt "Link ROM Mode"
        default LINK_ROM_SYMB
        config LINK_ROM_LIB
            bool "Link_ROM_Library"

        config LINK_ROM_SYMB
            bool "Link_ROM_Symbol"
    endchoice
endmenu

comment "----end of MENUCONFIG FOR General------"

menu "MENUCONFIG FOR KM0 CONFIG"
    rsource "project_km0/Kconfig"
endmenu


menu "MENUCONFIG FOR KM4 CONFIG"
    rsource "project_km4/Kconfig"
endmenu

comment "----- DO NOT ENTER IN THIS BUTTON ------"
menu "MENUCONFIG FOR Private"
config WHC_HOST
    bool "--DO NOT CHOOSE THIS CONFIG--"
config WHC_DEV
    bool "--DO NOT CHOOSE THIS CONFIG--"
config WHC_NONE
    bool "--DO NOT CHOOSE THIS CONFIG--"
endmenu
```

## amebadplus_gcc_project/Kconfig.bt
```kconfig
choice
    depends on FULLMAC_MENU
    prompt "HCI Mode"
    default BT_INIC_SHARE
    config BT_INIC_SHARE
        bool "Share interface with WiFi"
    config BT_INIC_H4
        bool "UART H4"
    config BT_INIC_H5
        bool "UART H5"
    config BT_INIC_NONE
        bool "Internal"
endchoice

# set this to 'y' to debug BT inic without WiFi fullmac
config BT_INIC_DEBUG
    bool
    default n

choice
    depends on BT_INIC_DEBUG && !FULLMAC_MENU
    prompt "iNIC debug Interface"
    default BT_INICD_H4
    config BT_INICD_H4
        bool "UART H4"
    config BT_INICD_H5
        bool "UART H5"
    config BT_INICD_SPI
        bool "SPI"
    config BT_INICD_SDIO
        bool "SDIO"
endchoice

config BT_INIC
    depends on BT_INIC_SHARE || BT_INIC_H4 || BT_INIC_H5 || BT_INIC_DEBUG
    bool
    default y

if !BT_INIC

    config BT_ADVANCED_FEATURE_MENU
        bool "BT Advanced Feature"
        default n

    config BT_EXCLUDE_AT_COMMAND
        depends on BT_ADVANCED_FEATURE_MENU
        bool "Exclude BT AT Command"
        default n

    config BT_MESH_BASED_ON_CODED_PHY
        depends on BT_ADVANCED_FEATURE_MENU
        bool "Enable BT Mesh Based on CODED PHY"
        default n

    # config BT_ZEPHYR
    #     depends on BT_ADVANCED_FEATURE_MENU
    #     bool "Use Zephyr BT Stack"
    #     default n

    config BT_EXAMPLE_DEMO_MENU
        bool "BT Example Demo"
        default n

    if BT_EXAMPLE_DEMO_MENU
        config BT_PERIPHERAL_MENU
            bool "BLE Peripheral"
            default n

        config BT_CENTRAL_MENU
            bool "BLE Central"
            default n

        config BT_SCATTERNET_MENU
            bool "BLE Scatternet"
            default n

        # config BT_THROUGHPUT
        #     bool "BLE Throughput"
        #     default n

        config BT_TRANSFER_MODULE_MENU
            bool "BLE Transfer Module"
            default n

        config BT_MESH_PROVISIONER_MENU
            bool "BLE Mesh Provisioner"
            default n

        config BT_MESH_DEVICE_MENU
            bool "BLE Mesh Device"
            default n

        config BT_MESH_PROVISIONER_SCATTERNET_MENU
            bool "BLE Mesh Provisioner and BLE Scatternet"
            default n

        config BT_MESH_DEVICE_SCATTERNET_MENU
            bool "BLE Mesh Device and BLE Scatternet"
            default n

    endif
endif
```
