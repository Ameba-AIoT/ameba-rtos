## amebadplus_gcc_project/project_km4/asdk/Kconfig
```kconfig
comment "----------CPU config----------"

menu "CONFIG CHIP"
    comment "Target Platform Selection"
    comment "Choose a Vendor/Product combination"
    choice 
        prompt "Product"
        default AMEBADPLUS_FOR_KM4
        config AMEBADPLUS_FOR_KM4
            bool "AMEBADPLUS"
    endchoice

    choice
        prompt "ArmCore" 
        default ARM_CORE_CM4_FOR_KM4 
        config ARM_CORE_CM4_FOR_KM4
            bool "ARM_CM4"
    endchoice
    
    config FPGA_FOR_KM4
        bool "Select FPGA"

    choice 
        prompt "Chip Version"
        default AMEBADPLUS_B_CUT_FOR_KM4
        config AMEBADPLUS_A_CUT_FOR_KM4
            bool "AMEBADPLUS_A_Cut"
        config AMEBADPLUS_B_CUT_FOR_KM4
            bool "AMEBADPLUS_B_Cut"
    endchoice
endmenu

comment "----------OS config----------"

menu "CONFIG OS"
    config KERNEL_FOR_KM4 
        bool "Enable Kernel"
        default y 
    
    if KERNEL_FOR_KM4
        choice
            prompt "Kernel Selecte"
            default PLATFORM_FREERTOS_FOR_KM4
            config PLATFORM_FREERTOS_FOR_KM4
                bool "FREERTOS"
        endchoice

        config TASK_SCHEDULER_DISABLED_FOR_KM4 
            int
            default 0
    endif

endmenu 

comment "----------Peripheral config----------"

menu "CONFIG USB"
    config USB_DEVICE_EN_FOR_KM4 
        bool "Enable USB Device"
        default n 
    if USB_DEVICE_EN_FOR_KM4
        config USBD_CDC_ACM_FOR_KM4
            bool "CDC ACM"
        config USBD_COMPOSITE_FOR_KM4
            bool "Composite"
        config USBD_HID_FOR_KM4
            bool "HID"
        config USBD_VENDOR_FOR_KM4
            bool "Vendor"
        config USBD_INIC_FOR_KM4
            bool "INIC"
    endif
endmenu

comment "----------Peripheral Test----------"
menu "CONFIG FUNCTION TEST"
    config PER_TEST_FOR_KM4
        bool "Enable Peripheral Test"
    if PER_TEST_FOR_KM4
        config SYS_VERIFY_FOR_KM4
            bool "System_Verify_Mode"
        if SYS_VERIFY_FOR_KM4
            choice 
                prompt "System Verify Type"
                config FT_FOR_KM4
                    bool "FT_Test"
                config EQC_FOR_KM4
                    bool "EQC_Test"
                config QA_FOR_KM4
                    bool "QA_Test"
                config OLT_FOR_KM4
                    bool "OLT_Test"
                config EMC_FOR_KM4
                    bool "EMC_Test"
                config CORNER_FOR_KM4
                    bool "Corner_Test"
                config SIMULATION_FOR_KM4
                    bool "IMG_SIM"
            endchoice
        endif 
        config WIFI_FW_VERIFY_FOR_KM4 
        bool "WIFI FW Test"		
        config DBGPORT_VERIFY_FOR_KM4 
        bool "DBGPORT_Verify_Mode"	
        config TIMER_VERIFY_FOR_KM4 
        bool "Timer_Verify_Mode"	
        config PRS_VERIFY_FOR_KM4 
        bool "PRS_Verify_Mode"		
        config WDG_VERIFY_FOR_KM4 
        bool "WDG_Verify_Mode"		
        config TRNG_VERIFY_FOR_KM4 
        bool "TRNG_Verify_Mode"		
        config GDMA_VERIFY_FOR_KM4 
        bool "Gdma_Verify_Mode"		
        config GPIO_VERIFY_FOR_KM4 
        bool "GPIO_Verify_Mode"		
        config PINMUX_VERIFY_FOR_KM4 
        bool "PINMUX_Verify_Mode"      
        config ZB_INT_VERIFY_FOR_KM4 
        bool "ZB_INT_Verify_Mode"	
        config SPI_COM_VERIFY_FOR_KM4 
        bool "SPI_COM_Verify_Mode"	
        config UART_VERIFY_FOR_KM4 
        bool "UART_Verify_Mode"		
        config LCDC_VERIFY_FOR_KM4 
        bool "LCDC_Verify_Mode"		
        config LEDC_VERIFY_FOR_KM4 
        bool "LEDC_Verify_Mode"		
        config I2C_VERIFY_FOR_KM4 
        bool "I2C_Verify_Mode"		
        config PMC_VERIFY_FOR_KM4 
        bool "PMC_Verify_Mode"		
        config SGPIO_VERIFY_FOR_KM4 
        bool "SGPIO_Verify_Mode"	
        config PSRAM_VERIFY_FOR_KM4 
        bool "PSRAM_Verify_Mode"	
        config AUDIO_VERIFY_FOR_KM4 
        bool "AUDIO_Verify_Mode"	
        if AUDIO_VERIFY_FOR_KM4
            choice 
                prompt "AUDIO Verify Type"
                config AUDIO_SNR_VERIFY_FOR_KM4 
                    bool "AUDIO_SNR_VERIFY"
            endchoice
        endif 
        config SOC_PS_VERIFY_FOR_KM4 
        bool "SOC_PS_Verify_Mode"	
        config CRYPTO_VERIFY_FOR_KM4 
        bool "Crypto_Verify_Mode"	
        config EFUSE_VERIFY_FOR_KM4 
        bool "EFUSE_Verify_Mode"	
        config SPIC_VERIFY_FOR_KM4 
        bool "SPIC_Verify_Mode"		
        if SPIC_VERIFY_FOR_KM4
            choice 
                prompt "SPIC Verify Type"
                config MCM_MEM_VERIFY_FOR_KM4 
                    bool "MCM_MEMORY_VERIFY"   
            endchoice
        endif
        config FTL_VERIFY_FOR_KM4 
        bool "FTL_Verify_Mode"		
        config ADC_VERIFY_FOR_KM4 
        bool "ADC_Verify_Mode"		
        config CAPTOUCH_VERIFY_FOR_KM4 
        bool "CapTouch_Verify_Mode"	
        config THERMAL_VERIFY_FOR_KM4 
        bool "Thermal_Verify_Mode"	
        config RSIP_VERIFY_FOR_KM4 
        bool "RSIP_Verify_Mode"		
        config SDIO_DEVICE_VERIFY_FOR_KM4 
        bool "SDIO_DEVICE_Verify_Mode"	
        config SDIOH_VERIFY_FOR_KM4 
        bool "SDIO_HOST_Verify_Mode"	
        config CHIP_RST_VERIFY_FOR_KM4 
        bool "chip_reset_verify"		
        config DBG_TIMER_VERIFY_FOR_KM4  
        bool "debugtimer_verify"		
        config DHRYSTONE_TEST_FOR_KM4 
        bool "Dhrystone Test"		
        config PERFORMANCE_VERIFY_FOR_KM4 
        bool "Performance_Verify_Mode"		
        config RTLIB_VERIFY_FOR_KM4 
        bool "RTLIB ROM Test"		
        config IPC_VERIFY_FOR_KM4 
        bool "IPC Test"			
        config IR_VERIFY_FOR_KM4 
        bool "IR Test"			
        config MPU_VERIFY_FOR_KM4 
        bool "MPU Test"			
        config CACHE_VERIFY_FOR_KM4 
        bool "CACHE Test"		
        config WFE_VERIFY_FOR_KM4 
        bool "WFE Test"			
        config DDR_VERIFY_FOR_KM4 
        bool "DDR Test"			
        config RSA_VERIFY_FOR_KM4 
        bool "RSA Test"			
        config ECDSA_VERIFY_FOR_KM4 
        bool "ECDSA Test"		
        config ED25519_VERIFY_FOR_KM4 
        bool "ED25519 Test"		
        config SPINAND_VERIFY_FOR_KM4 
        bool "SpiNand Test"		
        config LOGUART_VERIFY_FOR_KM4 
        bool "LOGUART Test"		
        config KEYSCAN_VERIFY_FOR_KM4 
        bool "KeyScan Test"		
        config SDM_VERIFY_FOR_KM4 
        bool "SDM Test"			
        config PPE_VERIFY_FOR_KM4 
        bool "PPE Test"			
        config QSPI_VERIFY_FOR_KM4 
        bool "QSPI Test"		
        config MEMORY_VERIFY_FOR_KM4 
        bool "Memory Test"		
        config AF_VERIFY_FOR_KM4 
        bool "AF Test"			
        config MBEDTLS_VERIFY_FOR_KM4 
        bool "mbedtls Test"		
        config FLASH_AVL_FOR_KM4  
        bool "Flash_AVL"       
        config USBD_VERIFY_FOR_KM4 
        bool "USB Test"			
        config WIFI_VERIFY_FOR_KM4 
        bool "WIFI Test"        
        if WIFI_VERIFY_FOR_KM4
            choice 
                prompt "WIFI Verify Type"         
                config WIFI_VERIFY_ASIC_FOR_KM4  
                bool "WIFI_ASIC"
                config MAC_LBK_FOR_KM4  
                bool "WIFI_MAC_LBK"
                config WIFI_VERIFY_PSPHY_FOR_KM4 
                bool "WIFI_2MAC_WITH_PSPHY"
                config WIFI_VERIFY_TRUEPHY_FOR_KM4  
                bool "WIFI_2MAC_WITH_TUREPHY"
            endchoice
        endif
    endif

endmenu

comment "----------Secure Test----------"
menu "CONFIG SECURE TEST"
    config SEC_VERIFY_FOR_KM4
        bool "SEC_Verify_Mode"
    if SEC_VERIFY_FOR_KM4
        config CACHE_SEC_VERIFY_FOR_KM4 
            bool "CACHE Secure Test"	
        config EFUSE_SEC_VERIFY_FOR_KM4
            bool "EFUSE Secure Test"	
        config GDMA_SEC_VERIFY_FOR_KM4 
            bool "GDMA Secure Test"		
        config AES_SEC_VERIFY_FOR_KM4
            bool "AES Secure Test"
        config CRYPTO_SEC_VERIFY_FOR_KM4	
            bool "Crypto Secure Test"	
        config CRC_SEC_VERIFY_FOR_KM4
            bool "CRC Secure Test"		
        config RDP_SEC_VERIFY_FOR_KM4
            bool "RDP Secure Test"		
        config WDG_SEC_VERIFY_FOR_KM4
            bool "WDG Secure Test"		
        config TRNG_SEC_VERIFY_FOR_KM4
            bool "TRNG Secure Test"		
        config TIMER_SEC_VERIFY_FOR_KM4
            bool "TIMER Secure Test"	
        config DBGTIM_SEC_VERIFY_FOR_KM4
            bool "DBGTIM Secure Test"	
        config GPIO_SEC_VERIFY_FOR_KM4
            bool "GPIO Secure Test"		
        config RTC_SEC_VERIFY_FOR_KM4
            bool "RTC Secure Test"		
        config ADC_SEC_VERIFY_FOR_KM4
            bool "ADC Secure Test"		
        config THERMAL_SEC_VERIFY_FOR_KM4
            bool "THERMAL Secure Test"	
        config LCDC_SEC_VERIFY_FOR_KM4
            bool "LCDC Secure Test"		
        config LOG_UART_SEC_VERIFY_FOR_KM4
            bool "LOG_UART_Secure_TEST"	
        config UART_SEC_VERIFY_FOR_KM4
            bool "UART_Secure_TEST"		
        config SPI_SEC_VERIFY_FOR_KM4
            bool "SPI_Secure_TEST"		
        config I2C_SEC_VERIFY_FOR_KM4
            bool "I2C_Secure_TEST"		
        config EDDSA_SEC_VERIFY_FOR_KM4
            bool "EDDSA Secure Test"	
        config ECDSA_SEC_VERIFY_FOR_KM4
            bool "ECDSA Secure Test"	
        config RSA_SEC_VERIFY_FOR_KM4
            bool "RSA Secure Test"		
        config LEDC_SEC_VERIFY_FOR_KM4
            bool "LEDC Secure Test"		
        config IRDA_SEC_VERIFY_FOR_KM4
            bool "IRDA Secure Test"		
        config TZ_SEC_VERIFY_FOR_KM4
            bool "Trustzone Secure Test"		
        config AUDIO_SEC_VERIFY_FOR_KM4
            bool "AUDIO Secure Test"	
        config KEYSCAN_SEC_VERIFY_FOR_KM4
            bool "KEYSCAN Secure Test"	    
    endif

endmenu

comment "----------Application Config----------"
menu "LWIP Config"
    config IP_NAT_FOR_KM4
        bool "NAT REPEATER Enable"
        default n 
endmenu

menu "SSL Config"
    config USE_MBEDTLS_ROM_FOR_KM4
        bool 
        default y 
    config MBED_TLS_ENABLED_FOR_KM4
        bool "MBEDTLS Enable"
        default y 
    config SSL_ROM_TEST_FOR_KM4
        bool "SSL ROM Test"
        default n
endmenu

menu "802154 Config"
    config 802154_EN_FOR_KM4
        bool "Enable 802154"
        default n 
    if 802154_EN_FOR_KM4
        if !MBED_TLS_ENABLED_FOR_KM4
            comment "Must Enable MBEDTLS Before Enable THREAD"
        endif
        if MBED_TLS_ENABLED_FOR_KM4
            config 802154_THREAD_EN_FOR_KM4
                depends on !802154_PLATFORM_TEST_EN_FOR_KM4
                bool "Enable THREAD" 
                default n 
            choice 
                depends on 802154_THREAD_EN_FOR_KM4
                prompt "THREAD ROLE"
                config 802154_THREAD_BORDER_ROUTER_EN_FOR_KM4
                    bool "BORDER_ROUTER"
                config 802154_THREAD_FTD_EN_FOR_KM4
                    bool "FTD"
                config 802154_THREAD_MTD_EN_FOR_KM4
                    bool "MTD"
            endchoice
            config 802154_THREAD_LLF_TEST_EN_FOR_KM4
                bool "Low Layer Function Test"
                default n 
        endif
        config 802154_PLATFORM_TEST_EN_FOR_KM4
            bool "Enable 802154 Platform Test"
            default n
        
    endif
     
endmenu

menu "GUI Config"
    config GUI_EN_FOR_KM4
        bool "Enable GUI"
        default n 
    config LVGL_EN_FOR_KM4
        depends on GUI_EN_FOR_KM4
        bool "LVGL"
        default n 
endmenu

menu "Audio Config"
    config AUDIO_FWK_FOR_KM4 
        bool "Enable Audio Framework"
        default n 
    if AUDIO_FWK_FOR_KM4
        choice 
            prompt "Select Audio Interfaces"
            default AUDIO_PASSTHROUGH_FOR_KM4 if (WIFI_AUDIO_FOR_KM4||WFA_SRC_FOR_KM4)
            config AUDIO_MIXER_FOR_KM4
                bool "Mixer"
            config AUDIO_PASSTHROUGH_FOR_KM4
                bool "PassThrough"
        endchoice
    endif

    menu "Third Party Lib"
        config SPEEX_LIB_FOR_KM4 
            bool "Speex"
            default n
        config OPUS_LIB_FOR_KM4
            bool "OPUS"
            default n 
    endmenu

endmenu

menu "IMQ Config"
    config IMQ_EN_FOR_KM4
        bool "Enable IMQ"
        default n
endmenu

menu "Wifi Audio Config"
    config WIFI_AUDIO_FOR_KM4
        bool "Enable WIFI AUDIO"
        default n 
    config WFA_SRC_FOR_KM4
        bool "Enable WFA SRC"
        default n 
    if WIFI_AUDIO_FOR_KM4||WFA_SRC_FOR_KM4
        config AUDIO_FWK_FOR_KM4 
            bool 
            default y 
        # config AUDIO_PASSTHROUGH_FOR_KM4
        #     bool 
        #     default y 
        config WFA_FEC_USE_SRAM_FOR_KM4
            bool "Enable FEC USE SRAM"
            default n
    endif

endmenu
#===========================================================================
# Normal: Build all code, includes ROM code. Normally for FPGA verification.
# Release: Build user application code and link with ROM + RAM libraries.
# Build_ROM_Lib: Build the ROM code library only.
# Build_RAM_Lib: Build the RAM code library only.
# Build_RAM_All: Build all RAM code, includes user application, and link with ROM library.

comment "----------Build Config----------"
menu "Build Option"
comment "Select toolchain"
    choice
        prompt"Toolchain"
        default TOOLCHAIN_ASDK_FOR_KM4
        config TOOLCHAIN_ASDK_FOR_KM4
            bool "ASDK"

        config TOOLCHAIN_ARM_GCC_FOR_KM4
            bool "ARM_GCC"
    endchoice

comment "Choose the build configuration"
    choice 
        prompt "Link ROM Mode"
        default LINK_ROM_LIB_FOR_KM4
        config LINK_ROM_LIB_FOR_KM4
            bool "Link_ROM_Library"

        config LINK_ROM_SYMB_FOR_KM4
            bool "Link_ROM_Symbol"
    endchoice
endmenu
```

## amebadplus_gcc_project/project_km4/asdk/make_secure/Kconfig
```kconfig
config TRUSTZONE_FOR_KM4
    bool "Enable TrustZone"
    default n 
    help
        Configurations for trustzone
if TRUSTZONE_FOR_KM4
    choice 
        prompt "TrustZone by RDP or TFM"
        default RDP_BASIC_FOR_KM4
        help
            Select trustzone type
        config RDP_BASIC_FOR_KM4 
            bool "RDP_BASIC"

        config RDP_TFM_FOR_KM4
            bool "RDP_TFM"

    endchoice

    config TRUSTZONE_EN_FOR_KM4 
        bool 
        default y 
    
    if RDP_TFM_FOR_KM4
        config TFM_TEST_ENABLE_FOR_KM4 
            bool "TFM Test Suite Enable" 
            default n 
    endif

    if TFM_TEST_ENABLE_FOR_KM4
        choice
            prompt "TFM Test Suite Select"
            config TFM_TEST_REGRESSION_FOR_KM4
                bool "Regression_Tests"

            config TFM_TEST_PSA_API_FOR_KM4
                bool "PSA_API_Tests"
        endchoice

        if TFM_TEST_REGRESSION_FOR_KM4
            config TFM_TEST_S_FOR_KM4
                bool "TFM secure regression tests"
            config TFM_TEST_NS_FOR_KM4
                bool "TFM non-secure regression tests"	
        endif

        if TFM_TEST_PSA_API_FOR_KM4 
            choice 
                prompt "TEST_PSA_API Select"
                config TEST_PSA_API_STORAGE_FOR_KM4 
                    bool "STORAGE"

                config TEST_PSA_API_CRYPTO_FOR_KM4 
                    bool "CRYPTO"

                config TEST_PSA_API_INITIAL_ATTESTATION_FOR_KM4
                    bool "INITIAL_ATTESTATION"
            endchoice
        endif
    endif
endif
```
