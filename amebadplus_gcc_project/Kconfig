## amebagreen2_gcc_project/Kconfig
```kconfig
mainmenu "${RTK_SOC_NAME} Configuration"

comment "--------MENUCONFIG FOR General---------"

#Release flag, set to y after release
config AMEBA_RLS
  def_bool y

config AMEBAGREEN2
    def_bool y

#---------- FEATURE LIST START-----------#
#All features are invisible in menuconfig

config SUPPORT_NAND_FLASH
    def_bool y

config SUPPORT_FATFS_USB
    def_bool y

config SUPPORT_SDIO_DEVICE
    def_bool y

config SUPPORT_SDIOH
    def_bool y

config SUPPORT_SD_CARD
    def_bool y

config SUPPORT_USB
    def_bool y

config SUPPORT_USBD_INIC
    def_bool y

config SUPPORT_USBD_UAC
    def_bool y

config SUPPORT_USBH_UAC
    def_bool y

config SUPPORT_USBH_ECM
    def_bool y

config SUPPORT_HEAP_TRACE
    def_bool y

#---------- FEATURE LIST END-------------#

menu "CONFIG TrustZone"
    config TRUSTZONE
        bool "Enable TrustZone"
    config TRUSTZONE_EN
        depends on TRUSTZONE
        bool
        default y
endmenu

menu "CONFIG Memory Arch"
    config SECOND_FLASH_NOR
        bool "Second flash NOR"
    if !SECOND_FLASH_NOR
        config SECOND_FLASH_NAND
            bool "Second flash NAND"
        endif
endmenu

menu "CONFIG Link Option"
    choice
        prompt "IMG1(Bootloader) running on FLASH or SRAM?"
        default IMG1_FLASH
        config IMG1_FLASH
            bool "FLASH"
        config IMG1_SRAM
            bool "SRAM"
    endchoice

    choice
        prompt "IMG2(Application) running on FLASH, SRAM, or PSRAM?"
        default IMG2_FLASH
        config IMG2_FLASH
            bool "FLASH"
        config IMG2_SRAM
            bool "SRAM"
        config IMG2_PSRAM
            bool "PSRAM"
            select PSRAM_USED
    endchoice

    choice
        prompt "IMG2 Data and Heap in SRAM or PSRAM?"
        default DATA_HEAP_SRAM
        config DATA_HEAP_SRAM
            bool "SRAM"
        config DATA_HEAP_PSRAM
            bool "PSRAM"
            select PSRAM_USED
    endchoice

    if TRUSTZONE
        choice
            prompt "IMG3(SecureImage) running on SRAM, PSRAM or FLASH?"
            default IMG3_SRAM
            config IMG3_PSRAM
                bool "PSRAM"
                select PSRAM_USED
            config IMG3_SRAM
                bool "SRAM"
            config IMG3_FLASH
                bool "FLASH"
        endchoice
    endif

    config PSRAM_ALL_FOR_AP_HEAP
        depends on !IMG2_PSRAM && !DATA_HEAP_PSRAM
        depends on !WIFI_HOST_CONTROL # FULLMAC_DEV does not support PSRAM for now
        bool "ALL PSRAM USED FOR APPLICATION HEAP"
        default y

    config PSRAM_USED
        bool
endmenu

menu "CONFIG Mass Production"
    config MP_INCLUDED
        bool "Enable MP"
    if MP_INCLUDED
        choice
            prompt "MP Mode"
            default MP_SHRINK
            config MP_EXPAND
                bool "expand"
            config MP_SHRINK
                bool "shrink"
        endchoice
    endif
endmenu

rsource "../component/at_cmd/Kconfig"

rsource "../component/soc/common/rtk_assert/Kconfig"

rsource "../component/file_system/Kconfig"

rsource "../component/os/Kconfig"

orsource "../component/utils/Kconfig"


menu "CONFIG OTA OPTION"
    config UPGRADE_BOOTLOADER
        bool "Enable Bootloader OTA"
    config COMPRESS_OTA_IMG
        bool "Enable Compress APP Image"
endmenu

rsource "../component/usb/Kconfig"

menu "CONFIG APPLICATION"

    orsource "../component/ui/Kconfig"

    orsource "../component/audio/Kconfig"

    orsource "../component/application/Kconfig"

    orsource "${RTK_APP_DIR}/Kconfig"

    rsource "../component/soc/common/diagnose/Kconfig"

endmenu


comment "-----Connectivity config-----"

menu "CONFIG WHC INTF"
    choice
        prompt "WHC MODE"
        default WHC_INTF_IPC_MENU
            config WHC_INTF_IPC_MENU
                bool "WHC_IPC"
                select WHC_INTF_IPC
            config WIFI_SINGLE_CORE_MENU
                bool "SINGLE CORE"
            config FULLMAC_DEV
                bool "FULLMAC_DEV"
                select WIFI_HOST_CONTROL
                select WHC_DEV_FOR_KM4TZ
            config WHC_FULLMAC_HOST
                bool "FULLMAC_HOST"
                select WHC_FULLMAC_HOST_IMPL
                select WHC_HOST_FOR_KM4TZ

    endchoice

    if !WHC_INTF_IPC_MENU && !WIFI_SINGLE_CORE_MENU
        choice
           prompt "HW INTERFACE"
           config WHC_INTF_SDIO
                bool "WHC_INTF_SDIO"
            config WHC_INTF_USB
                bool "WHC_INTF_USB"
                select USB_HAL_LIB
                select USB_DEVICE_EN
                select USBD_INIC
            config WHC_INTF_SPI
                bool "WHC_INTF_SPI"
            config WHC_INTF_UART
                bool "WHC_INTF_UART"
        endchoice
    endif

    if FULLMAC_DEV
        menu "FULLMAC config"
        config WHC_CMD_PATH
            default y if FULLMAC_DEV
            bool "Support WHC CMD PATH"
        config WHC_WIFI_API_PATH
            default y if FULLMAC_DEV
            bool "Support WHC WIFI API PATH"
        config WHC_WPA_SUPPLICANT_OFFLOAD_FOR_KM4TZ
            bool "Support WHC SUPPLICANT OFFLOAD"
        config WHC_DEV_TCPIP_KEEPALIVE_FOR_KM4TZ
            bool "Support WHC DEV TCPIP KEEPALIVE"
        config FULLMAC_IN_SINGLE_DIE
            bool "Support Download to SRAM Only"
        endmenu
    endif

    if WHC_FULLMAC_HOST && !WHC_INTF_IPC_MENU
        menu "FULLMAC HOST config"
        config WHC_CMD_PATH
            default y
            bool "Support WHC CMD PATH"
        config WHC_WIFI_API_PATH
            default y
            bool "Support WHC WIFI API PATH"
        endmenu
    endif

    if FULLMAC_DEV && WHC_WPA_SUPPLICANT_OFFLOAD_FOR_KM4TZ

        menu "WPA Mode"

        #choose WPA_STD will compile std supplicant in device side.
        choice
            prompt "WPA Mode Selection"
            config WPA_LITE
                bool "WPA LITE"
            config WPA_STD
                bool "WPA Supplicant STD"
        endchoice

        if WPA_STD

            orsource "../component/wifi/wpa_supplicant/wpa_supplicant_std/Kconfig"

        endif

        menu "RTW CLI"
        config RTW_CLI
            bool "Support RTW_CLI"
        endmenu

        endmenu
    endif

    if WHC_INTF_IPC_MENU || WIFI_SINGLE_CORE_MENU
        choice
            prompt "Select AP Core"
            default KM4TZ_AS_AP
            config KM4TZ_AS_AP
                bool "KM4TZ"
                select WHC_HOST_FOR_KM4TZ if WHC_INTF_IPC_MENU
                select WHC_DEV_FOR_KM4NS if WHC_INTF_IPC_MENU
                select WHC_NONE_FOR_KM4TZ if WIFI_SINGLE_CORE_MENU
            config KM4NS_AS_AP
                bool "KM4NS"
                select WHC_HOST_FOR_KM4NS if WHC_INTF_IPC_MENU
                select WHC_DEV_FOR_KM4TZ if WHC_INTF_IPC_MENU
                select WHC_NONE_FOR_KM4NS if WIFI_SINGLE_CORE_MENU
        endchoice
    endif


    config WHC_HOST_FOR_KM4TZ
        bool
    config WHC_DEV_FOR_KM4NS
        bool
    config WHC_HOST_FOR_KM4NS
        bool
    config WHC_DEV_FOR_KM4TZ
        bool
    config WHC_NONE_FOR_KM4TZ
        bool
    config WHC_WIFI_API_PATH
        bool
endmenu

menu "CONFIG WIFI"
    config WLAN_MENU
        bool "Enable Wifi"
        default y
    if WLAN_MENU
        rsource "../component/wifi/Kconfig.wifi"

        config WHC_INTF_IPC_MENU
            bool
            select WHC_WIFI_API_PATH
            select WLAN
            select LWIP_LAYER if WHC_HOST && !MP_SHRINK && !PLATFORM_ZEPHYR
            select FW_DRIVER_COEXIST if WHC_DEV
            select ENABLE_WPS if WHC_HOST && WIFI_WPS_ENABLE_MENU
            select ENABLE_WPS_DISCOVERY if ENABLE_WPS

        config FULLMAC_DEV
            bool
            depends on WHC_DEV
            select WLAN
            select FW_DRIVER_COEXIST
            select WIFI_FW_EN if !MP_SHRINK
            select LWIP_LAYER if WHC_DEV_TCPIP_KEEPALIVE_FOR_KM4TZ

        config WHC_FULLMAC_HOST_IMPL
            bool
            depends on WHC_HOST
            select WLAN
            select LWIP_LAYER

        config WIFI_SINGLE_CORE_MENU
            bool
            depends on WHC_NONE
            select WLAN
            select LWIP_LAYER
            select WIFI_FW_EN
            select FW_DRIVER_COEXIST
            select ENABLE_WPS if WIFI_WPS_ENABLE_MENU
            select ENABLE_WPS_DISCOVERY if ENABLE_WPS

        config WIFI_FW_EN_FOR_KM4NS
            depends on !FULLMAC_DEV
            bool
            default !MP_SHRINK
    endif

    config WLAN
        bool
    config WHC_INTF_IPC
        bool
    config LWIP_LAYER
        bool
    config FW_DRIVER_COEXIST
        bool
    config WHC_INTF_SDIO
        bool
    config WHC_INTF_SPI
        bool
    config WHC_INTF_USB
        bool
    config WIFI_FW_EN
        bool
    config ENABLE_WPS
        bool
    config ENABLE_WPS_DISCOVERY
        bool
    config FULLMAC_HOST
        bool
    config WIFI_HOST_CONTROL
        bool
    config WHC_FULLMAC_HOST_IMPL
        bool
endmenu

menu "CONFIG BT"
    config  BT_MENU
        bool "Enable BT"

    if BT_MENU
        # IC BT capability
        config BT_HAS_MESH
            def_bool y

        rsource "../component/bluetooth/Kconfig.inic"

        if !BT_INIC
            rsource "../component/bluetooth/Kconfig"
        endif

        config BT
            def_bool WHC_HOST || WHC_NONE || (FULLMAC_DEV && WHC_DEV)
            select FTL_ENABLED

        config FTL_ENABLED
            bool

    endif
endmenu


menu "CONFIG ETHERNET"
    config ETHERNET
        bool "Enable ETHERNET"
		default n
        select ETHERNET_RMII

    config ETHERNET_RMII
        bool

	if ETHERNET
		choice
			prompt "PHY SOURCE CLK"
			default MAC_OUTPUT_50M
			config MAC_OUTPUT_50M
				bool "external 50M"
			config MAC_OUTPUT_25M
				bool "external 25M"
			config PHY_INT_XTAL
				bool "internal xtal"
		endchoice
	endif
endmenu

rsource "../component/lwip/Kconfig"

rsource "../component/ssl/Kconfig"

orsource "../component/wpan/Kconfig"

rsource "../component/rtk_coex/Kconfig.coex"

if !AMEBA_RLS
comment "---------Test Config---------"

menu "Verification and Test"
    rsource "../component/soc/amebagreen2/Kconfig"
endmenu
endif

comment "--------Build Config---------"
menu "Build Option"

config FPGA
    bool "Select FPGA"
    depends on !AMEBA_RLS

choice
    prompt "Chip Version"
    default AMEBAGREEN2_B_CUT
    config AMEBAGREEN2_A_CUT
        bool "AMEBAGREEN2_A_Cut"

    config AMEBAGREEN2_B_CUT
        bool "AMEBAGREEN2_B_Cut"
endchoice

comment "Choose the build configuration"
    choice
        prompt "Link ROM Mode"
        default LINK_ROM_SYMB
        config LINK_ROM_LIB
            bool "Link_ROM_Library"

        config LINK_ROM_SYMB
            bool "Link_ROM_Symbol"
    endchoice
endmenu

comment "----end of MENUCONFIG FOR General------"

menu "MENUCONFIG FOR KM4TZ CONFIG"
    rsource "project_km4tz/Kconfig"
endmenu

menu "MENUCONFIG FOR KM4NS CONFIG"
    rsource "project_km4ns/Kconfig"
endmenu


comment "----- DO NOT ENTER IN THIS BUTTON ------"
menu "MENUCONFIG FOR Private"
config WHC_HOST
    bool "--DO NOT CHOOSE THIS CONFIG--"
config WHC_DEV
    bool "--DO NOT CHOOSE THIS CONFIG--"
config WHC_NONE
    bool "--DO NOT CHOOSE THIS CONFIG--"
endmenu
```

## amebagreen2_gcc_project/project_km4ns/Kconfig
```kconfig
comment "----------CPU config----------"

menu "CONFIG CHIP"
    choice
        prompt "ArmCore"
        default ARM_CORE_CM4_KM4NS_FOR_KM4NS
        config ARM_CORE_CM4_KM4NS_FOR_KM4NS
            bool "ARM_CM4_KM4NS"
    endchoice

    config ARM_CORE_CM4_FOR_KM4NS
        bool
        default y

    choice
        prompt "Chip Version"
        default AMEBAGREEN2_A_CUT_FOR_KM4NS
        config AMEBAGREEN2_A_CUT_FOR_KM4NS
            bool "AMEBAGREEN2_A_Cut"
    endchoice
endmenu
```

## amebagreen2_gcc_project/project_km4tz/Kconfig
```kconfig
comment "----------CPU config----------"

menu "CONFIG CHIP"
    choice
        prompt "ArmCore"
        default ARM_CORE_CM4_KM4TZ_FOR_KM4TZ
        config ARM_CORE_CM4_KM4TZ_FOR_KM4TZ
            bool "ARM_CM4_KM4TZ"
    endchoice

    config ARM_CORE_CM4_FOR_KM4TZ
        bool
        default y

    choice
        prompt "Chip Version"
        default AMEBAGREEN2_A_CUT_FOR_KM4TZ
        config AMEBAGREEN2_A_CUT_FOR_KM4TZ
            bool "AMEBAGREEN2_A_Cut"

        config AMEBAGREEN2_B_CUT_FOR_KM4TZ
            bool "AMEBAGREEN2_B_Cut"
    endchoice
endmenu
```
