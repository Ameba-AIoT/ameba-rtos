## amebasmart_gcc_project/Kconfig
```kconfig
mainmenu "AmebaSmart Configuration"

comment "--------MENUCONFIG FOR General---------"

#Release flag, set to y after release
config AMEBA_RLS
  def_bool y

config AMEBASMART
    def_bool y

#---------- FEATURE LIST START-----------#
#All features are invisible in menuconfig

config SUPPORT_NAND_FLASH
    def_bool y

config SUPPORT_FATFS_USB
    def_bool y

config SUPPORT_SD_CARD
    def_bool y

#
# USB features
#

# USB function
config SUPPORT_USB
    def_bool y

# USB shared DFIFO mode
config SUPPORT_USB_SHARED_DFIFO
    def_bool y

# USB UAC device
config SUPPORT_USBD_UAC
    def_bool y

config SUPPORT_USBH_UAC
    def_bool y

# USB ECM host
config SUPPORT_USBH_ECM
    def_bool y

# USB ECM bridge
config SUPPORT_USBH_ECM_BRIDGE
    def_bool y

config SUPPORT_SDIOH
    def_bool y

config SUPPORT_SMP
    def_bool y

#
# Audio features
#

# audio device function
config SUPPORT_AUDIO_DEVICE
    def_bool y

#---------- FEATURE LIST END-------------#

menu "CONFIG Link Option"
    choice
        prompt "IMG1(Bootloader) running on SRAM?"
        default IMG1_SRAM
        config IMG1_SRAM
            bool "SRAM"
    endchoice

    choice
        prompt "IMG2(Application) running on PSRAM or FLASH?"
        default IMG2_PSRAM
        config IMG2_PSRAM
            depends on !CP_TEST_CA32
            bool "PSRAM"
        config IMG2_FLASH
            bool "FLASH"
    endchoice
endmenu

menu "CONFIG TrustZone"
    config TRUSTZONE_FOR_KM4
        bool "Enable TrustZone"
    config TRUSTZONE_EN
        depends on TRUSTZONE_FOR_KM4
        bool
        default y
endmenu


menu "CONFIG Linux"
    config LINUX_FW_EN
        bool "Enable Linux (CA32 Linux Need KM4 Support)"
endmenu

rsource "../component/at_cmd/Kconfig"

rsource "../component/soc/common/rtk_assert/Kconfig"

rsource "../component/file_system/Kconfig"

rsource "../component/os/Kconfig"

orsource "../component/utils/Kconfig"

menu "CONFIG OTA OPTION"
    config UPGRADE_BOOTLOADER
        bool "Enable Bootloader OTA"

    config COMPRESS_OTA_IMG
        bool "Enable Compress APP Image"
endmenu

rsource "../component/usb/Kconfig"

menu "CONFIG APPLICATION"

    orsource "../component/ui/Kconfig"

    orsource "../component/audio/Kconfig"

    rsource "../component/utils/ipc/Kconfig"

    rsource "../component/dynamic_app/Kconfig"

    menu "AI Config"
        orsource "../component/tflite_micro/Kconfig"
        orsource "../component/aivoice/Kconfig"
        if AIVOICE_EN_MENU
            orsource "../component/application/speechmind/Kconfig"
        endif
    endmenu

    orsource "../component/application/Kconfig"

    orsource "${APP_DIR}/Kconfig.prj"

    orsource "../component/application/matter/project/cmake/Kconfig"

    rsource "../component/soc/common/diagnose/Kconfig"

endmenu


comment "-----Connectivity Config-----"
menu "CONFIG WHC INTF"
    choice
        prompt "WHC MODE"
        default WHC_INTF_IPC_MENU
        config WHC_INTF_IPC_MENU
            bool "WHC_IPC"
            select WHC_INTF_IPC
            select WHC_DEV_FOR_KM4
            select WHC_HOST_FOR_CA32
        # config FULLMAC_DEV
        #     bool "FULLMAC"
        config WIFI_SINGLE_CORE_MENU
            bool "SINGLE CORE"
            select WHC_NONE_FOR_KM4
        # config SDIO_BRIDGE
        #     bool "SDIO_BRIDGE"
        # config SPI_FULLMAC_HOST
        #     bool "SPI_FULLMAC_HOST"

    endchoice

    if FULLMAC_DEV
        choice
            prompt "FULLMAC INTERFACE"
            config SPI_FULLMAC
                bool "SPI_FULLMAC"
            config USB_FULLMAC
                bool "USB_FULLMAC"
            config SDIO_FULLMAC
                bool "SDIO_FULLMAC"
        endchoice
    endif

    config WHC_HOST_FOR_CA32
        bool
    config WHC_DEV_FOR_KM4
        bool
    config WHC_HOST_FOR_KM4
        bool
    config WHC_NONE_FOR_KM4
        bool
    config WHC_WIFI_API_PATH
        bool
endmenu

menu "CONFIG WIFI"
    config WLAN_MENU
        depends on !CP_TEST_CA32
        bool "Enable Wifi"
        default y
    if WLAN_MENU

        rsource "../component/wifi/Kconfig.wifi"

        config WHC_INTF_IPC_MENU
            bool
            select WHC_WIFI_API_PATH
            select WLAN if WHC_HOST||WHC_DEV
            select AS_INIC_AP if WHC_HOST
            select LWIP_LAYER if WHC_HOST && !MP_SHRINK
            select ENABLE_WPS if WHC_HOST && WIFI_WPS_ENABLE_MENU
            select ENABLE_WPS_DISCOVERY if ENABLE_WPS

        config FULLMAC_DEV
            bool
            depends on WHC_DEV
            select WHC_INTF_SDIO if SDIO_FULLMAC
            select WHC_INTF_SPI if SPI_FULLMAC
            select WHC_INTF_USB if USB_FULLMAC
            select WLAN
            select WIFI_FW_EN

        config SDIO_BRIDGE
            bool
            depends on WHC_NONE
            select WLAN
            select WHC_INTF_SDIO
            select LWIP_LAYER

        config SPI_FULLMAC_HOST
            bool
            depends on WHC_HOST
            select WLAN_FOR_CA32
            select WLAN_FOR_KM4
            select AS_INIC_AP_FOR_CA32
            select LWIP_LAYER

        config WIFI_SINGLE_CORE_MENU
            bool
            depends on WHC_NONE
            select WHC_INTF_IPC
            select WLAN
            select LWIP_LAYER if !MP_SHRINK
            select ENABLE_WPS if WIFI_WPS_ENABLE_MENU
            select ENABLE_WPS_DISCOVERY if ENABLE_WPS

    endif

    if !WLAN_MENU
        config WLAN_DISABLE
            bool
            select AS_INIC_AP if WHC_HOST
            select AS_INIC_NP if WHC_DEV
    endif


    config WLAN
        bool
    config WHC_INTF_IPC
        bool
    config AS_INIC_AP
        bool
    config AS_INIC_NP
        bool
    config LWIP_LAYER
        bool
    config WHC_INTF_SDIO
        bool
    config WHC_INTF_SPI
        bool
    config WHC_INTF_USB
        bool
    config WIFI_FW_EN
        bool
    config ENABLE_WPS
        bool
    config ENABLE_WPS_DISCOVERY
        bool

endmenu

menu "CONFIG BT"
    config BT_MENU
        bool "Enable BT"
    if BT_MENU
        # IC BT capability
        config BT_HAS_BREDR
            def_bool y
        config BT_HAS_MESH
            def_bool y
        config BT_HAS_LEAUDIO
            def_bool y

        choice
            prompt "BT Mode Selection"
            default BT_DUAL_MODE
            config BT_BLE_ONLY
                bool "BLE_ONLY"

            config BT_DUAL_MODE
                bool "DUAL_MODE"
        endchoice

        config BT
            depends on WHC_HOST || WHC_NONE
            bool
            default y
            select FTL_ENABLED

        config FTL_ENABLED
            bool

        rsource "../component/bluetooth/Kconfig"

    endif
endmenu


rsource "../component/lwip/Kconfig"

rsource "../component/ssl/Kconfig"

orsource "../component/wpan/Kconfig"

rsource "../component/rtk_coex/Kconfig.coex"

if !AMEBA_RLS
comment "---------Test Config---------"

menu "Verification and Test"
    # shall all CPU see this option.
    config CP_TEST_CA32
        bool "CP Test CA32 without external memory"
        help
            Enable this option to let CA32 run code from SRAM in CP stage for test purpose.
            This option is only for internal test, do not enable it in normal project.
            It will reduce available memory size for CA32 application.

    rsource "../component/soc/amebasmart/Kconfig"
endmenu
endif

comment "--------Build Config---------"

menu "Build Option"

    config FPGA
        bool "Select FPGA"
        depends on !AMEBA_RLS
        default y

    comment "Choose the build configuration"
    choice
        prompt "Link ROM Mode"
        default LINK_ROM_SYMB

        config LINK_ROM_LIB
            bool "Link_ROM_Library"

        config LINK_ROM_SYMB
            bool "Link_ROM_Symbol"
    endchoice
endmenu

comment "-----end of MENUCONFIG FOR General-----"


menu "MENUCONFIG FOR KM0 CONFIG"
    rsource "project_lp/Kconfig"
endmenu


menu "MENUCONFIG FOR KM4 CONFIG"
    rsource "project_hp/Kconfig"
endmenu



menu "MENUCONFIG FOR CA32 CONFIG"
    rsource "project_ap/Kconfig"
endmenu


comment "----- DO NOT ENTER IN THIS BUTTON ------"
menu "MENUCONFIG FOR Private"
config WHC_HOST
    bool "--DO NOT CHOOSE THIS CONFIG--"
config WHC_DEV
    bool "--DO NOT CHOOSE THIS CONFIG--"
config WHC_NONE
    bool "--DO NOT CHOOSE THIS CONFIG--"
endmenu
```

## amebasmart_gcc_project/project_ap/Kconfig
```kconfig
comment "--- --------------CPU config Start------------"

menu "CONFIG CHIP" #DONE
    choice
        prompt "ArmCore"
        default ARM_CORE_CA32_FOR_CA32
        config ARM_CORE_CA32_FOR_CA32
            bool "ARM_CA32"
    endchoice

    choice
        prompt "Chip Version"
        default AMEBASMART_A_CUT_FOR_CA32
        config AMEBASMART_A_CUT_FOR_CA32
            bool "AMEBASMART_A_Cut"
    endchoice

    # Enable NEON (Advanced SIMD) support for ARM Cortex-A processors
    config NEON_FOR_CA32
        bool
        default y

endmenu

comment "--- --------------smp config Start------------"

menu "CONFIG SMP"
    choice
        prompt "Select Core Num"
        default SMP_DUAL_CORE_FOR_CA32
        config SMP_DUAL_CORE_FOR_CA32
            bool "DUAL"
        config SMP_SINGLE_CORE_FOR_CA32
            bool "SINGLE"
    endchoice

    config CORE_NUM_FOR_CA32
        int
        default 2 if SMP_DUAL_CORE_FOR_CA32
        default 1 if SMP_SINGLE_CORE_FOR_CA32

    config SMP
        bool
        default y if SMP_DUAL_CORE_FOR_CA32
endmenu
```

## amebasmart_gcc_project/project_hp/Kconfig
```kconfig
comment "--- --------------CPU config Start------------"

config SUPPORT_CPU_MVE_FOR_KM4
    def_bool y

config SUPPORT_DSP_TABLE_ROM_FOR_KM4
    def_bool y

menu "CONFIG CHIP"
    config CPU_HAS_FPU_FOR_KM4
        bool
        default y

    choice
        prompt "ArmCore"
        default ARM_CORE_CM4_FOR_KM4
        config ARM_CORE_CM4_FOR_KM4
            bool "ARM_CM4"
    endchoice
endmenu
```

## amebasmart_gcc_project/project_lp/Kconfig
```kconfig
comment "--- --------------CPU config Start------------"

menu "CONFIG CHIP" #DONE
    choice
        prompt "ArmCore"
        config ARM_CORE_CM0_FOR_KM0
            bool "ARM_KM0"
    endchoice

endmenu


comment "--- --------------WIFI FW Config Start------------"

menu "CONFIG WIFI FW"
    config WIFI_FW_EN_FOR_KM0
        bool "Enable Wifi firmware"
        default y

    if WIFI_FW_EN_FOR_KM0
        config WIFI_FW_VERIFY_FOR_KM0
            bool "WIFI FW Test"

        config SOCZB_PTA_VERIFY_FOR_KM0
            bool "SOCZB_PTA_Verify_Mode"
    endif
endmenu
```

## component/aivoice/Kconfig
```kconfig
config AIVOICE_EN_MENU
    bool "Enable AIVoice"
    select AIVOICE_EN if CORE_AS_AP
    select TFLITE_MICRO_EN if CORE_AS_AP

if AIVOICE_EN_MENU
    choice
        prompt "Select AFE Resource"
        default AFE_RES_2MIC50MM_MENU

        config AFE_RES_1MIC_MENU
            bool "afe_res_1mic"
            select AFE_RES_1MIC if CORE_AS_AP

        config AFE_RES_2MIC30MM_MENU
            bool "afe_res_2mic30mm"
            select AFE_RES_2MIC30MM if CORE_AS_AP

        config AFE_RES_2MIC50MM_MENU
            bool "afe_res_2mic50mm"
            select AFE_RES_2MIC50MM if CORE_AS_AP

        config AFE_RES_2MIC70MM_MENU
            bool "afe_res_2mic70mm"
            select AFE_RES_2MIC70MM if CORE_AS_AP

        config AFE_RES_CIRCLE3MIC50MM_MENU
            bool "afe_res_3mic50mm"
            select AFE_RES_CIRCLE3MIC50MM if CORE_AS_AP
    endchoice

    choice
        prompt "Select VAD Resource"
        default VAD_V7_200K_MENU

        config VAD_V7_200K_MENU
            bool "vad_v7_200K"
            select VAD_V7_200K if CORE_AS_AP

        config VAD_V8_60K_MENU
            bool "vad_v8_60K"
            select VAD_V8_60K if CORE_AS_AP
    endchoice

    choice
        prompt "Select KWS Resource"
        default KWS_XIAOQIANGXIAOQIANG_NIHAOXIAOQIANG_V4_300K_MENU

        config KWS_XIAOQIANGXIAOQIANG_NIHAOXIAOQIANG_V4_300K_MENU
            bool "kws_xiaoqiangxiaoqiang_nihaoxiaoqiang_v4_300K"
            select KWS_XIAOQIANGXIAOQIANG_NIHAOXIAOQIANG_V4_300K if CORE_AS_AP

        config KWS_XIAOQIANGXIAOQIANG_NIHAOXIAOQIANG_V5_125K_MENU
            bool "kws_xiaoqiangxiaoqiang_nihaoxiaoqiang_v5_125K"
            select KWS_XIAOQIANGXIAOQIANG_NIHAOXIAOQIANG_V5_125K if CORE_AS_AP

        config KWS_CN_CUSTOMIZED_V3_750K_MENU
            bool "kws_cn_customized_v3_750K"
            select KWS_CN_CUSTOMIZED_V3_750K if CORE_AS_AP
    endchoice

    choice
        prompt "Select ASR Resource"
        default ASR_CN_V8_2M_MENU

        config ASR_CN_V8_2M_MENU
            bool "asr_cn_v8_2M"
            select ASR_CN_V8_2M if CORE_AS_AP

        config ASR_CN_V10_1M_MENU
            bool "asr_cn_v10_1M"
            select ASR_CN_V10_1M if CORE_AS_AP
    endchoice
endif

config AIVOICE_EN
    bool

config AFE_RES_1MIC
    bool

config AFE_RES_2MIC30MM
    bool

config AFE_RES_2MIC50MM
    bool

config AFE_RES_2MIC70MM
    bool

config AFE_RES_CIRCLE_3MIC50MM
    bool

config VAD_V7_200K
    bool

config VAD_V8_60K
    bool

config KWS_XIAOQIANGXIAOQIANG_NIHAOXIAOQIANG_V4_300K
    bool

config KWS_XIAOQIANGXIAOQIANG_NIHAOXIAOQIANG_V5_125K
    bool

config KWS_CN_CUSTOMIZED_V3_750K
    bool

config ASR_CN_V8_2M
    bool

config ASR_CN_V10_1M
    bool
```
