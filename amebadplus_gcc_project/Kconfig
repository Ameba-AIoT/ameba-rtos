## amebalite_gcc_project/menuconfig/config.in
```kconfig
# ATTENTION:
# Brief explaination:
#
# 1. "make menuconfig" will see this file.
# 2. make menuconfig save file will produce "/.config" and "/autoconf.h" two files.
# 3. makefile will see the "/.config" file
# 4. C code will see the "/autoconf.h"
#
# in this file, declare variable xxx, please add the prefix "CONFIG_" word.  Example: "CONFIG_XXX"


#===========================================================================
mainmenu_name 'RTL Bootcode Configuration'

separator "GeneralStart"

comment '--------------General config------------'

mainmenu_option next_comment
comment '< CONFIG DSP Enable'
bool "Enable DSP"				CONFIG_DSP_EN
if [ "$CONFIG_DSP_EN" = "y" ]; then
	bool "DSP within APP image"				CONFIG_DSP_WITHIN_APP_IMG
fi
endmenu

mainmenu_option next_comment
comment '< CONFIG TrustZone'
bool "Enable TrustZone"			CONFIG_TRUSTZONE_FOR_KM4
if [ "$CONFIG_TRUSTZONE_FOR_KM4" = "y" ]; then
	define_bool CONFIG_TRUSTZONE_EN y
fi
endmenu

mainmenu_option next_comment
comment '< CONFIG Link Option'
choice 'IMG1(Bootloader) running on FLASH or SRAM?'			"FLASH			CONFIG_IMG1_FLASH \
															SRAM			CONFIG_IMG1_SRAM  \
															"FLASH
choice 'IMG2(Application) running on FLASH or PSRAM?'   	"CodeInXip_DataHeapInPsram		CONFIG_CODE_XIP_DATA_PSRAM \
															CodeInPsram_DataHeapInSram		CONFIG_CODE_PSRAM_DATA_SRAM \
															CodeInPsram_DataHeapInPsram		CONFIG_CODE_PSRAM_DATA_PSRAM \
															CodeInXip_DataHeapInSram		CONFIG_CODE_XIP_DATA_SRAM \
															"CodeInXip_DataHeapInPsram
if [ "$CONFIG_TRUSTZONE_FOR_KM4" = "y" ]; then
	choice 'IMG3(SecureImage) running on PSRAM or SRAM?'	"PSRAM			CONFIG_IMG3_PSRAM \
															SRAM			CONFIG_IMG3_SRAM	\
															" SRAM
fi
endmenu

mainmenu_option next_comment
comment '< CONFIG Mass Production'
bool "Enable MP"			CONFIG_MP_INCLUDED
if [ "$CONFIG_MP_INCLUDED" = "y" ]; then
	choice 'MP Mode'	"expand			CONFIG_MP_EXPAND \
						shrink			CONFIG_MP_SHRINK	\
						" shrink
fi
endmenu

mainmenu_option next_comment
comment '< CONFIG Shell CMD'
bool "Enable ATCMD"			CONFIG_SUPPORT_ATCMD
if [ "$CONFIG_SUPPORT_ATCMD" = "y" ]; then
choice 'ATCMD IO Type'	"LOGUART	CONFIG_ATCMD_IO_LOGUART \
						UART		CONFIG_ATCMD_IO_UART \
						"
bool "Enable Longer CMD"	CONFIG_LONGER_CMD
fi
endmenu

mainmenu_option next_comment
comment '< CONFIG VFS'
bool "Enable VFS LITTLEFS"                     CONFIG_VFS_LITTLEFS_INCLUDED
bool "Enable VFS FATFS"                        CONFIG_VFS_FATFS_INCLUDED
if [ "$CONFIG_VFS_FATFS_INCLUDED" = "y" ]; then
choice 'FATFS Memory Type'     "
                            	FlASH           FATFS_DISK_FLASH \
                                "
bool "FATFS within APP Image"				CONFIG_FATFS_WITHIN_APP_IMG
fi
endmenu

mainmenu_option next_comment
comment '< CONFIG OTA OPTION'
bool "Upgrade Bootloader"				CONFIG_UPGRADE_BOOTLOADER
bool "Support Compressed APP Image"		CONFIG_COMPRESS_OTA_IMG
endmenu

comment '--------------Network Config------------'

mainmenu_option next_comment
comment '< CONFIG Application Processor'

choice 'Select AP Core'			"KM4	CONFIG_AP_CORE_KM4 \
								KR4		CONFIG_AP_CORE_KR4 \
								" KM4

if [ "$CONFIG_AP_CORE_KR4" = "y" ]; then
	bool "Enable INIC"				CONFIG_WIFI_INIC
else
	define_bool CONFIG_WIFI_INIC y
fi

endmenu #CONFIG Application Processor

mainmenu_option next_comment
comment '< CONFIG BT'
bool "Enable BT"														CONFIG_BT_MENU
# !!Notice that "[ ]" both side and "$CONFIG_XXX" should has a whitespace
if [ "$CONFIG_BT_MENU" = "y" ]; then
	if [ "$CONFIG_AP_CORE_KM4" = "y" ]; then
		define_bool CONFIG_BT_FOR_KM4 y
		define_bool CONFIG_FTL_ENABLED_FOR_KM4 y
	else
		define_bool CONFIG_BT_FOR_KR4 y
		define_bool CONFIG_FTL_ENABLED_FOR_KR4 y
	fi
	choice 'BT Mode Selection'	"BLE_ONLY								CONFIG_BT_BLE_ONLY \
								DUAL_MODE								CONFIG_BT_DUAL_MODE \
								" BLE_ONLY
	bool "BT Advanced Feature"											CONFIG_BT_ADVANCED_FEATURE_MENU
	if [ "$CONFIG_BT_ADVANCED_FEATURE_MENU" = "y" ]; then
		bool "  Exclude BT AT Command"									CONFIG_BT_EXCLUDE_AT_COMMAND
#		bool "  Use Zephyr BT Stack"									CONFIG_BT_ZEPHYR
	fi
	bool "BT Example Demo"												CONFIG_BT_EXAMPLE_DEMO_MENU
	if [ "$CONFIG_BT_EXAMPLE_DEMO_MENU" = "y" ]; then
		bool "  BLE Peripheral"											CONFIG_BT_PERIPHERAL
		bool "  BLE Central"											CONFIG_BT_CENTRAL
		bool "  BLE Scatternet"											CONFIG_BT_SCATTERNET
#		bool "  BLE Throughput"											CONFIG_BT_THROUGHPUT
		bool "  BLE Mesh Provisioner"									CONFIG_BT_MESH_PROVISIONER_MENU
		bool "  BLE Mesh Device"										CONFIG_BT_MESH_DEVICE_MENU
		bool "  BLE Mesh Provisioner and BLE Scatternet"				CONFIG_BT_MESH_PROVISIONER_SCATTERNET_MENU
		bool "  BLE Mesh Device and BLE Scatternet"						CONFIG_BT_MESH_DEVICE_SCATTERNET_MENU
#		bool "  BLE Mesh Provisioner Test"								CONFIG_BT_MESH_PROVISIONER_TEST_MENU
#		bool "  BLE Mesh Device Test"									CONFIG_BT_MESH_DEVICE_TEST_MENU
#		bool "  BLE ISO Test"											CONFIG_BT_ISO_TEST
		bool "  BLE Audio"												CONFIG_BT_LE_AUDIO_MENU
		if [ "$CONFIG_BT_LE_AUDIO_MENU" = "y" ]; then
			bool "    BLE Audio Basic Audio Profile"					CONFIG_BT_BAP_MENU
			bool "    BLE Audio Common Audio Profile"					CONFIG_BT_CAP_MENU
			bool "    BLE Audio Public Broadcast Profile"				CONFIG_BT_PBP_MENU
			bool "    BLE Audio Telephony and Media Audio Profile"		CONFIG_BT_TMAP_MENU
		fi
		bool "  BT A2DP"												CONFIG_BT_A2DP_MENU
		bool "  BT HFP"													CONFIG_BT_HFP_MENU
		bool "  BT A2DP and BT HFP"										CONFIG_BT_A2DP_HFP_MENU
		bool "  BT SPP"													CONFIG_BT_SPP
		bool "  BT Audio MP Test"										CONFIG_BT_AUDIO_MP_TEST_MENU
#		bool "  BT HID"													CONFIG_BT_HID
#		bool "  BT PTS"													CONFIG_BT_PTS
		bool "  BT A2DP and BLE Scatternet"								CONFIG_BT_A2DP_SCATTERNET_MENU
#		bool "  BT A2DP and BLE Mesh Provisioner and BLE Scatternet"	CONFIG_BT_A2DP_PROVISIONER_SCATTERNET_MENU
		bool "  BT A2DP and BLE Audio PBP"								CONFIG_BT_A2DP_LE_AUDIO_PBP_MENU
		bool "  BT A2DP and BLE Audio TMAP"								CONFIG_BT_A2DP_LE_AUDIO_TMAP_MENU
		if [ "$CONFIG_BT_MESH_PROVISIONER_MENU" = "y" ]; then
			define_bool CONFIG_BT_MESH_PROVISIONER y
			define_bool CONFIG_BT_MESH_PROVISIONER_SUPPORT y
		fi
		if [ "$CONFIG_BT_MESH_DEVICE_MENU" = "y" ]; then
			define_bool CONFIG_BT_MESH_DEVICE y
			define_bool CONFIG_BT_MESH_DEVICE_SUPPORT y
		fi
		if [ "$CONFIG_BT_MESH_PROVISIONER_SCATTERNET_MENU" = "y" ]; then
			define_bool CONFIG_BT_MESH_PROVISIONER_SCATTERNET y
			define_bool CONFIG_BT_MESH_PROVISIONER_SUPPORT y
		fi
		if [ "$CONFIG_BT_MESH_DEVICE_SCATTERNET_MENU" = "y" ]; then
			define_bool CONFIG_BT_MESH_DEVICE_SCATTERNET y
			define_bool CONFIG_BT_MESH_DEVICE_SUPPORT y
		fi
		if [ "$CONFIG_BT_MESH_PROVISIONER_TEST_MENU" = "y" ]; then
			define_bool CONFIG_BT_MESH_PROVISIONER_TEST y
			define_bool CONFIG_BT_MESH_PROVISIONER_SUPPORT y
		fi
		if [ "$CONFIG_BT_MESH_DEVICE_TEST_MENU" = "y" ]; then
			define_bool CONFIG_BT_MESH_DEVICE_TEST y
			define_bool CONFIG_BT_MESH_DEVICE_SUPPORT y
		fi
		if [ "$CONFIG_BT_LE_AUDIO_MENU" = "y" ]; then
			define_bool CONFIG_BT_LE_AUDIO y
			define_bool CONFIG_BT_APP_AUDIO_DATA y
			define_bool CONFIG_BT_AUDIO_CODEC_SUPPORT y
			define_bool CONFIG_BT_AUDIO_CODEC_LC3 y
			if [ "$CONFIG_BT_BAP_MENU" = "y" ]; then
				define_bool CONFIG_BT_BAP y
				define_bool CONFIG_BT_BAP_SUPPORT y
			fi
			if [ "$CONFIG_BT_CAP_MENU" = "y" ]; then
				define_bool CONFIG_BT_CAP y
				define_bool CONFIG_BT_CAP_SUPPORT y
			fi
			if [ "$CONFIG_BT_PBP_MENU" = "y" ]; then
				define_bool CONFIG_BT_PBP y
				define_bool CONFIG_BT_PBP_SUPPORT y
			fi
			if [ "$CONFIG_BT_TMAP_MENU" = "y" ]; then
				define_bool CONFIG_BT_TMAP y
				define_bool CONFIG_BT_TMAP_SUPPORT y
				define_bool CONFIG_BT_CAP_SUPPORT y
			fi
		fi
		if [ "$CONFIG_BT_A2DP_MENU" = "y" ]; then
			define_bool CONFIG_BT_A2DP y
			define_bool CONFIG_BT_APP_AUDIO_DATA y
			define_bool CONFIG_BT_AUDIO_CODEC_SUPPORT y
			define_bool CONFIG_BT_AUDIO_CODEC_SBC y
		fi
		if [ "$CONFIG_BT_HFP_MENU" = "y" ]; then
			define_bool CONFIG_BT_HFP y
			define_bool CONFIG_BT_APP_AUDIO_DATA y
			define_bool CONFIG_BT_AUDIO_CODEC_SUPPORT y
			define_bool CONFIG_BT_AUDIO_CODEC_CVSD y
		fi
		if [ "$CONFIG_BT_A2DP_HFP_MENU" = "y" ]; then
			define_bool CONFIG_BT_A2DP_HFP y
			define_bool CONFIG_BT_APP_AUDIO_DATA y
			define_bool CONFIG_BT_AUDIO_CODEC_SUPPORT y
			define_bool CONFIG_BT_AUDIO_CODEC_SBC y
			define_bool CONFIG_BT_AUDIO_CODEC_CVSD y
		fi
		if [ "$CONFIG_BT_AUDIO_MP_TEST_MENU" = "y" ]; then
			define_bool CONFIG_BT_AUDIO_MP_TEST y
			define_bool CONFIG_BT_APP_AUDIO_DATA y
			define_bool CONFIG_BT_AUDIO_CODEC_SUPPORT y
			define_bool CONFIG_BT_AUDIO_CODEC_SBC y
			define_bool CONFIG_BT_AUDIO_CODEC_CVSD y
		fi
		if [ "$CONFIG_BT_A2DP_SCATTERNET_MENU" = "y" ]; then
			define_bool CONFIG_BT_A2DP_SCATTERNET y
			define_bool CONFIG_BT_APP_AUDIO_DATA y
			define_bool CONFIG_BT_AUDIO_CODEC_SUPPORT y
			define_bool CONFIG_BT_AUDIO_CODEC_SBC y
		fi
		if [ "$CONFIG_BT_A2DP_PROVISIONER_SCATTERNET_MENU" = "y" ]; then
			define_bool CONFIG_BT_A2DP_PROVISIONER_SCATTERNET y
			define_bool CONFIG_BT_APP_AUDIO_DATA y
			define_bool CONFIG_BT_AUDIO_CODEC_SUPPORT y
			define_bool CONFIG_BT_AUDIO_CODEC_SBC y
			define_bool CONFIG_BT_MESH_PROVISIONER_SUPPORT y
		fi
		if [ "$CONFIG_BT_A2DP_LE_AUDIO_PBP_MENU" = "y" ]; then
			define_bool CONFIG_BT_LE_AUDIO y
			define_bool CONFIG_BT_A2DP_LE_AUDIO_PBP y
			define_bool CONFIG_BT_APP_AUDIO_DATA y
			define_bool CONFIG_BT_PBP_SUPPORT y
			define_bool CONFIG_BT_AUDIO_CODEC_SUPPORT y
			define_bool CONFIG_BT_AUDIO_CODEC_SBC y
			define_bool CONFIG_BT_AUDIO_CODEC_LC3 y
		fi
		if [ "$CONFIG_BT_A2DP_LE_AUDIO_TMAP_MENU" = "y" ]; then
			define_bool CONFIG_BT_LE_AUDIO y
			define_bool CONFIG_BT_A2DP_LE_AUDIO_TMAP y
			define_bool CONFIG_BT_APP_AUDIO_DATA y
			define_bool CONFIG_BT_TMAP_SUPPORT y
			define_bool CONFIG_BT_CAP_SUPPORT y
			define_bool CONFIG_BT_AUDIO_CODEC_SUPPORT y
			define_bool CONFIG_BT_AUDIO_CODEC_SBC y
			define_bool CONFIG_BT_AUDIO_CODEC_LC3 y
		fi
	fi
fi
endmenu

mainmenu_option next_comment
comment '< CONFIG WIFI'
bool "Enable Wifi"                CONFIG_WLAN_MENU
if [ "$CONFIG_WLAN_MENU" = "y" ]; then
	if [ "$CONFIG_AP_CORE_KM4" = "y" ]; then
		if [ "$CONFIG_WIFI_INIC" = "y" ]; then
			define_bool CONFIG_WLAN_KM4_AP_KR4_NP y
			define_bool CONFIG_WLAN_KR4_AP_KM4_NP n
			define_bool CONFIG_WIFI_KM4_SINGLE_CORE n
			define_bool CONFIG_WIFI_KR4_SINGLE_CORE n
		else
			define_bool CONFIG_WLAN_KM4_AP_KR4_NP n
			define_bool CONFIG_WLAN_KR4_AP_KM4_NP n
			define_bool CONFIG_WIFI_KM4_SINGLE_CORE y
			define_bool CONFIG_WIFI_KR4_SINGLE_CORE n
		fi
	fi
	if [ "$CONFIG_AP_CORE_KR4" = "y" ]; then
		if [ "$CONFIG_WIFI_INIC" = "y" ]; then
			define_bool CONFIG_WLAN_KM4_AP_KR4_NP n
			define_bool CONFIG_WLAN_KR4_AP_KM4_NP y
			define_bool CONFIG_WIFI_KM4_SINGLE_CORE n
			define_bool CONFIG_WIFI_KR4_SINGLE_CORE n
		else
			define_bool CONFIG_WLAN_KM4_AP_KR4_NP n
			define_bool CONFIG_WLAN_KR4_AP_KM4_NP n
			define_bool CONFIG_WIFI_KM4_SINGLE_CORE n
			define_bool CONFIG_WIFI_KR4_SINGLE_CORE y
		fi
	fi
	bool "Enable HIGH TP"	CONFIG_HIGH_TP_TEST
	if [ "$CONFIG_WLAN_KR4_AP_KM4_NP" = "y" ]; then
		define_bool CONFIG_WLAN_FOR_KR4 y
		define_bool CONFIG_WLAN_FOR_KM4 y
		define_bool CONFIG_AS_INIC_AP_FOR_KR4 y
		define_bool CONFIG_AS_INIC_NP_FOR_KM4 y
		if [ "$CONFIG_MP_SHRINK" = "y" ]; then
			define_bool CONFIG_LWIP_LAYER_FOR_KR4 n
		else
			define_bool CONFIG_LWIP_LAYER_FOR_KR4 y
		fi
		define_bool CONFIG_FW_DRIVER_COEXIST_FOR_KM4 y
	fi

	if [ "$CONFIG_WLAN_KM4_AP_KR4_NP" = "y" ]; then
		define_bool CONFIG_WLAN_FOR_KR4 y
		define_bool CONFIG_WLAN_FOR_KM4 y
		define_bool CONFIG_AS_INIC_AP_FOR_KM4 y
		define_bool CONFIG_AS_INIC_NP_FOR_KR4 y
		if [ "$CONFIG_MP_SHRINK" = "y" ]; then
			define_bool CONFIG_LWIP_LAYER_FOR_KM4 n
		else
			define_bool CONFIG_LWIP_LAYER_FOR_KM4 y
		fi
		define_bool CONFIG_FW_DRIVER_COEXIST_FOR_KR4 y
	fi

	if [ "$CONFIG_WIFI_KM4_SINGLE_CORE" = "y" ]; then
		define_bool CONFIG_WLAN_FOR_KM4 y
		define_bool CONFIG_SINGLE_CORE_WIFI_FOR_KM4 y
		if [ "$CONFIG_MP_SHRINK" = "y" ]; then
			define_bool CONFIG_LWIP_LAYER_FOR_KM4 n
		else
			define_bool CONFIG_LWIP_LAYER_FOR_KM4 y
		fi
		define_bool CONFIG_FW_DRIVER_COEXIST_FOR_KM4 y
	fi

	if [ "$CONFIG_WIFI_KR4_SINGLE_CORE" = "y" ]; then
		define_bool CONFIG_WLAN_FOR_KR4 y
		define_bool CONFIG_SINGLE_CORE_WIFI_FOR_KR4 y
		if [ "$CONFIG_MP_SHRINK" = "y" ]; then
			define_bool CONFIG_LWIP_LAYER_FOR_KR4 n
		else
			define_bool CONFIG_LWIP_LAYER_FOR_KR4 y
		fi
		define_bool CONFIG_FW_DRIVER_COEXIST_FOR_KR4 y
	fi

	if [ "$CONFIG_WLAN_KR4_AP_KM4_NP" = "y" ]; then
		bool "Enable WPS"		CONFIG_ENABLE_WPS_FOR_KR4
		if [ "$CONFIG_ENABLE_WPS_FOR_KR4" = "y" ]; then
			define_bool CONFIG_ENABLE_WPS_DISCOVERY_FOR_KR4 y
		fi
	fi

	if [ "$CONFIG_WLAN_KM4_AP_KR4_NP" = "y" ]; then
		bool "Enable WPS"		CONFIG_ENABLE_WPS_FOR_KM4
		if [ "$CONFIG_ENABLE_WPS_FOR_KM4" = "y" ]; then
			define_bool CONFIG_ENABLE_WPS_DISCOVERY_FOR_KM4 y
		fi
	fi

	if [ "$CONFIG_WIFI_KM4_SINGLE_CORE" = "y" ]; then
		bool "Enable WPS"		CONFIG_ENABLE_WPS_FOR_KM4
		if [ "$CONFIG_ENABLE_WPS_FOR_KM4" = "y" ]; then
			define_bool CONFIG_ENABLE_WPS_DISCOVERY_FOR_KM4 y
		fi
	fi

	if [ "$CONFIG_WIFI_KR4_SINGLE_CORE" = "y" ]; then
		bool "Enable WPS"		CONFIG_ENABLE_WPS_FOR_KR4
		if [ "$CONFIG_ENABLE_WPS_FOR_KR4" = "y" ]; then
			define_bool CONFIG_ENABLE_WPS_DISCOVERY_FOR_KR4 y
		fi
	fi

	bool "Enable CSI"		CONFIG_WIFI_CSI_ENABLE
	bool "Enable ANTDIV"		CONFIG_WIFI_ANTDIV_ENABLE
	bool "Enable 11K"		CONFIG_WIFI_11K_ENABLE
	bool "Enable 11V"		CONFIG_WIFI_11V_ENABLE
	bool "Enable 11R"		CONFIG_WIFI_11R_ENABLE

else
	define_bool CONFIG_WLAN n
	define_bool CONFIG_AS_INIC_AP_FOR_KM4 y
	define_bool CONFIG_AS_INIC_NP_FOR_KR4 y
	define_bool CONFIG_LWIP_LAYER n
fi
endmenu

mainmenu_option next_comment
comment '< CONFIG LWIP'
if [ "$CONFIG_WLAN_KR4_AP_KM4_NP" = "y" ]; then
	bool "Enable Fast DHCP"		CONFIG_FAST_DHCP_FOR_KR4
fi

if [ "$CONFIG_WLAN_KM4_AP_KR4_NP" = "y" ]; then
	bool "Enable Fast DHCP"		CONFIG_FAST_DHCP_FOR_KM4
fi

if [ "$CONFIG_WIFI_KM4_SINGLE_CORE" = "y" ]; then
	bool "Enable Fast DHCP"		CONFIG_FAST_DHCP_FOR_KM4
fi

if [ "$CONFIG_WIFI_KR4_SINGLE_CORE" = "y" ]; then
	bool "Enable Fast DHCP"		CONFIG_FAST_DHCP_FOR_KR4
fi

bool "Enable LWIP Debug"		CONFIG_LWIP_DEBUG
if [ "$CONFIG_LWIP_DEBUG" = "y" ]; then
	mainmenu_option next_comment
	comment '< CONFIG LWIP DEBUG'
		bool "Enable ETHARP DEBUG"				CONFIG_ETHARP_DEBUG
		bool "Enable NETIF DEBUG"				CONFIG_NETIF_DEBUG
		bool "Enable PBUF DEBUG"				CONFIG_PBUF_DEBUG
		bool "Enable API LIB DEBUG"				CONFIG_API_LIB_DEBUG
		bool "Enable API MSG DEBUG"				CONFIG_API_MSG_DEBUG
		bool "Enable SOCKETS DEBUG"				CONFIG_SOCKETS_DEBUG
		bool "Enable ICMP DEBUG"				CONFIG_ICMP_DEBUG
		bool "Enable IPNAT DEBUG"				CONFIG_IPNAT_DEBUG
		bool "Enable IGMP DEBUG"				CONFIG_IGMP_DEBUG
		bool "Enable INET DEBUG"				CONFIG_INET_DEBUG
		bool "Enable IP DEBUG"					CONFIG_IP_DEBUG
		bool "Enable IP REASS DEBUG"			CONFIG_IP_REASS_DEBUG
		bool "Enable RAW DEBUG"					CONFIG_RAW_DEBUG
		bool "Enable MEM DEBUG"					CONFIG_MEM_DEBUG
		bool "Enable MEMP DEBUG"				CONFIG_MEMP_DEBUG
		bool "Enable SYS DEBUG"					CONFIG_SYS_DEBUG
		bool "Enable TIMERS DEBUG"				CONFIG_TIMERS_DEBUG
		bool "Enable TCP DEBUG"					CONFIG_TCP_DEBUG
		bool "Enable TCP INPUT DEBUG"			CONFIG_TCP_INPUT_DEBUG
		bool "Enable TCP FR DEBUG"				CONFIG_TCP_FR_DEBUG
		bool "Enable TCP RTO DEBUG"				CONFIG_TCP_RTO_DEBUG
		bool "Enable TCP CWND DEBUG"			CONFIG_TCP_CWND_DEBUG
		bool "Enable TCP WND DEBUG"				CONFIG_TCP_WND_DEBUG
		bool "Enable TCP OUTPUT DEBUG"			CONFIG_TCP_OUTPUT_DEBUG
		bool "Enable TCP RST DEBUG"				CONFIG_TCP_RST_DEBUG
		bool "Enable TCP QLEN DEBUG"			CONFIG_TCP_QLEN_DEBUG
		bool "Enable UDP DEBUG"					CONFIG_UDP_DEBUG
		bool "Enable TCPIP DEBUG"				CONFIG_TCPIP_DEBUG
		bool "Enable SLIP DEBUG"				CONFIG_SLIP_DEBUG
		bool "Enable DHCP DEBUG"				CONFIG_DHCP_DEBUG
		bool "Enable AUTOIP DEBUG"				CONFIG_AUTOIP_DEBUG
		bool "Enable DNS DEBUG"					CONFIG_DNS_DEBUG
		bool "Enable IP6 DEBUG"					CONFIG_IP6_DEBUG
		bool "Enable DHCP6 DEBUG"				CONFIG_DHCP6_DEBUG
	endmenu
fi
endmenu

separator "GeneralEnd"
separator "KM4Start"

comment '--------------KM4 config------------'
mainmenu_option next_comment
comment '< MENUCONFIG FOR KM4 CONFIG'

comment '--------------CPU config------------'

mainmenu_option next_comment
comment '< CONFIG CHIP'
comment 'Target Platform Selection'
comment 'Choose a Vendor/Product combination.'

choice 'Product' "AMEBALITE CONFIG_AMEBALITE_FOR_KM4  \
		" AMEBALITE

choice 'ArmCore' "ARM_CM4 ARM_CORE_CM4_FOR_KM4 \
		"ARM_CM4

bool "Select FPGA"            CONFIG_FPGA_FOR_KM4

endmenu

#===========================================================================
# Common Config with every IC have this function in here. Don't litmit someone ic.
#
comment '--------------OS config------------'
mainmenu_option next_comment
comment '< CONFIG OS'

bool "Enable Kernel"                     CONFIG_KERNEL_FOR_KM4

if [ "$CONFIG_KERNEL_FOR_KM4" = "y" ]; then
choice 'Kernel Selecte' "FREERTOS        PLATFORM_FREERTOS_FOR_KM4 \
						"FREERTOS
define_int TASK_SCHEDULER_DISABLED_FOR_KM4 0
fi
endmenu #CONFIG OS

#===========================================================================

#===========================================================================
# Normall function config
#

comment '--------------Peripheral Test---------------'
mainmenu_option next_comment
comment '< CONFIG FUNCTION TEST'
bool "Enable Peripheral Test"		CONFIG_PER_TEST_FOR_KM4
if [ "$CONFIG_PER_TEST_FOR_KM4" = "y" ]; then
	bool "System_Verify_Mode"	CONFIG_SYS_VERIFY_FOR_KM4
	if [ "$CONFIG_SYS_VERIFY_FOR_KM4" = "y" ]; then
	choice 'System Verify Type'	"FT_Test		CONFIG_FT_FOR_KM4\
								EQC_Test		CONFIG_EQC_FOR_KM4 \
								QA_Test			CONFIG_QA_FOR_KM4 \
								OLT_Test		CONFIG_OLT_FOR_KM4 \
								Corner_Test		CONFIG_CORNER_FOR_KM4 \
								IMG_SIM			CONFIG_SIMULATION_FOR_KM4 \
								"
	fi
	bool "WIFI FW Test"		CONFIG_WIFI_FW_VERIFY_FOR_KM4
	bool "DBGPORT_Verify_Mode"	CONFIG_DBGPORT_VERIFY_FOR_KM4
	bool "Timer_Verify_Mode"	CONFIG_TIMER_VERIFY_FOR_KM4
	bool "PRS_Verify_Mode"		CONFIG_PRS_VERIFY_FOR_KM4
	bool "WDG_Verify_Mode"		CONFIG_WDG_VERIFY_FOR_KM4
	bool "TRNG_Verify_Mode"		CONFIG_TRNG_VERIFY_FOR_KM4
	bool "Gdma_Verify_Mode"		CONFIG_GDMA_VERIFY_FOR_KM4
	bool "GPIO_Verify_Mode"		CONFIG_GPIO_VERIFY_FOR_KM4
	bool "ZB_INT_Verify_Mode"	CONFIG_ZB_INT_VERIFY_FOR_KM4
	bool "SPI_COM_Verify_Mode"	CONFIG_SPI_COM_VERIFY_FOR_KM4
	bool "UART_Verify_Mode"		CONFIG_UART_VERIFY_FOR_KM4
	bool "LCDC_Verify_Mode"		CONFIG_LCDC_VERIFY_FOR_KM4
	bool "LEDC_Verify_Mode"		CONFIG_LEDC_VERIFY_FOR_KM4
	bool "I2C_Verify_Mode"		CONFIG_I2C_VERIFY_FOR_KM4
	bool "PMC_Verify_Mode"		CONFIG_PMC_VERIFY_FOR_KM4
	bool "SGPIO_Verify_Mode"	CONFIG_SGPIO_VERIFY_FOR_KM4
	bool "PSRAM_Verify_Mode"	CONFIG_PSRAM_VERIFY_FOR_KM4
	bool "I2S_Verify_Mode"		CONFIG_I2S_VERIFY_FOR_KM4
	bool "AUDIO_Verify_Mode"	CONFIG_AUDIO_VERIFY_FOR_KM4
	bool "SOC_PS_Verify_Mode"	CONFIG_SOC_PS_VERIFY_FOR_KM4
	bool "Crypto_Verify_Mode"	CONFIG_CRYPTO_VERIFY_FOR_KM4
	bool "EFUSE_Verify_Mode"	CONFIG_EFUSE_VERIFY_FOR_KM4
	bool "SPIC_Verify_Mode"		CONFIG_SPIC_VERIFY_FOR_KM4
	bool "FTL_Verify_Mode"		CONFIG_FTL_VERIFY_FOR_KM4
	bool "ADC_Verify_Mode"		CONFIG_ADC_VERIFY_FOR_KM4
	bool "CapTouch_Verify_Mode"	CONFIG_CAPTOUCH_VERIFY_FOR_KM4
	bool "Thermal_Verify_Mode"	CONFIG_THERMAL_VERIFY_FOR_KM4
	bool "RSIP_Verify_Mode"		CONFIG_RSIP_VERIFY_FOR_KM4
	bool "SDIO_DEVICE_Verify_Mode"	CONFIG_SDIO_DEVICE_VERIFY_FOR_KM4
	bool "SDIO_HOST_Verify_Mode"	CONFIG_SDIOH_VERIFY_FOR_KM4
	bool "chip_reset_verify"		CONFIG_CHIP_RST_VERIFY_FOR_KM4
	bool "debugtimer_verify"		CONFIG_DBG_TIMER_VERIFY_FOR_KM4
	bool "Dhrystone Test"		CONFIG_DHRYSTONE_TEST_FOR_KM4
	bool "RTLIB ROM Test"		CONFIG_RTLIB_VERIFY_FOR_KM4
	bool "IPC Test"			CONFIG_IPC_VERIFY_FOR_KM4
	bool "IR Test"			CONFIG_IR_VERIFY_FOR_KM4
	bool "MPU Test"			CONFIG_MPU_VERIFY_FOR_KM4
	bool "CACHE Test"		CONFIG_CACHE_VERIFY_FOR_KM4
	bool "WFE Test"			CONFIG_WFE_VERIFY_FOR_KM4
	bool "DDR Test"			CONFIG_DDR_VERIFY_FOR_KM4
	bool "RSA Test"			CONFIG_RSA_VERIFY_FOR_KM4
	bool "ECDSA Test"		CONFIG_ECDSA_VERIFY_FOR_KM4
	bool "ED25519 Test"		CONFIG_ED25519_VERIFY_FOR_KM4
	bool "LOGUART Test"		CONFIG_LOGUART_VERIFY_FOR_KM4
	bool "Memory Share Test"		CONFIG_MEMSHARE_VERIFY_FOR_KM4
	bool "AF Test"			CONFIG_AF_VERIFY_FOR_KM4
	bool "Flash_AVL_Mode"       CONFIG_Flash_AVL_FOR_KM4
	bool "WIFI Test"        CONFIG_WIFI_VERIFY_FOR_KM4
	if [ "$CONFIG_WIFI_VERIFY_FOR_KM4" = "y" ]; then
	choice 'WIFI Verify Type'         "WIFI_ASIC			  CONFIG_WIFI_VERIFY_ASIC_FOR_KM4 \
									   WIFI_MAC_LBK           CONFIG_MAC_LBK_FOR_KM4 \
									   WIFI_2MAC_WITH_PSPHY   CONFIG_WIFI_VERIFY_PSPHY_FOR_KM4 \
									   WIFI_2MAC_WITH_TUREPHY CONFIG_WIFI_VERIFY_TRUEPHY_FOR_KM4 \
									  "
	fi

fi #CONFIG_PER_TEST
endmenu #CONFIG PER TEST

comment '--------------Secure Test---------------'
mainmenu_option next_comment
comment '< CONFIG SECURE TEST'
bool "SEC_Verify_Mode"			CONFIG_SEC_VERIFY_FOR_KM4
if [ "$CONFIG_SEC_VERIFY_FOR_KM4" = "y" ]; then
	bool "CACHE Secure Test"	CONFIG_CACHE_SEC_VERIFY_FOR_KM4
	bool "EFUSE Secure Test"	CONFIG_EFUSE_SEC_VERIFY_FOR_KM4
	bool "GDMA Secure Test"		CONFIG_GDMA_SEC_VERIFY_FOR_KM4
	bool "AES Secure Test"		CONFIG_AES_SEC_VERIFY_FOR_KM4
	bool "Crypto Secure Test"	CONFIG_CRYPTO_SEC_VERIFY_FOR_KM4
	bool "CRC Secure Test"		CONFIG_CRC_SEC_VERIFY_FOR_KM4
	bool "RDP Secure Test"		CONFIG_RDP_SEC_VERIFY_FOR_KM4
	bool "WDG Secure Test"		CONFIG_WDG_SEC_VERIFY_FOR_KM4
	bool "TRNG Secure Test"		CONFIG_TRNG_SEC_VERIFY_FOR_KM4
	bool "TIMER Secure Test"	CONFIG_TIMER_SEC_VERIFY_FOR_KM4
	bool "DBGTIM Secure Test"	CONFIG_DBGTIM_SEC_VERIFY_FOR_KM4
	bool "GPIO Secure Test"		CONFIG_GPIO_SEC_VERIFY_FOR_KM4
	bool "RTC Secure Test"		CONFIG_RTC_SEC_VERIFY_FOR_KM4
	bool "ADC Secure Test"		CONFIG_ADC_SEC_VERIFY_FOR_KM4
	bool "THERMAL Secure Test"	CONFIG_THERMAL_SEC_VERIFY_FOR_KM4
	bool "LCDC Secure Test"		CONFIG_LCDC_SEC_VERIFY_FOR_KM4
	bool "UART_Secure_TEST"		CONFIG_UART_SEC_VERIFY_FOR_KM4
	bool "SPI_Secure_TEST"		CONFIG_SPI_SEC_VERIFY_FOR_KM4
	bool "I2C_Secure_TEST"		CONFIG_I2C_SEC_VERIFY_FOR_KM4
	bool "EDDSA Secure Test"	CONFIG_EDDSA_SEC_VERIFY_FOR_KM4
	bool "ECDSA Secure Test"	CONFIG_ECDSA_SEC_VERIFY_FOR_KM4
	bool "RSA Secure Test"		CONFIG_RSA_SEC_VERIFY_FOR_KM4
	bool "LEDC Secure Test"		CONFIG_LEDC_SEC_VERIFY_FOR_KM4
	bool "IRDA Secure Test"		CONFIG_IRDA_SEC_VERIFY_FOR_KM4
	bool "Trustzone Secure Test"		CONFIG_TZ_SEC_VERIFY_FOR_KM4
	bool "AUDIO Secure Test"	CONFIG_AUDIO_SEC_VERIFY_FOR_KM4
fi #CONFIG_PER_TEST
endmenu #CONFIG PER TEST






comment '--------------Application Config------------'
mainmenu_option next_comment
comment '< SSL Config'
define_bool CONFIG_USE_MBEDTLS_ROM_FOR_KM4 y
bool "MBEDTLS Enable"		CONFIG_MBED_TLS_ENABLED_FOR_KM4
bool "SSL ROM Test"		CONFIG_SSL_ROM_TEST_FOR_KM4
endmenu

# mainmenu_option next_comment
# comment '< 802154 Config'
# bool "Enable 802154"                     CONFIG_802154_EN_FOR_KM4
# if [ "$CONFIG_802154_EN_FOR_KM4" = "y" ]; then
	# bool "Enable THREAD"                	CONFIG_802154_THREAD_EN_FOR_KM4
	# if [ "$CONFIG_802154_THREAD_EN_FOR_KM4" = "y" ]; then
		# choice 'THREAD ROLE'      "BORDER_ROUTER		CONFIG_802154_THREAD_BORDER_ROUTER_EN_FOR_KM4 \
						# FTD			        CONFIG_802154_THREAD_FTD_EN_FOR_KM4 \
						# MTD			        CONFIG_802154_THREAD_MTD_EN_FOR_KM4 \
						# RCP			        CONFIG_802154_THREAD_RCP_EN_FOR_KM4 \
						# "
		# if [ "$CONFIG_802154_THREAD_RCP_EN_FOR_KM4" = "n" ]; then
			# bool "RCP AS RADIO"                	CONFIG_802154_THREAD_RADIO_RCP_EN_FOR_KM4
		# fi
		# bool "USE FLASH FOR OPENTHREAD SETTING" CONFIG_802154_THREAD_FLASH_API_EN_FOR_KM4
		# bool "STABILITY TEST"                	CONFIG_802154_THREAD_STABILITY_TEST_EN_FOR_KM4
	# fi
	# bool "Enable ZIGBEE"                	CONFIG_802154_ZIGBEE_EN_FOR_KM4
	# if [ "$CONFIG_802154_ZIGBEE_EN_FOR_KM4" = "y" ]; then
		# choice 'ZIGBEE USER TYPE'       "APPLICATION	CONFIG_802154_ZIGBEE_APPLICATION_EN_FOR_KM4 \
										# MAC_TEST		CONFIG_802154_ZIGBEE_MAC_TEST_EN_FOR_KM4 \
										# ZCP_TEST		CONFIG_802154_ZIGBEE_ZCP_TEST_EN_FOR_KM4 \
										# REGRESSION_TEST	CONFIG_802154_ZIGBEE_REGRESSION_TEST_EN_FOR_KM4 \
										# "
		# choice 'ZIGBEE DEVICE ROLE'     "ZC_ZR		CONFIG_802154_ZIGBEE_ROLE_ZC_ZR_FOR_KM4 \
										# ZED			CONFIG_802154_ZIGBEE_ROLE_ZED_FOR_KM4 \
										# "
		# if [ "$CONFIG_802154_ZIGBEE_ZCP_TEST_EN_FOR_KM4" = "y" ]; then
			# choice 'ZCP TEST TYPE'			"DEFAULT		CONFIG_802154_ZIGBEE_ZCP_DEFAULT_EN_FOR_KM4 \
											# GPPB_CERT		CONIFG_802154_ZIGBEE_ZCP_GPPB_EN_FOR_KM4 \
											# "
		# fi
		# if [ "$CONFIG_802154_ZIGBEE_APPLICATION_EN_FOR_KM4" = "y" ]; then
			# if [ "$CONFIG_802154_ZIGBEE_ROLE_ZED_FOR_KM4" = "y" ]; then
				# choice 'ZED ROLE EXAMPLE'	"ha_on_off_light_n_switch[switch]	CONFIG_802154_ZIGBEE_EXAMPLE_ONOFFLIGHT_S_FOR_KM4\
											# light_control[switch]				CONFIG_802154_ZIGBEE_EXAMPLE_LIGHTCTL_S_FOR_KM4\
											# "
			# fi
			# if [ "$CONFIG_802154_ZIGBEE_ROLE_ZC_ZR_FOR_KM4" = "y" ]; then
				# choice 'ZC_ZR EXAMPLE'		"ha_on_off_light_n_switch[light]	CONFIG_802154_ZIGBEE_EXAMPLE_ONOFFLIGHT_L_FOR_KM4\
											# ha_custom_cluster[zc]				CONFIG_802154_ZIGBEE_EXAMPLE_CUSTOM_CLUSTER_ZC_FOR_KM4\
											# ha_custom_cluster[zr]				CONFIG_802154_ZIGBEE_EXAMPLE_CUSTOM_CLUSTER_ZR_FOR_KM4\
											# light_control[bulb]					CONFIG_802154_ZIGBEE_EXAMPLE_LIGHTCTL_B_FOR_KM4\
											# light_control[coor]					CONFIG_802154_ZIGBEE_EXAMPLE_LIGHTCTL_C_FOR_KM4\
											# "
			# fi
		# fi
	# fi
	# bool "Enable 802154 Test"               CONFIG_802154_TEST_EN_FOR_KM4
	# if [ "$CONFIG_802154_TEST_EN_FOR_KM4" = "y" ]; then
		# define_bool CONFIG_802154_THREAD_EN_FOR_KM4 n
		# define_bool CONFIG_802154_ZIGBEE_EN_FOR_KM4 n
	# fi
# fi
# endmenu

mainmenu_option next_comment
comment '< GUI Config'
bool "Enable GUI"                    		CONFIG_GUI_EN_FOR_KM4
if [ "$CONFIG_GUI_EN_FOR_KM4" = "y" ]; then
	bool "emWin"		CONFIG_EMWIN_EN_FOR_KM4
	bool "LittlevGL"		CONFIG_LITTLEVGL_EN_FOR_KM4
fi
endmenu

mainmenu_option next_comment
comment '< Audio Config'

bool "Enable Audio Framework"		CONFIG_AUDIO_FWK_FOR_KM4
if [ "$CONFIG_AUDIO_FWK_FOR_KM4" = "y" ]; then
	choice 'Select Audio Interfaces' "Mixer	CONFIG_AUDIO_MIXER_FOR_KM4 \
								PassThrough	CONFIG_AUDIO_PASSTHROUGH_FOR_KM4"
fi

bool "Enable Media Framework"		CONFIG_MEDIA_PLAYER_FOR_KM4
if [ "$CONFIG_MEDIA_PLAYER_FOR_KM4" = "y" ]; then
	mainmenu_option next_comment
	comment '    Demux'
		bool "Demux WAV"	CONFIG_MEDIA_DEMUX_WAV_FOR_KM4
		bool "Demux MP3"	CONFIG_MEDIA_DEMUX_MP3_FOR_KM4
		bool "Demux AAC"	CONFIG_MEDIA_DEMUX_AAC_FOR_KM4
		bool "Demux M4A"	CONFIG_MEDIA_DEMUX_MP4_FOR_KM4
		bool "Demux FLAC"	CONFIG_MEDIA_DEMUX_FLAC_FOR_KM4
		bool "Demux OGG"	CONFIG_MEDIA_DEMUX_OGG_FOR_KM4
	endmenu
	mainmenu_option next_comment
	comment '    Codec'
		bool "Codec PCM"	CONFIG_MEDIA_CODEC_PCM_FOR_KM4
		bool "Codec MP3"	CONFIG_MEDIA_CODEC_MP3_FOR_KM4
		bool "Codec AAC"	CONFIG_MEDIA_CODEC_HAAC_FOR_KM4
		bool "Codec VORBIS"	CONFIG_MEDIA_CODEC_VORBIS_FOR_KM4
		bool "Codec OPUS"	CONFIG_MEDIA_CODEC_OPUS_FOR_KM4
	endmenu
fi
mainmenu_option next_comment
comment 'Third Party Lib'
        bool "Speex"        CONFIG_SPEEX_LIB_FOR_KM4
        bool "OPUS"         CONFIG_OPUS_LIB_FOR_KM4
endmenu

#bool "Enable Media Lite Framework"      CONFIG_MEDIA_LITE_PLAYER_FOR_KM4
#if [ "$CONFIG_MEDIA_LITE_PLAYER_FOR_KM4" = "y" ]; then
#	mainmenu_option next_comment
#	comment '    Demux'
#		bool "Demux WAV"	CONFIG_MEDIA_LITE_DEMUX_WAV_FOR_KM4
#		bool "Demux MP3"	CONFIG_MEDIA_LITE_DEMUX_MP3_FOR_KM4
#		bool "Demux AAC"	CONFIG_MEDIA_LITE_DEMUX_AAC_FOR_KM4
#		bool "Demux M4A"	CONFIG_MEDIA_LITE_DEMUX_MP4_FOR_KM4
#	endmenu
#	mainmenu_option next_comment
#	comment '    Codec'
#		bool "Codec PCM"	CONFIG_MEDIA_LITE_CODEC_PCM_FOR_KM4
#		bool "Codec MP3"	CONFIG_MEDIA_LITE_CODEC_MP3_FOR_KM4
#		bool "Codec AAC"	CONFIG_MEDIA_LITE_CODEC_HAAC_FOR_KM4
#	endmenu
#fi
if [ "$CONFIG_MEDIA_PLAYER_FOR_KM4" = "y" -o "$CONFIG_MEDIA_LITE_PLAYER_FOR_KM4" = "y" ]; then
	define_bool CONFIG_AUDIO_FWK_FOR_KM4 y
fi
endmenu

mainmenu_option next_comment
comment '< CONFIG IPC Message Queue'
bool "Enable IPC Message Queue"		CONFIG_IMQ_EN_FOR_KM4
if [ "$CONFIG_IMQ_EN_FOR_KM4" = "y" ]; then
	bool "Enable RPC"	 CONFIG_RPC_EN_FOR_KM4
	bool "Enable IPC Message Queue Test"	 CONFIG_IMQ2_TEST_FOR_KM4
	define_bool CONFIG_IPC_MSG_MASTER_FOR_KM4 y
fi
endmenu


#===========================================================================
#===========================================================================

#===========================================================================
#=====================    Debug Message Config Start   =====================
comment '--------------Debug Message Config------------'
mainmenu_option next_comment
comment '< To set debug msg flag'
bool "Enable crashdump for img1(bootloader)"	 CONFIG_DEBUG_CRASHDUMP_IMG1_FOR_KM4
endmenu

#===========================================================================
# Normal: Build all code, includes ROM code. Normally for FPGA verification.
# Release: Build user application code and link with ROM + RAM libraries.
# Build_ROM_Lib: Build the ROM code library only.
# Build_RAM_Lib: Build the RAM code library only.
# Build_RAM_All: Build all RAM code, includes user application, and link with ROM library.
comment '--------------Build Config------------'
mainmenu_option next_comment

comment '< Build Option'

comment 'Select toolchain  '
choice 'Toolchain'		"ASDK             CONFIG_TOOLCHAIN_ASDK_FOR_KM4  \
                                 ARM_GCC          CONFIG_TOOLCHAIN_ARM_GCC_FOR_KM4  \
 			           		" ASDK

comment 'Choose the build configuration '
choice 'Link ROM Mode ' 			"Link_ROM_Library      CONFIG_LINK_ROM_LIB_FOR_KM4  \
                                     Link_ROM_Symbol       CONFIG_LINK_ROM_SYMB_FOR_KM4  \
					               " Link_ROM_Library
endmenu
#===========================================================================
# Some SW CONFIG based on different IC version
#

#---------------------------------------------------------------------------

#---------------------------------------------------------------------------


#===========================================================================
comment '--------------------------'
endmenu


separator "KM4End"
separator "KR4Start"

#===========================================================================

comment '--------------KR4 config------------'

mainmenu_option next_comment
comment '< MENUCONFIG FOR KR4 CONFIG'


comment '--------------CPU config------------'

mainmenu_option next_comment
comment '< CONFIG CHIP'
comment 'Target Platform Selection'
comment 'Choose a Vendor/Product combination.'

choice 'Product' "AMEBALITE CONFIG_AMEBALITE_FOR_KR4  \
		" AMEBALITE

choice 'RSICVCore' "RSICV_KR4 RSICV_CORE_KR4_FOR_KR4  \
		"RSICV_KR4

bool "Select FPGA"            CONFIG_FPGA_FOR_KR4

endmenu

#===========================================================================
# Common Config with every IC have this function in here. Don't litmit someone ic.
#
comment '--------------OS config------------'
mainmenu_option next_comment
comment '< CONFIG OS'

bool "Enable Kernel"                     CONFIG_KERNEL_FOR_KR4

if [ "$CONFIG_KERNEL_FOR_KR4" = "y" ]; then
choice 'Kernel Selecte' "FREERTOS        PLATFORM_FREERTOS_FOR_KR4 \
						"FREERTOS
define_int TASK_SCHEDULER_DISABLED_FOR_KR4 0
fi
endmenu #CONFIG OS

#===========================================================================


#===========================================================================
# Normall function config
#

comment '--------------Peripheral Test---------------'
mainmenu_option next_comment
comment '< CONFIG FUNCTION TEST'
bool "Enable Peripheral Test"		CONFIG_PER_TEST_FOR_KR4
if [ "$CONFIG_PER_TEST_FOR_KR4" = "y" ]; then
	bool "System_Verify_Mode"	CONFIG_SYS_VERIFY_FOR_KR4
	if [ "$CONFIG_SYS_VERIFY_FOR_KR4" = "y" ]; then
	choice 'System Verify Type'	"IMG_SIM	CONFIG_SIMULATION_FOR_KR4 \
								"
	fi
	bool "WIFI FW Test"		CONFIG_WIFI_FW_VERIFY_FOR_KR4
	bool "SOCZB_PTA_Verify_Mode"	CONFIG_SOCZB_PTA_VERIFY_FOR_KR4
	bool "Timer_Verify_Mode"	CONFIG_TIMER_VERIFY_FOR_KR4
	bool "WDG_Verify_Mode"		CONFIG_WDG_VERIFY_FOR_KR4
	bool "Gdma_Verify_Mode"		CONFIG_GDMA_VERIFY_FOR_KR4
	bool "GPIO_Verify_Mode"		CONFIG_GPIO_VERIFY_FOR_KR4
	bool "SPI_COM_Verify_Mode"	CONFIG_SPI_COM_VERIFY_FOR_KR4
	bool "UART_Verify_Mode"		CONFIG_UART_VERIFY_FOR_KR4
	bool "I2C_Verify_Mode"		CONFIG_I2C_VERIFY_FOR_KR4
	bool "PMC_Verify_Mode"		CONFIG_PMC_VERIFY_FOR_KR4
	bool "EFUSE_Verify_Mode"	CONFIG_EFUSE_VERIFY_FOR_KR4
	bool "SPIC_Verify_Mode"		CONFIG_SPIC_VERIFY_FOR_KR4
	bool "ADC_Verify_Mode"		CONFIG_ADC_VERIFY_FOR_KR4
	bool "RSIP_Verify_Mode"		CONFIG_RSIP_VERIFY_FOR_KR4
	bool "CapTouch_Verify_Mode"	CONFIG_CAPTOUCH_VERIFY_FOR_KR4
	bool "SGPIO_Verify_Mode"	CONFIG_SGPIO_VERIFY_FOR_KR4
	bool "Qdecoder_Verify_Mode"	CONFIG_QDEC_VERIFY_FOR_KR4
	bool "Dhrystone Test"		CONFIG_DHRYSTONE_TEST_FOR_KR4
	bool "SSL ROM Test"		CONFIG_SSL_ROM_TEST_FOR_KR4
	bool "RTLIB ROM Test"		CONFIG_RTLIB_VERIFY_FOR_KR4
	bool "SecureBoot Test"		CONFIG_SBOOT_VERIFY_FOR_KR4
	bool "IPC Test"			CONFIG_IPC_VERIFY_FOR_KR4
	bool "MPU Test"			CONFIG_MPU_VERIFY_FOR_KR4
	bool "CACHE Test"		CONFIG_CACHE_VERIFY_FOR_KR4
	bool "WFE Test"			CONFIG_WFE_VERIFY_FOR_KR4
	bool "Thermal_Verify_Mode"	CONFIG_THERMAL_VERIFY_FOR_KR4
	bool "chip_reset_verify"		CONFIG_CHIP_RST_VERIFY_FOR_KR4
	bool "debugtimer_verify"		CONFIG_DBG_TIMER_VERIFY_FOR_KR4
	bool "LOGUART Test"		CONFIG_LOGUART_VERIFY_FOR_KR4
	bool "AUDIO_Verify_Mode"		CONFIG_AUDIO_VERIFY_FOR_KR4
	bool "CRYPTO_Verify_Mode"		CONFIG_CRYPTO_VERIFY_FOR_KR4
	bool "ECDSA_Verify_Mode"		CONFIG_ECDSA_VERIFY_FOR_KR4
	bool "Memory Share Test"		CONFIG_MEMSHARE_VERIFY_FOR_KR4
	bool "Flash_AVL_Mode"       	CONFIG_Flash_AVL_FOR_KR4
	bool "WIFI Test"       			CONFIG_WIFI_VERIFY_FOR_KR4
	if [ "$CONFIG_WIFI_VERIFY_FOR_KR4" = "y" ]; then
	choice 'WIFI Verify Type'         "WIFI_ASIC			 		  CONFIG_WIFI_VERIFY_ASIC_FOR_KR4 \
									   WIFI_MAC_LBK           		  CONFIG_MAC_LBK_FOR_KR4 \
									   WIFI_2MAC_WITH_PSPHY  		  CONFIG_WIFI_VERIFY_PSPHY_FOR_KR4 \
									   WIFI_2MAC_WITH_TUREPHY 		  CONFIG_WIFI_VERIFY_TRUEPHY_FOR_KR4 \
									  "
	fi
fi #CONFIG_PER_TEST
endmenu #CONFIG PER TEST



comment '--------------Application Config------------'
mainmenu_option next_comment
comment '< SSL Config'
define_bool CONFIG_USE_MBEDTLS_ROM_FOR_KR4 y
bool "MBEDTLS Enable"		CONFIG_MBED_TLS_ENABLED_FOR_KR4
bool "SSL ROM Test"		CONFIG_SSL_ROM_TEST_FOR_KR4
endmenu


mainmenu_option next_comment
comment '< Audio Config'

bool "Enable Audio Framework"		CONFIG_AUDIO_FWK_FOR_KR4
if [ "$CONFIG_AUDIO_FWK_FOR_KR4" = "y" ]; then
	choice 'Select Audio Interfaces' "Mixer	CONFIG_AUDIO_MIXER_FOR_KR4 \
								PassThrough	CONFIG_AUDIO_PASSTHROUGH_FOR_KR4"
fi

bool "Enable Media Framework"		CONFIG_MEDIA_PLAYER_FOR_KR4
if [ "$CONFIG_MEDIA_PLAYER_FOR_KR4" = "y" ]; then
	mainmenu_option next_comment
	comment '    Demux'
		bool "Demux WAV"	CONFIG_MEDIA_DEMUX_WAV_FOR_KR4
		bool "Demux MP3"	CONFIG_MEDIA_DEMUX_MP3_FOR_KR4
		bool "Demux AAC"	CONFIG_MEDIA_DEMUX_AAC_FOR_KR4
		bool "Demux M4A"	CONFIG_MEDIA_DEMUX_MP4_FOR_KR4
		bool "Demux FLAC"	CONFIG_MEDIA_DEMUX_FLAC_FOR_KR4
		bool "Demux OGG"	CONFIG_MEDIA_DEMUX_OGG_FOR_KR4
	endmenu
	mainmenu_option next_comment
	comment '    Codec'
		bool "Codec PCM"	CONFIG_MEDIA_CODEC_PCM_FOR_KR4
		bool "Codec MP3"	CONFIG_MEDIA_CODEC_MP3_FOR_KR4
		bool "Codec AAC"	CONFIG_MEDIA_CODEC_HAAC_FOR_KR4
		bool "Codec VORBIS"	CONFIG_MEDIA_CODEC_VORBIS_FOR_KR4
		bool "Codec OPUS"	CONFIG_MEDIA_CODEC_OPUS_FOR_KR4
	endmenu
fi
mainmenu_option next_comment
comment 'Third Party Lib'
        bool "Speex"        CONFIG_SPEEX_LIB_FOR_KR4
        bool "OPUS"         CONFIG_OPUS_LIB_FOR_KR4
endmenu
#bool "Enable Media Lite Framework"      CONFIG_MEDIA_LITE_PLAYER_FOR_KR4
#if [ "$CONFIG_MEDIA_LITE_PLAYER_FOR_KR4" = "y" ]; then
#	mainmenu_option next_comment
#	comment '    Demux'
#		bool "Demux WAV"	CONFIG_MEDIA_LITE_DEMUX_WAV_FOR_KR4
#		bool "Demux MP3"	CONFIG_MEDIA_LITE_DEMUX_MP3_FOR_KR4
#		bool "Demux AAC"	CONFIG_MEDIA_LITE_DEMUX_AAC_FOR_KR4
#		bool "Demux M4A"	CONFIG_MEDIA_LITE_DEMUX_MP4_FOR_KR4
#	endmenu
#	mainmenu_option next_comment
#	comment '    Codec'
#		bool "Codec PCM"	CONFIG_MEDIA_LITE_CODEC_PCM_FOR_KR4
#		bool "Codec MP3"	CONFIG_MEDIA_LITE_CODEC_MP3_FOR_KR4
#		bool "Codec AAC"	CONFIG_MEDIA_LITE_CODEC_HAAC_FOR_KR4
#	endmenu
#fi
if [ "$CONFIG_MEDIA_PLAYER_FOR_KR4" = "y" -o "$CONFIG_MEDIA_LITE_PLAYER_FOR_KR4" = "y" ]; then
	define_bool CONFIG_AUDIO_FWK_FOR_KR4 y
fi
endmenu
mainmenu_option next_comment
comment '< CONFIG IPC Message Queue'
bool "Enable IPC Message Queue"		CONFIG_IMQ_EN_FOR_KR4
if [ "$CONFIG_IMQ_EN_FOR_KR4" = "y" ]; then
	bool "Enable RPC"	 CONFIG_RPC_EN_FOR_KR4
	bool "Enable IPC Message Queue Test"	CONFIG_IMQ2_TEST_FOR_KR4
fi
endmenu

#===========================================================================
#===========================================================================

#===========================================================================
#=====================    Debug Message Config   =====================
comment '--------------Debug Message Config------------'
mainmenu_option next_comment
comment '< To set debug msg flag'

define_bool CONFIG_DEBUG_RXI_DUMP_FOR_KR4 n
bool "Enable debug backtrace"               	 CONFIG_DEBUG_BACK_TRACE_FOR_KR4
bool "Enable debug crash dump"               	 CONFIG_DEBUG_CRASH_DUMP_FOR_KR4

if [ "$CONFIG_DEBUG_CRASH_DUMP_FOR_KR4" = "y" ]; then
	define_int CONFIG_STACK_DUMP_DEPTH_FOR_KR4 100
	define_int CONFIG_DEBUG_CRASH_DUMP_RUNS_FOR_KR4 1
fi
endmenu

#===========================================================================
# Normal: Build all code, includes ROM code. Normally for FPGA verification.
# Release: Build user application code and link with ROM + RAM libraries.
# Build_ROM_Lib: Build the ROM code library only.
# Build_RAM_Lib: Build the RAM code library only.
# Build_RAM_All: Build all RAM code, includes user application, and link with ROM library.
comment '--------------Build Config------------'
mainmenu_option next_comment

comment '< Build Option'

comment 'Select toolchain  '
choice 'Toolchain'		"VSDK             CONFIG_TOOLCHAIN_VSDK_FOR_KR4  \
 			           		" VSDK

comment 'Choose the build configuration '
choice 'Link ROM Mode ' 			"Link_ROM_Library      CONFIG_LINK_ROM_LIB_FOR_KR4  \
                                     Link_ROM_Symbol       CONFIG_LINK_ROM_SYMB_FOR_KR4  \
					               " Link_ROM_Library
endmenu
#===========================================================================
# Some SW CONFIG based on different IC version
#

#---------------------------------------------------------------------------

#---------------------------------------------------------------------------


#===========================================================================
comment '--------------------------'
endmenu

separator "KR4End"
```
